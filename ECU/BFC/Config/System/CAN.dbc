VERSION ""

NS_ :

BS_:

BU_: HLC LSW BFC
VAL_TABLE_ Off_On 1 "On" 0 "Off" ;
VAL_TABLE_ Off_On_Auto 255 "SNA" 2 "Auto" 1 "On" 0 "Off" ;

BO_ 1558 Msg_Diag_Uudt_Response_BFC: 8 BFC
 SG_ Signal_DiagPeriodicResp_BFC : 0|64@1+ (1,0) [0|0] ""  HLC

BO_ 1458 Msg_Diag_Response_BFC: 8 BFC
 SG_ Signal_DiagResponse_BFC : 0|64@1+ (1,0) [0|1.8446744074E+19] ""  HLC

BO_ 1913 Msg_Diag_Request_Global: 8 HLC
 SG_ Signal_DiagRequestGlobal : 0|64@1+ (1,0) [0|1.8446744074E+19] ""  BFC

BO_ 1442 Msg_Diag_Request_BFC: 8 HLC
 SG_ Signal_DiagRequest_BFC : 0|64@1+ (1,0) [0|0] ""  BFC

BO_ 1027 NmHLC: 8 HLC

BO_ 1025 NmLSW: 8 LSW

BO_ 1026 NmBFC: 8 BFC

BO_ 616 LightCtrl: 8 BFC
 SG_ HeadLight : 0|1@1+ (1,0) [0|1] ""  HLC

BO_ 528 LightSwitch: 2 LSW
 SG_ LightSwitch : 0|2@1+ (1,0) [0|2] ""  BFC

BA_DEF_ BO_  "DiagConnection" INT 0 65535;
BA_DEF_ BU_  "NodeLayerModules" STRING ;
BA_DEF_ BO_  "DiagUUDTResponse" ENUM  "No","Yes";
BA_DEF_ BO_  "GenMsgCycleTime" INT 0 0;
BA_DEF_ BO_  "GenMsgSendType" ENUM  "Cyclic","NotUsed","NotUsed","NotUsed","NotUsed","NotUsed","NotUsed","NotUsed","NoMsgSendType";
BA_DEF_ SG_  "GenSigCycleTime" INT 0 0;
BA_DEF_ SG_  "GenSigSendType" ENUM  "Cyclic","OnWrite","NotUsed","OnChange","NotUsed","NotUsed","NotUsed","NoSigSendType";
BA_DEF_  "Baudrate" INT 0 1000000;
BA_DEF_  "BusType" STRING ;
BA_DEF_  "NmType" STRING ;
BA_DEF_  "Manufacturer" STRING ;
BA_DEF_  "NmAsrWaitBusSleepTime" INT 0 65535;
BA_DEF_  "NmAsrTimeoutTime" INT 0 65535;
BA_DEF_  "NmAsrRepeatMessageTime" INT 0 65535;
BA_DEF_ BU_  "NmAsrNode" ENUM  "no","yes";
BA_DEF_  "NmAsrMessageCount" INT 0 256;
BA_DEF_ BO_  "NmAsrMessage" ENUM  "no","yes";
BA_DEF_ BU_  "NmAsrCanMsgReducedTime" INT 0 65535;
BA_DEF_  "NmAsrCanMsgCycleTime" INT 0 65535;
BA_DEF_  "NmAsrBaseAddress" HEX 0 65535;
BA_DEF_ BU_  "ILUsed" ENUM  "no","yes";
BA_DEF_ BO_  "GenMsgILSupport" ENUM  "no","yes";
BA_DEF_ BO_  "DiagState" ENUM  "No","Yes";
BA_DEF_ BO_  "DiagResponse" ENUM  "No","Yes";
BA_DEF_ BO_  "DiagRequest" ENUM  "No","Yes";
BA_DEF_DEF_  "DiagConnection" 0;
BA_DEF_DEF_  "NodeLayerModules" "CANoeILNLVector.dll";
BA_DEF_DEF_  "DiagUUDTResponse" "No";
BA_DEF_DEF_  "GenMsgCycleTime" 0;
BA_DEF_DEF_  "GenMsgSendType" "NoMsgSendType";
BA_DEF_DEF_  "GenSigCycleTime" 0;
BA_DEF_DEF_  "GenSigSendType" "Cyclic";
BA_DEF_DEF_  "Baudrate" 500000;
BA_DEF_DEF_  "BusType" "";
BA_DEF_DEF_  "NmType" "";
BA_DEF_DEF_  "Manufacturer" "Vector";
BA_DEF_DEF_  "NmAsrWaitBusSleepTime" 750;
BA_DEF_DEF_  "NmAsrTimeoutTime" 1000;
BA_DEF_DEF_  "NmAsrRepeatMessageTime" 400;
BA_DEF_DEF_  "NmAsrNode" "yes";
BA_DEF_DEF_  "NmAsrMessageCount" 64;
BA_DEF_DEF_  "NmAsrMessage" "no";
BA_DEF_DEF_  "NmAsrCanMsgReducedTime" 50;
BA_DEF_DEF_  "NmAsrCanMsgCycleTime" 100;
BA_DEF_DEF_  "NmAsrBaseAddress" 1024;
BA_DEF_DEF_  "ILUsed" "yes";
BA_DEF_DEF_  "GenMsgILSupport" "yes";
BA_DEF_DEF_  "DiagState" "No";
BA_DEF_DEF_  "DiagResponse" "No";
BA_DEF_DEF_  "DiagRequest" "No";
BA_ "BusType" "CAN";
BA_ "NmType" "NmAsr";
BA_ "GenMsgILSupport" BO_ 1558 0;
BA_ "DiagUUDTResponse" BO_ 1558 1;
BA_ "DiagConnection" BO_ 1458 57345;
BA_ "DiagResponse" BO_ 1458 1;
BA_ "GenMsgILSupport" BO_ 1458 0;
BA_ "GenMsgSendType" BO_ 1458 0;
BA_ "GenMsgCycleTime" BO_ 1458 100;
BA_ "GenMsgILSupport" BO_ 1913 0;
BA_ "DiagConnection" BO_ 1913 57344;
BA_ "DiagState" BO_ 1913 1;
BA_ "GenMsgSendType" BO_ 1913 0;
BA_ "GenMsgCycleTime" BO_ 1913 100;
BA_ "DiagConnection" BO_ 1442 57345;
BA_ "GenMsgILSupport" BO_ 1442 0;
BA_ "DiagRequest" BO_ 1442 1;
BA_ "GenMsgSendType" BO_ 1442 0;
BA_ "GenMsgCycleTime" BO_ 1442 100;
BA_ "NmAsrMessage" BO_ 1027 1;
BA_ "GenMsgSendType" BO_ 1027 0;
BA_ "GenMsgCycleTime" BO_ 1027 10;
BA_ "NmAsrMessage" BO_ 1025 1;
BA_ "GenMsgSendType" BO_ 1025 0;
BA_ "GenMsgCycleTime" BO_ 1025 10;
BA_ "GenMsgCycleTime" BO_ 1026 10;
BA_ "GenMsgSendType" BO_ 1026 0;
BA_ "NmAsrMessage" BO_ 1026 1;
BA_ "GenMsgCycleTime" BO_ 616 10;
BA_ "GenMsgSendType" BO_ 616 0;
BA_ "GenMsgCycleTime" BO_ 528 100;
BA_ "GenMsgSendType" BO_ 528 0;
BA_ "GenSigSendType" SG_ 1558 Signal_DiagPeriodicResp_BFC 7;
BA_ "GenSigSendType" SG_ 1458 Signal_DiagResponse_BFC 7;
BA_ "GenSigSendType" SG_ 1913 Signal_DiagRequestGlobal 7;
BA_ "GenSigSendType" SG_ 1442 Signal_DiagRequest_BFC 7;
BA_ "GenSigCycleTime" SG_ 616 HeadLight 10;
BA_ "GenSigCycleTime" SG_ 528 LightSwitch 10;
VAL_ 616 HeadLight 1 "On" 0 "Off" ;
VAL_ 528 LightSwitch 255 "SNA" 2 "Auto" 1 "On" 0 "Off" ;
