AUTOSAR XML (schema 00049)
standard types defined: boolean, uint8
package /VehicleProject
  system System
package /Diagnostics
  diagnostic contribution set DiagnosticContributionSet: ecu-instance=BFC, service-tables=DS_BFC
  diagnostic service table DS_BFC: diagnostic-connections=DC_0xE001_oBFC_oCAN00, ecu-instance=BFC
  diagnostic connection DC_0xE001_oBFC_oCAN00: functional-request=Msg_Diag_Request_Global_oTN_0x00E0_HLC, physical-request=Msg_Diag_Request_BFC_oTN_0x0001_BFC, response=Msg_Diag_Response_BFC_oTN_0x0001_BFC
package /NM
  nm config NmConfig: can-nm-cluster-coupling=coupled-cluster=CAN00_CAN
    can nm cluster CAN00_CAN: communication-cluster=CAN00, nm-channel-id=0, nm-msg-cycle-time=0.1, nm-network-timeout=1, nm-repeat-message-time=0.4, nm-wait-bus-sleep-time=0.75
      can nm node BFC: controller=CT_CAN00, nm-if-ecu=BFC_CAN, nm-node-id=2, tx-nm-pdu=NmBFC_oCAN00, nm-msg-cycle-offset=0, nm-msg-reduced-time=0.05, nm-range-config={lower-can-id=1024, upper-can-id=1087}
      can nm node HLC: nm-if-ecu=HLC_CAN, nm-node-id=3, nm-msg-cycle-offset=0, nm-msg-reduced-time=0.05, nm-range-config={lower-can-id=1024, upper-can-id=1087}
      can nm node LSW: nm-if-ecu=LSW_CAN, nm-node-id=1, nm-msg-cycle-offset=0, nm-msg-reduced-time=0.05, nm-range-config={lower-can-id=1024, upper-can-id=1087}
    nm-if-ecus:
      nm ecu BFC_CAN: ecu-instance=BFC, nm-node-id-enabled=false, nm-user-data-enabled=true
      nm ecu HLC_CAN: nm-node-id-enabled=false, nm-user-data-enabled=true
      nm ecu LSW_CAN: nm-node-id-enabled=false, nm-user-data-enabled=true
package /TP
  can tp config CAN00_CAN: communication-cluster=CAN00, can-tp-ecu{cycle-time-main-function=0.005, ecu-instance=BFC}
    can tp address TA_0x0000: tp-address=0
    can tp address TA_0x0001: tp-address=1
    can tp address TA_0x00E0: tp-address=224
    can tp channel TPCH: channel-id=0, channel-mode=FULL-DUPLEX-MODE
    can-tp-connection addressing-format=STANDARD, can-tp-channel=TPCH, data-pdu=Msg_Diag_Request_Global_Tp_oCAN00, multicast=TA_0x0000, receiver=TN_BFC, ta-type=FUNCTIONAL, tp-sdu=Msg_Diag_Request_Global_oCAN00, transmitter=TN_0x00E0_HLC:
      ident Msg_Diag_Request_Global_oTN_0x00E0_HLC
    can-tp-connection addressing-format=STANDARD, can-tp-channel=TPCH, data-pdu=Msg_Diag_Request_BFC_Tp_oCAN00, flow-control-pdu=Msg_Diag_Response_BFC_Tp_oCAN00, receiver=TN_0x0001_BFC, ta-type=PHYSICAL, tp-sdu=Msg_Diag_Request_BFC_oCAN00, transmitter=TN_0x00E0_HLC:
      ident Msg_Diag_Request_BFC_oTN_0x0001_BFC
    can-tp-connection addressing-format=STANDARD, can-tp-channel=TPCH, data-pdu=Msg_Diag_Response_BFC_Tp_oCAN00, flow-control-pdu=Msg_Diag_Request_BFC_Tp_oCAN00, receiver=TN_0x00E0_HLC, ta-type=PHYSICAL, tp-sdu=Msg_Diag_Response_BFC_oCAN00, transmitter=TN_0x0001_BFC:
      ident Msg_Diag_Response_BFC_oTN_0x0001_BFC
    can tp node TN_0x0001_BFC: connector=CN_CAN00, tp-address=TA_0x0001
    can tp node TN_0x00E0_HLC: tp-address=TA_0x00E0
    can tp node TN_BFC: connector=CN_CAN00
package /Cluster
  can cluster CAN00: baudrate=500000, protocol-name=CAN
    can physical channel CHNL: comm-connectors=CN_CAN00
      frame LightCtrl_oCAN00: id 0x268, from BFC, frame-length=8, can-addressing-mode=STANDARD
        pdu LightCtrl_oCAN00: length=8, minimum-delay=0, transmission-mode-false-timing=cyclic-timing={time-offset=0, time-period=0.01}, transmission-mode-true-timing=cyclic-timing={time-offset=0, time-period=0.01}, unused-bit-pattern=0
          signal HeadLight_oLightCtrl_oCAN00: start 0, 1 bit, little-endian, i-signal-type=PRIMITIVE, init-value=0, base-type=boolean, compu {0=Cx0_Off, 1=Cx1_On}, range raw 0..1, transfer-property=PENDING
      frame LightSwitch_oCAN00: id 0x210, to BFC, frame-length=2, can-addressing-mode=STANDARD
        pdu LightSwitch_oCAN00: length=2, minimum-delay=0, transmission-mode-false-timing=cyclic-timing={time-offset=0, time-period=0.1}, transmission-mode-true-timing=cyclic-timing={time-offset=0, time-period=0.1}, unused-bit-pattern=0
          signal LightSwitch_oLightSwitch_oCAN00: start 0, 2 bit, little-endian, i-signal-type=PRIMITIVE, init-value=0, base-type=uint8, invalid-value=3, compu {0=Cx0_Off, 1=Cx1_On, 2=Cx2_Auto, 3=Cx3_SNA} "Source signal range: [0,2]", range raw 0..3, transfer-property=PENDING, to BFC
      frame Msg_Diag_Request_BFC_oCAN00: id 0x5A2, to BFC, frame-length=8, can-addressing-mode=STANDARD
        n pdu Msg_Diag_Request_BFC_Tp_oCAN00: length=8
      frame Msg_Diag_Request_Global_oCAN00: id 0x779, to BFC, frame-length=8, can-addressing-mode=STANDARD
        n pdu Msg_Diag_Request_Global_Tp_oCAN00: length=8
      frame Msg_Diag_Response_BFC_oCAN00: id 0x5B2, from BFC, frame-length=8, can-addressing-mode=STANDARD
        n pdu Msg_Diag_Response_BFC_Tp_oCAN00: length=8
      frame Msg_Diag_Uudt_Response_BFC_oCAN00: id 0x616, from BFC, frame-length=8, can-addressing-mode=STANDARD
        dcm i pdu Msg_Diag_Uudt_Response_BFC_oCAN00: length=8, diag-pdu-type=DIAG-RESPONSE
      frame NmBFC_oCAN00: id 0x402, from BFC, frame-length=8, can-addressing-mode=STANDARD
        nm pdu NmBFC_oCAN00: length=8, unused-bit-pattern=0
      pdu triggering PT_Msg_Diag_Request_BFC: pdu=Msg_Diag_Request_BFC_oCAN00, to BFC
      pdu triggering PT_Msg_Diag_Request_Global: pdu=Msg_Diag_Request_Global_oCAN00, to BFC
      pdu triggering PT_Msg_Diag_Response_BFC: pdu=Msg_Diag_Response_BFC_oCAN00, from BFC
package /ECU
  ecu instance BFC: associated-com-i-pdu-group=[BFC_oCAN00_Rx, BFC_oCAN00_Tx]
    can communication controller CT_CAN00
    can communication connector CN_CAN00: comm-controller=CT_CAN00
package /IPDUGroup
  i signal i pdu group BFC_oCAN00_Rx: communication-direction=IN, i-signal-i-pdus=LightSwitch_oCAN00
  i signal i pdu group BFC_oCAN00_Tx: communication-direction=OUT, i-signal-i-pdus=LightCtrl_oCAN00
package /PDU
  dcm i pdu Msg_Diag_Request_BFC_oCAN00: length=8, diag-pdu-type=DIAG-REQUEST
  dcm i pdu Msg_Diag_Request_Global_oCAN00: length=7, diag-pdu-type=DIAG-REQUEST
  dcm i pdu Msg_Diag_Response_BFC_oCAN00: length=8, diag-pdu-type=DIAG-RESPONSE
