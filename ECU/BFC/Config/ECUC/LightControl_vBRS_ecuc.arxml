AUTOSAR XML (schema 00049)
package /ActiveEcuC
  module config vBRS: implementation-config-variant=VARIANT-PRE-COMPILE, module-description=vBRS_Impl
    vBRSGeneral:
      vBRSEnableCoreSpecificVLinkGenConfig = true
      vBRSEnableSupportLEDs = false
      vBRSEnableSafeContextSupport = false
      vBRSEnableMultiCoreSupport = false
      vBRSEnableSupportToggleWdPin = false
      vBRSEnableSupportToggleCustomPin = false
      vBRSEnableEcuMStubGeneration = false
      vBRSDisableSetupSupport = false
      vBRSEnableSchmStubGeneration = false
      vBRSEnableSchmStubSupportDrvCanAN = true
      vBRSEnableSchmStubEmptyExclusiveAreaHandling = false
      vBRSExecutionInstance = Application
      vBRSFirstInstance = true
      vBRSFblSupportEcuMInit = false
      vBRSFblSupportExceptionTableInRam = false
      vBRSEnableSmallDevicesOptimization = false
      vBRSHypervisorGuest = false
    vBRSHwConfig:
      vBRSOscClock = 20000000
      vBRSPeriphClock = 100000000
      vBRSTimebaseClock = 100000000
      vBRSPeriphClockDescription = Initial value for Peripheral Clock: 100MHz GPT=100MHz/8 =12.5MHz
      vBRSEnablePortHandling = false
      vBRSEnableWatchdogHandling = false
      vBRSEnablePLLClocksHandling = false
      vBRSPreferPLLWatchdogInit = false
      vBRSEvaluationBoard = TRIBOARD_TC3x7
      3 x vBRSEvalBoardInfo:
        TRIBOARD_TC3x7: vBRSEvalBoard=TRIBOARD_TC3x7, vBRSEvalBoardDescription=Toggle Port Group 33 Port 4 for LED support, vBRSEvalBoardOscClock=20000000
        TRIBOARD_TC3x9: vBRSEvalBoard=TRIBOARD_TC3x9, vBRSEvalBoardDescription=Toggle Port Group 33 Port 4 for LED support, vBRSEvalBoardOscClock=20000000
        CUSTOMER_HARDWARE: vBRSEvalBoard=CUSTOMER_HARDWARE, vBRSEvalBoardDescription=This Eval board is used for customer hardware. All pin configuration have to be specify manually in the BrsHw_Ports.h.
      vBRSDriverHandlingCAN:
        vBRSEnableDriverHandlingCAN = true
        vBRSDriverHandlingCAN_channel0 = true
        vBRSDriverHandlingCAN_channel{1..9} = false
        vBRSDriverHandlingCAN_PeripheralClock = false
        vBRSDriverHandlingCAN_channel{10..19} = false
        vBRSDriverHandlingCAN_Clock = 20000000
    vBRSMemoryInit: vBRSInitPatternBlocks=0, vBRSInitPatternHardResetBlocks=0, vBRSInitPatternAreas=0, vBRSInitPatternHardResetAreas=0
