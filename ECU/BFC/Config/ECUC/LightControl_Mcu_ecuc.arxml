AUTOSAR XML (schema 00049)
package /Mcu
  module config Mcu: implementation-config-variant=VARIANT-POST-BUILD, module-description=Mcu_Impl
    CommonPublishedInformation:
      ArMajorVersion = 4
      ArMinorVersion = 4
      ArPatchVersion = 0
      ModuleId = 101
      Release = _TRICORE_TC397_ADAS
      SwMajorVersion = 20
      SwMinorVersion = 25
      SwPatchVersion = 0
      VendorId = 17
    McuGeneralConfiguration:
      McuCcu60SleepModeEnabled = false
      McuCcu61SleepModeEnabled = false
      McuClearColdResetStatusApi = false
      McuClockSourceFailureNotification = false
      McuDevErrorDetect = false
      McuGetRamStateApi = false
      McuGpt12SleepModeEnabled = false
      McuGtmSleepModeEnabled = false
      McuIdleModeCpuCore = INDIVIDUAL_IDLE_CORES_SEL0
      McuIfxCpuCcuconApi = false
      McuIfxDeInitApi = false
      McuIfxLpmApi = false
      McuIfxTrapApi = false
      McuInitCheckApi = false
      McuInitClock = true
      McuInitDeInitApiMode = MCU_MCAL_SUPERVISOR
      McuMainOscillatorFrequency = 20
      McuMultiCoreErrorDetect = false
      McuNoPll = false
      McuOscAmpRegulationEnable = false
      McuOscCapacitance{0..3}Enable = false
      McuOscillatorMode = EXT_CRYSTAL_CERAMIC_RES_MODE_SEL0
      McuPerformResetApi = true
      McuRuntimeApiMode = MCU_MCAL_SUPERVISOR
      McuSafetyEnable = false
      McuStandbyEntryMode = STANDBY_ENTRY_REQ_SLEEP_SEL0
      McuSysClkFrequency = 20
      McuSystemModeCpuCore = CPU_SYSTEM_CORE0_SEL0
      McuVersionInfoApi = false
      McuVersionCheckExternalModules = false
      McuCriticalSectionProtection = false
      McuSwResetCall = false
      McuDeviceName = V4H
      McuIsrCategory = CAT1
    McuHardwareResourceAllocationConf_0 (McuHardwareResourceAllocationConf)
      12 x McuAscLinAllocationConf:
        McuAscLinAllocationConf_0
          McuAscLinChannelAllocationConf: McuAscLinChannelAllocationConf=ASCLIN_CH_NOT_USED, McuAscLinKernelId=ASCLIN0
        McuAscLinAllocationConf_1
          McuAscLinChannelAllocationConf: McuAscLinChannelAllocationConf=ASCLIN_CH_NOT_USED, McuAscLinKernelId=ASCLIN0
        McuAscLinAllocationConf_10
          McuAscLinChannelAllocationConf: McuAscLinChannelAllocationConf=ASCLIN_CH_NOT_USED, McuAscLinKernelId=ASCLIN0
        McuAscLinAllocationConf_11
          McuAscLinChannelAllocationConf: McuAscLinChannelAllocationConf=ASCLIN_CH_NOT_USED, McuAscLinKernelId=ASCLIN0
        McuAscLinAllocationConf_2
          McuAscLinChannelAllocationConf: McuAscLinChannelAllocationConf=ASCLIN_CH_NOT_USED, McuAscLinKernelId=ASCLIN0
        McuAscLinAllocationConf_3
          McuAscLinChannelAllocationConf: McuAscLinChannelAllocationConf=ASCLIN_CH_NOT_USED, McuAscLinKernelId=ASCLIN0
        McuAscLinAllocationConf_4
          McuAscLinChannelAllocationConf: McuAscLinChannelAllocationConf=ASCLIN_CH_NOT_USED, McuAscLinKernelId=ASCLIN0
        McuAscLinAllocationConf_5
          McuAscLinChannelAllocationConf: McuAscLinChannelAllocationConf=ASCLIN_CH_NOT_USED, McuAscLinKernelId=ASCLIN0
        McuAscLinAllocationConf_6
          McuAscLinChannelAllocationConf: McuAscLinChannelAllocationConf=ASCLIN_CH_NOT_USED, McuAscLinKernelId=ASCLIN0
        McuAscLinAllocationConf_7
          McuAscLinChannelAllocationConf: McuAscLinChannelAllocationConf=ASCLIN_CH_NOT_USED, McuAscLinKernelId=ASCLIN0
        McuAscLinAllocationConf_8
          McuAscLinChannelAllocationConf: McuAscLinChannelAllocationConf=ASCLIN_CH_NOT_USED, McuAscLinKernelId=ASCLIN0
        McuAscLinAllocationConf_9
          McuAscLinChannelAllocationConf: McuAscLinChannelAllocationConf=ASCLIN_CH_NOT_USED, McuAscLinKernelId=ASCLIN0
      McuCcu6ModuleAllocationConf_0 (McuCcu6ModuleAllocationConf): McuCcu6ModuleAllocationConf=CCU6_MODULE_USED_BY_ADC_DRIVER
      McuCcu6ModuleAllocationConf_1 (McuCcu6ModuleAllocationConf): McuCcu6ModuleAllocationConf=CCU6_MODULE_NOT_USED
      McuEruAllocationConf_0 (McuEruAllocationConf)
        8 x McuEruChannelInputLineConf, all with McuEruChannelInputLineConf=ERU_CHANNEL_INP_NOT_USED:
          McuEruChannelInputLineConf_{0..7}
        8 x McuEruChannelOutputUnitConf, all with McuEruChannelOutputUnitConf=ERU_CHANNEL_OUT_NOT_USED:
          McuEruChannelOutputUnitConf_{0..7}
      5 x McuGpt12ModuleAllocationConf, all with McuGpt12ModuleAllocationConf=GPT_TIMER_NOT_USED:
        McuGpt12ModuleAllocationConf_0: McuGpt12TimerAllocation=GPT_TIMER_2
        McuGpt12ModuleAllocationConf_1: McuGpt12TimerAllocation=GPT_TIMER_3
        McuGpt12ModuleAllocationConf_2: McuGpt12TimerAllocation=GPT_TIMER_4
        McuGpt12ModuleAllocationConf_3: McuGpt12TimerAllocation=GPT_TIMER_5
        McuGpt12ModuleAllocationConf_4: McuGpt12TimerAllocation=GPT_TIMER_6
      McuGtmAllocationConf_0 (McuGtmAllocationConf)
        12 x McuGtmAtomAllocationConf:
          McuGtmAtomAllocationConf_0
            8 x McuGtmAtomChannelAllocationConf, all with McuAtomChannelEventHandledByDsadc=false, McuGtmAtomChannelAllocationConf=GTM_ATOM_CHANNEL_NOT_USED:
              McuGtmAtomChannelAllocationConf_{0..7}
          McuGtmAtomAllocationConf_1
            8 x McuGtmAtomChannelAllocationConf, all with McuAtomChannelEventHandledByDsadc=false, McuGtmAtomChannelAllocationConf=GTM_ATOM_CHANNEL_NOT_USED:
              McuGtmAtomChannelAllocationConf_{0..7}
          McuGtmAtomAllocationConf_10
            8 x McuGtmAtomChannelAllocationConf, all with McuAtomChannelEventHandledByDsadc=false, McuGtmAtomChannelAllocationConf=GTM_ATOM_CHANNEL_NOT_USED:
              McuGtmAtomChannelAllocationConf_{0..7}
          McuGtmAtomAllocationConf_11
            8 x McuGtmAtomChannelAllocationConf, all with McuAtomChannelEventHandledByDsadc=false, McuGtmAtomChannelAllocationConf=GTM_ATOM_CHANNEL_NOT_USED:
              McuGtmAtomChannelAllocationConf_{0..7}
          McuGtmAtomAllocationConf_2
            8 x McuGtmAtomChannelAllocationConf, all with McuAtomChannelEventHandledByDsadc=false, McuGtmAtomChannelAllocationConf=GTM_ATOM_CHANNEL_NOT_USED:
              McuGtmAtomChannelAllocationConf_{0..7}
          McuGtmAtomAllocationConf_3
            8 x McuGtmAtomChannelAllocationConf, all with McuAtomChannelEventHandledByDsadc=false, McuGtmAtomChannelAllocationConf=GTM_ATOM_CHANNEL_NOT_USED:
              McuGtmAtomChannelAllocationConf_{0..7}
          McuGtmAtomAllocationConf_4
            8 x McuGtmAtomChannelAllocationConf, all with McuAtomChannelEventHandledByDsadc=false, McuGtmAtomChannelAllocationConf=GTM_ATOM_CHANNEL_NOT_USED:
              McuGtmAtomChannelAllocationConf_{0..7}
          McuGtmAtomAllocationConf_5
            8 x McuGtmAtomChannelAllocationConf, all with McuAtomChannelEventHandledByDsadc=false, McuGtmAtomChannelAllocationConf=GTM_ATOM_CHANNEL_NOT_USED:
              McuGtmAtomChannelAllocationConf_{0..7}
          McuGtmAtomAllocationConf_6
            8 x McuGtmAtomChannelAllocationConf, all with McuAtomChannelEventHandledByDsadc=false, McuGtmAtomChannelAllocationConf=GTM_ATOM_CHANNEL_NOT_USED:
              McuGtmAtomChannelAllocationConf_{0..7}
          McuGtmAtomAllocationConf_7
            8 x McuGtmAtomChannelAllocationConf, all with McuAtomChannelEventHandledByDsadc=false, McuGtmAtomChannelAllocationConf=GTM_ATOM_CHANNEL_NOT_USED:
              McuGtmAtomChannelAllocationConf_{0..7}
          McuGtmAtomAllocationConf_8
            8 x McuGtmAtomChannelAllocationConf, all with McuAtomChannelEventHandledByDsadc=false, McuGtmAtomChannelAllocationConf=GTM_ATOM_CHANNEL_NOT_USED:
              McuGtmAtomChannelAllocationConf_{0..7}
          McuGtmAtomAllocationConf_9
            8 x McuGtmAtomChannelAllocationConf, all with McuAtomChannelEventHandledByDsadc=false, McuGtmAtomChannelAllocationConf=GTM_ATOM_CHANNEL_NOT_USED:
              McuGtmAtomChannelAllocationConf_{0..7}
        8 x McuGtmTimAllocationConf:
          McuGtmTimAllocationConf_0
            8 x McuGtmTimChannelAllocationConf, all with McuGtmTimChannelAllocationConf=GTM_TIM_CHANNEL_NOT_USED:
              McuGtmTimChannelAllocationConf_{0..7}
          McuGtmTimAllocationConf_1
            8 x McuGtmTimChannelAllocationConf, all with McuGtmTimChannelAllocationConf=GTM_TIM_CHANNEL_NOT_USED:
              McuGtmTimChannelAllocationConf_{0..7}
          McuGtmTimAllocationConf_2
            8 x McuGtmTimChannelAllocationConf, all with McuGtmTimChannelAllocationConf=GTM_TIM_CHANNEL_NOT_USED:
              McuGtmTimChannelAllocationConf_{0..7}
          McuGtmTimAllocationConf_3
            8 x McuGtmTimChannelAllocationConf, all with McuGtmTimChannelAllocationConf=GTM_TIM_CHANNEL_NOT_USED:
              McuGtmTimChannelAllocationConf_{0..7}
          McuGtmTimAllocationConf_4
            8 x McuGtmTimChannelAllocationConf, all with McuGtmTimChannelAllocationConf=GTM_TIM_CHANNEL_NOT_USED:
              McuGtmTimChannelAllocationConf_{0..7}
          McuGtmTimAllocationConf_5
            8 x McuGtmTimChannelAllocationConf, all with McuGtmTimChannelAllocationConf=GTM_TIM_CHANNEL_NOT_USED:
              McuGtmTimChannelAllocationConf_{0..7}
          McuGtmTimAllocationConf_6
            8 x McuGtmTimChannelAllocationConf, all with McuGtmTimChannelAllocationConf=GTM_TIM_CHANNEL_NOT_USED:
              McuGtmTimChannelAllocationConf_{0..7}
          McuGtmTimAllocationConf_7
            8 x McuGtmTimChannelAllocationConf, all with McuGtmTimChannelAllocationConf=GTM_TIM_CHANNEL_NOT_USED:
              McuGtmTimChannelAllocationConf_{0..7}
        6 x McuGtmTomAllocationConf:
          McuGtmTomAllocationConf_0
            16 x McuGtmTomChannelAllocationConf, all with McuGtmTomChannelAllocationConf=GTM_TOM_CHANNEL_NOT_USED, McuTomChannelEventHandledByDsadc=false:
              McuGtmTomChannelAllocationConf_0
              McuGtmTomChannelAllocationConf_1
              McuGtmTomChannelAllocationConf_{10..15}
              McuGtmTomChannelAllocationConf_{2..9}
          McuGtmTomAllocationConf_1
            16 x McuGtmTomChannelAllocationConf, all with McuGtmTomChannelAllocationConf=GTM_TOM_CHANNEL_NOT_USED, McuTomChannelEventHandledByDsadc=false:
              McuGtmTomChannelAllocationConf_0
              McuGtmTomChannelAllocationConf_1
              McuGtmTomChannelAllocationConf_{10..15}
              McuGtmTomChannelAllocationConf_{2..9}
          McuGtmTomAllocationConf_2
            16 x McuGtmTomChannelAllocationConf, all with McuGtmTomChannelAllocationConf=GTM_TOM_CHANNEL_NOT_USED, McuTomChannelEventHandledByDsadc=false:
              McuGtmTomChannelAllocationConf_0
              McuGtmTomChannelAllocationConf_1
              McuGtmTomChannelAllocationConf_{10..15}
              McuGtmTomChannelAllocationConf_{2..9}
          McuGtmTomAllocationConf_3
            16 x McuGtmTomChannelAllocationConf, all with McuGtmTomChannelAllocationConf=GTM_TOM_CHANNEL_NOT_USED, McuTomChannelEventHandledByDsadc=false:
              McuGtmTomChannelAllocationConf_0
              McuGtmTomChannelAllocationConf_1
              McuGtmTomChannelAllocationConf_{10..15}
              McuGtmTomChannelAllocationConf_{2..9}
          McuGtmTomAllocationConf_4
            16 x McuGtmTomChannelAllocationConf, all with McuGtmTomChannelAllocationConf=GTM_TOM_CHANNEL_NOT_USED, McuTomChannelEventHandledByDsadc=false:
              McuGtmTomChannelAllocationConf_0
              McuGtmTomChannelAllocationConf_1
              McuGtmTomChannelAllocationConf_{10..15}
              McuGtmTomChannelAllocationConf_{2..9}
          McuGtmTomAllocationConf_5
            16 x McuGtmTomChannelAllocationConf, all with McuGtmTomChannelAllocationConf=GTM_TOM_CHANNEL_NOT_USED, McuTomChannelEventHandledByDsadc=false:
              McuGtmTomChannelAllocationConf_0
              McuGtmTomChannelAllocationConf_1
              McuGtmTomChannelAllocationConf_{10..15}
              McuGtmTomChannelAllocationConf_{2..9}
      6 x McuStmAllocationConf, all with McuStmCmp0RegAllocationConf=STM_CMP0_NOT_USED, McuStmCmp1RegAllocationConf=STM_CMP1_NOT_USED:
        McuStmAllocationConf_{0..5}
    McuModuleConfiguration: McuClockSrcFailureNotification=DISABLED, McuNumberOfMcuModes=1, McuRamSectors=0, McuResetSetting=1
      GtmGlobalConfiguration_0 (GtmGlobalConfiguration)
        12 x GtmAtomGlobalConf:
          GtmAtomGlobalConf_0
            8 x GtmAtomChannelConf, all with GtmAtomChInternalTriggerEnable=false, GtmAtomChResetCn0OnTriggerEnable=false, GtmTimerPortPinSelect=NONE:
              GtmAtomChannelConf_{0..7}
            GtmAtomGroupConf
              GtmAtomActionTimeBaseUnitConf: GtmAtomActionTimeBaseSelection=ATOM_ACT_TB_TBU_TS0, GtmAtomActionTimeBaseValue=1
          GtmAtomGlobalConf_1
            8 x GtmAtomChannelConf, all with GtmAtomChInternalTriggerEnable=false, GtmAtomChResetCn0OnTriggerEnable=false, GtmTimerPortPinSelect=NONE:
              GtmAtomChannelConf_{0..7}
            GtmAtomGroupConf
              GtmAtomActionTimeBaseUnitConf: GtmAtomActionTimeBaseSelection=ATOM_ACT_TB_TBU_TS0, GtmAtomActionTimeBaseValue=1
          GtmAtomGlobalConf_10
            8 x GtmAtomChannelConf, all with GtmAtomChInternalTriggerEnable=false, GtmAtomChResetCn0OnTriggerEnable=false, GtmTimerPortPinSelect=NONE:
              GtmAtomChannelConf_{0..7}
            GtmAtomGroupConf
              GtmAtomActionTimeBaseUnitConf: GtmAtomActionTimeBaseSelection=ATOM_ACT_TB_TBU_TS0, GtmAtomActionTimeBaseValue=1
          GtmAtomGlobalConf_11
            8 x GtmAtomChannelConf, all with GtmAtomChInternalTriggerEnable=false, GtmAtomChResetCn0OnTriggerEnable=false, GtmTimerPortPinSelect=NONE:
              GtmAtomChannelConf_{0..7}
            GtmAtomGroupConf
              GtmAtomActionTimeBaseUnitConf: GtmAtomActionTimeBaseSelection=ATOM_ACT_TB_TBU_TS0, GtmAtomActionTimeBaseValue=1
          GtmAtomGlobalConf_2
            8 x GtmAtomChannelConf, all with GtmAtomChInternalTriggerEnable=false, GtmAtomChResetCn0OnTriggerEnable=false, GtmTimerPortPinSelect=NONE:
              GtmAtomChannelConf_{0..7}
            GtmAtomGroupConf
              GtmAtomActionTimeBaseUnitConf: GtmAtomActionTimeBaseSelection=ATOM_ACT_TB_TBU_TS0, GtmAtomActionTimeBaseValue=1
          GtmAtomGlobalConf_3
            8 x GtmAtomChannelConf, all with GtmAtomChInternalTriggerEnable=false, GtmAtomChResetCn0OnTriggerEnable=false, GtmTimerPortPinSelect=NONE:
              GtmAtomChannelConf_{0..7}
            GtmAtomGroupConf
              GtmAtomActionTimeBaseUnitConf: GtmAtomActionTimeBaseSelection=ATOM_ACT_TB_TBU_TS0, GtmAtomActionTimeBaseValue=1
          GtmAtomGlobalConf_4
            8 x GtmAtomChannelConf, all with GtmAtomChInternalTriggerEnable=false, GtmAtomChResetCn0OnTriggerEnable=false, GtmTimerPortPinSelect=NONE:
              GtmAtomChannelConf_{0..7}
            GtmAtomGroupConf
              GtmAtomActionTimeBaseUnitConf: GtmAtomActionTimeBaseSelection=ATOM_ACT_TB_TBU_TS0, GtmAtomActionTimeBaseValue=1
          GtmAtomGlobalConf_5
            8 x GtmAtomChannelConf, all with GtmAtomChInternalTriggerEnable=false, GtmAtomChResetCn0OnTriggerEnable=false, GtmTimerPortPinSelect=NONE:
              GtmAtomChannelConf_{0..7}
            GtmAtomGroupConf
              GtmAtomActionTimeBaseUnitConf: GtmAtomActionTimeBaseSelection=ATOM_ACT_TB_TBU_TS0, GtmAtomActionTimeBaseValue=1
          GtmAtomGlobalConf_6
            8 x GtmAtomChannelConf, all with GtmAtomChInternalTriggerEnable=false, GtmAtomChResetCn0OnTriggerEnable=false, GtmTimerPortPinSelect=NONE:
              GtmAtomChannelConf_{0..7}
            GtmAtomGroupConf
              GtmAtomActionTimeBaseUnitConf: GtmAtomActionTimeBaseSelection=ATOM_ACT_TB_TBU_TS0, GtmAtomActionTimeBaseValue=1
          GtmAtomGlobalConf_7
            8 x GtmAtomChannelConf, all with GtmAtomChInternalTriggerEnable=false, GtmAtomChResetCn0OnTriggerEnable=false, GtmTimerPortPinSelect=NONE:
              GtmAtomChannelConf_{0..7}
            GtmAtomGroupConf
              GtmAtomActionTimeBaseUnitConf: GtmAtomActionTimeBaseSelection=ATOM_ACT_TB_TBU_TS0, GtmAtomActionTimeBaseValue=1
          GtmAtomGlobalConf_8
            8 x GtmAtomChannelConf, all with GtmAtomChInternalTriggerEnable=false, GtmAtomChResetCn0OnTriggerEnable=false, GtmTimerPortPinSelect=NONE:
              GtmAtomChannelConf_{0..7}
            GtmAtomGroupConf
              GtmAtomActionTimeBaseUnitConf: GtmAtomActionTimeBaseSelection=ATOM_ACT_TB_TBU_TS0, GtmAtomActionTimeBaseValue=1
          GtmAtomGlobalConf_9
            8 x GtmAtomChannelConf, all with GtmAtomChInternalTriggerEnable=false, GtmAtomChResetCn0OnTriggerEnable=false, GtmTimerPortPinSelect=NONE:
              GtmAtomChannelConf_{0..7}
            GtmAtomGroupConf
              GtmAtomActionTimeBaseUnitConf: GtmAtomActionTimeBaseSelection=ATOM_ACT_TB_TBU_TS0, GtmAtomActionTimeBaseValue=1
        12 x GtmClusterConf, all with GtmCmuClusterInputClockDividerEnable=CLS_CLK_CFG_ENABLED_WITH_DIV_SEL2:
          GtmClusterConf_0
            GtmClusterConfClockSetting:
              GtmClusterConfClock{0..7}Src = CMU_CONF_CLOCK{0..7}_SEL0
            GtmClusterFixedClockSetting: GtmClusterFixedClockSrc=CMU_FIXED_CLOCK0_SEL0
          GtmClusterConf_1
            GtmClusterConfClockSetting:
              GtmClusterConfClock{0..7}Src = CMU_CONF_CLOCK{0..7}_SEL0
            GtmClusterFixedClockSetting: GtmClusterFixedClockSrc=CMU_FIXED_CLOCK0_SEL0
          GtmClusterConf_10
            GtmClusterConfClockSetting:
              GtmClusterConfClock{0..7}Src = CMU_CONF_CLOCK{0..7}_SEL0
            GtmClusterFixedClockSetting: GtmClusterFixedClockSrc=CMU_FIXED_CLOCK0_SEL0
          GtmClusterConf_11
            GtmClusterConfClockSetting:
              GtmClusterConfClock{0..7}Src = CMU_CONF_CLOCK{0..7}_SEL0
            GtmClusterFixedClockSetting: GtmClusterFixedClockSrc=CMU_FIXED_CLOCK0_SEL0
          GtmClusterConf_2
            GtmClusterConfClockSetting:
              GtmClusterConfClock{0..7}Src = CMU_CONF_CLOCK{0..7}_SEL0
            GtmClusterFixedClockSetting: GtmClusterFixedClockSrc=CMU_FIXED_CLOCK0_SEL0
          GtmClusterConf_3
            GtmClusterConfClockSetting:
              GtmClusterConfClock{0..7}Src = CMU_CONF_CLOCK{0..7}_SEL0
            GtmClusterFixedClockSetting: GtmClusterFixedClockSrc=CMU_FIXED_CLOCK0_SEL0
          GtmClusterConf_4
            GtmClusterConfClockSetting:
              GtmClusterConfClock{0..7}Src = CMU_CONF_CLOCK{0..7}_SEL0
            GtmClusterFixedClockSetting: GtmClusterFixedClockSrc=CMU_FIXED_CLOCK0_SEL0
          GtmClusterConf_5
            GtmClusterConfClockSetting:
              GtmClusterConfClock{0..7}Src = CMU_CONF_CLOCK{0..7}_SEL0
            GtmClusterFixedClockSetting: GtmClusterFixedClockSrc=CMU_FIXED_CLOCK0_SEL0
          GtmClusterConf_6
            GtmClusterConfClockSetting:
              GtmClusterConfClock{0..7}Src = CMU_CONF_CLOCK{0..7}_SEL0
            GtmClusterFixedClockSetting: GtmClusterFixedClockSrc=CMU_FIXED_CLOCK0_SEL0
          GtmClusterConf_7
            GtmClusterConfClockSetting:
              GtmClusterConfClock{0..7}Src = CMU_CONF_CLOCK{0..7}_SEL0
            GtmClusterFixedClockSetting: GtmClusterFixedClockSrc=CMU_FIXED_CLOCK0_SEL0
          GtmClusterConf_8
            GtmClusterConfClockSetting:
              GtmClusterConfClock{0..7}Src = CMU_CONF_CLOCK{0..7}_SEL0
            GtmClusterFixedClockSetting: GtmClusterFixedClockSrc=CMU_FIXED_CLOCK0_SEL0
          GtmClusterConf_9
            GtmClusterConfClockSetting:
              GtmClusterConfClock{0..7}Src = CMU_CONF_CLOCK{0..7}_SEL0
            GtmClusterFixedClockSetting: GtmClusterFixedClockSrc=CMU_FIXED_CLOCK0_SEL0
        4 x GtmTbuChannelConf, all with GtmTbuChClockSourceSelection=CMU_CLOCK0_SEL0, GtmTbuChMode=FREE_RUNNING_COUNTER_SEL0, GtmTbuChModuloCntrSel=TBU_CH1_SEL0, GtmTbuChResolutionSel=TBU_CH_LOWER_COUNT_BITS_SEL0, GtmTbuChannelEnable=false:
          GtmTbuChannelConf_{0..3}
        8 x GtmTimGlobalConf:
          GtmTimGlobalConf_0
            8 x GtmTimChannelConf, all with GtmTimInpPortPinSel=SEL0_NONE:
              GtmTimChannelConf_{0..7}
          GtmTimGlobalConf_1
            8 x GtmTimChannelConf, all with GtmTimInpPortPinSel=SEL0_NONE:
              GtmTimChannelConf_{0..7}
          GtmTimGlobalConf_2
            8 x GtmTimChannelConf, all with GtmTimInpPortPinSel=SEL0_NONE:
              GtmTimChannelConf_{0..7}
          GtmTimGlobalConf_3
            8 x GtmTimChannelConf, all with GtmTimInpPortPinSel=SEL0_NONE:
              GtmTimChannelConf_{0..7}
          GtmTimGlobalConf_4
            8 x GtmTimChannelConf, all with GtmTimInpPortPinSel=SEL0_NONE:
              GtmTimChannelConf_{0..7}
          GtmTimGlobalConf_5
            8 x GtmTimChannelConf, all with GtmTimInpPortPinSel=SEL0_NONE:
              GtmTimChannelConf_{0..7}
          GtmTimGlobalConf_6
            8 x GtmTimChannelConf, all with GtmTimInpPortPinSel=SEL0_NONE:
              GtmTimChannelConf_{0..7}
          GtmTimGlobalConf_7
            8 x GtmTimChannelConf, all with GtmTimInpPortPinSel=SEL0_NONE:
              GtmTimChannelConf_{0..7}
        6 x GtmTomGlobalConf:
          GtmTomGlobalConf_0
            16 x GtmTomChannelConf, all with GtmTimerPortPinSelect=NONE, GtmTomChInternalTriggerEnable=false, GtmTomChResetCn0OnTriggerEnable=false:
              GtmTomChannelConf_0
              GtmTomChannelConf_1
              GtmTomChannelConf_{10..15}
              GtmTomChannelConf_{2..9}
            GtmTomGroupConf_0 (GtmTomGroupConf)
              GtmTomActionTimeBaseUnitConf: GtmTomActionTimeBaseSelection=TOM_ACT_TB_TBU_TS0, GtmTomActionTimeBaseValue=1
            GtmTomGroupConf_1 (GtmTomGroupConf)
              GtmTomActionTimeBaseUnitConf: GtmTomActionTimeBaseSelection=TOM_ACT_TB_TBU_TS0, GtmTomActionTimeBaseValue=1
          GtmTomGlobalConf_1
            16 x GtmTomChannelConf, all with GtmTimerPortPinSelect=NONE, GtmTomChInternalTriggerEnable=false, GtmTomChResetCn0OnTriggerEnable=false:
              GtmTomChannelConf_0
              GtmTomChannelConf_1
              GtmTomChannelConf_{10..15}
              GtmTomChannelConf_{2..9}
            GtmTomGroupConf_0 (GtmTomGroupConf)
              GtmTomActionTimeBaseUnitConf: GtmTomActionTimeBaseSelection=TOM_ACT_TB_TBU_TS0, GtmTomActionTimeBaseValue=1
            GtmTomGroupConf_1 (GtmTomGroupConf)
              GtmTomActionTimeBaseUnitConf: GtmTomActionTimeBaseSelection=TOM_ACT_TB_TBU_TS0, GtmTomActionTimeBaseValue=1
          GtmTomGlobalConf_2
            16 x GtmTomChannelConf, all with GtmTimerPortPinSelect=NONE, GtmTomChInternalTriggerEnable=false, GtmTomChResetCn0OnTriggerEnable=false:
              GtmTomChannelConf_0
              GtmTomChannelConf_1
              GtmTomChannelConf_{10..15}
              GtmTomChannelConf_{2..9}
            GtmTomGroupConf_0 (GtmTomGroupConf)
              GtmTomActionTimeBaseUnitConf: GtmTomActionTimeBaseSelection=TOM_ACT_TB_TBU_TS0, GtmTomActionTimeBaseValue=1
            GtmTomGroupConf_1 (GtmTomGroupConf)
              GtmTomActionTimeBaseUnitConf: GtmTomActionTimeBaseSelection=TOM_ACT_TB_TBU_TS0, GtmTomActionTimeBaseValue=1
          GtmTomGlobalConf_3
            16 x GtmTomChannelConf, all with GtmTimerPortPinSelect=NONE, GtmTomChInternalTriggerEnable=false, GtmTomChResetCn0OnTriggerEnable=false:
              GtmTomChannelConf_0
              GtmTomChannelConf_1
              GtmTomChannelConf_{10..15}
              GtmTomChannelConf_{2..9}
            GtmTomGroupConf_0 (GtmTomGroupConf)
              GtmTomActionTimeBaseUnitConf: GtmTomActionTimeBaseSelection=TOM_ACT_TB_TBU_TS0, GtmTomActionTimeBaseValue=1
            GtmTomGroupConf_1 (GtmTomGroupConf)
              GtmTomActionTimeBaseUnitConf: GtmTomActionTimeBaseSelection=TOM_ACT_TB_TBU_TS0, GtmTomActionTimeBaseValue=1
          GtmTomGlobalConf_4
            16 x GtmTomChannelConf, all with GtmTimerPortPinSelect=NONE, GtmTomChInternalTriggerEnable=false, GtmTomChResetCn0OnTriggerEnable=false:
              GtmTomChannelConf_0
              GtmTomChannelConf_1
              GtmTomChannelConf_{10..15}
              GtmTomChannelConf_{2..9}
            GtmTomGroupConf_0 (GtmTomGroupConf)
              GtmTomActionTimeBaseUnitConf: GtmTomActionTimeBaseSelection=TOM_ACT_TB_TBU_TS0, GtmTomActionTimeBaseValue=1
            GtmTomGroupConf_1 (GtmTomGroupConf)
              GtmTomActionTimeBaseUnitConf: GtmTomActionTimeBaseSelection=TOM_ACT_TB_TBU_TS0, GtmTomActionTimeBaseValue=1
          GtmTomGlobalConf_5
            16 x GtmTomChannelConf, all with GtmTimerPortPinSelect=NONE, GtmTomChInternalTriggerEnable=false, GtmTomChResetCn0OnTriggerEnable=false:
              GtmTomChannelConf_0
              GtmTomChannelConf_1
              GtmTomChannelConf_{10..15}
              GtmTomChannelConf_{2..9}
            GtmTomGroupConf_0 (GtmTomGroupConf)
              GtmTomActionTimeBaseUnitConf: GtmTomActionTimeBaseSelection=TOM_ACT_TB_TBU_TS0, GtmTomActionTimeBaseValue=1
            GtmTomGroupConf_1 (GtmTomGroupConf)
              GtmTomActionTimeBaseUnitConf: GtmTomActionTimeBaseSelection=TOM_ACT_TB_TBU_TS0, GtmTomActionTimeBaseValue=1
        12 x GtmTriggerForAdc, all with GtmAdcTrigger0Select=TRIG_0_NO_TRIGGER, GtmAdcTrigger1Select=TRIG_0_NO_TRIGGER, GtmAdcTrigger2Select=TRIG_0_NO_TRIGGER, GtmAdcTrigger3Select=TRIG_0_NO_TRIGGER, GtmAdcTrigger4Select=TRIG_0_NO_TRIGGER:
          GtmTriggerForAdc_0
          GtmTriggerForAdc_1
          GtmTriggerForAdc_10
          GtmTriggerForAdc_11
          GtmTriggerForAdc_{2..9}
        6 x GtmTriggerForDsadc, all with GtmDsadcTrigger0Select=TRIG_0_NO_TRIGGER, GtmDsadcTrigger1Select=TRIG_0_NO_TRIGGER, GtmDsadcTrigger2Select=TRIG_0_NO_TRIGGER, GtmDsadcTrigger3Select=TRIG_0_NO_TRIGGER:
          GtmTriggerForDsadc_{0..5}
        McuGtmClockManagementConf: GtmCmuGlobalClockDenominator=1, GtmCmuGlobalClockNumerator=1
          GtmConfigClockSetting:
            GtmCmuConfigClock0Div = 0
            GtmCmuConfigClock0Enable = true
            GtmCmuConfigClock1Div = 0
            GtmCmuConfigClock1Enable = true
            GtmCmuConfigClock2Div = 0
            GtmCmuConfigClock2Enable = true
            GtmCmuConfigClock3Div = 0
            GtmCmuConfigClock3Enable = true
            GtmCmuConfigClock4Div = 0
            GtmCmuConfigClock4Enable = true
            GtmCmuConfigClock5Div = 0
            GtmCmuConfigClock5Enable = true
            GtmCmuConfigClock6Div = 0
            GtmCmuConfigClock6Enable = true
            GtmCmuConfigClock7Div = 0
            GtmCmuConfigClock7Enable = true
          GtmExtClockSetting:
            GtmCmuExtClock0Denominator = 1
            GtmCmuExtClock0Enable = false
            GtmCmuExtClock0Numerator = 1
            GtmCmuExtClock1Denominator = 1
            GtmCmuExtClock1Enable = false
            GtmCmuExtClock1Numerator = 1
            GtmCmuExtClock2Denominator = 1
            GtmCmuExtClock2Enable = false
            GtmCmuExtClock2Numerator = 1
          GtmFixedClockSetting: GtmCmuFixedClockEnable=true, GtmCmuFixedClockSel=CMU_GLOBAL_CLOCK_SEL0
      McuClockSettingConfig_0 (McuClockSettingConfig): McuClockSettingId=0, McuClockStabilityWaitingTime=0.0001
        McuClockReferencePoint_CAN (McuClockReferencePoint): McuClockRefSelection=MCU_USER_DEFINED_FREQUENCY, McuClockReferencePointFrequency=20000000
        McuClockReferencePointConfig
          McuClockMonitorConfig:
            McuBackupClockMonEnable = false
            McuBackupClockRangeMonEnable = false
            McuPll{0..2}ClockMonEnable = false
            McuSpbClockMonEnable = false
          McuExternalClockOutputConfig:
            McuExtClock0Enable = false
            McuExtClock1Enable = false
            McuExtClock1Inverted = false
            McuExtClockOutSel0 = FOUT_EXT_CLOCK0_SEL0
            McuExtClockOutSel1 = FOUT_EXT_CLOCK1_SEL0
            McuFoutClockDiv = 1
          McuPeripheralPllSettingConfig:
            McuClockReferencePointFrequency1 = 160000000
            McuClockReferencePointFrequency2 = 200000000
            McuFreqSource1ClockDivSelect = DIV_FACTOR_2_BYPASSED_SEL1
            McuPerPllK2DivStepDownChangeDelay = 10
            McuPerPllK2DivStepUpChangeDelay = 10
            McuPerPllK3DivStepDownChangeDelay = 10
            McuPerPllK3DivStepUpChangeDelay = 10
            McuPeripheralPllK2Divider = 4
            McuPeripheralPllK3Divider = 1
            McuPeripheralPllNDivider = 39
            McuPeripheralPllPDivider = 0
            McuPll2DivSelect = MCU_K3_DIV_FACTOR_BYPASSED_SEL1
          McuPllDistributionSettingConfig:
            McuAdasFrequency = 300000000
            McuAdcFrequency = 160000000
            McuAscLinFastFrequency = 200000000
            McuAscLinSlowClockSourceSelection = ASCLINS_CLOCK_SOURCE_DISABLED_SEL0
            McuAscLinSlowFrequency = 80000000
            McuBBBFrequency = 150000000
            McuCPU{0..5}Frequency = 300000000
            McuClockDistributionInpClockSel = PLL_INPUT_CLOCK_SRC_SELECT_SEL1
            McuConvCtrlPhaseSynchConf = PHASE_SYNCH_CONST_ACTIVE_SEL0
            McuEbuClkEnable = false
            McuEbuFrequency = 160000000
            McuErayClkEnable = false
            McuErayFrequency = 80000000
            McuFSI2Frequency = 300000000
            McuFSIFrequency = 100000000
            McuGEthFrequency = 150000000
            McuGTMFrequency = 200000000
            McuHsctFrequency = 400000000
            McuHspdm160Frequency = 160000000
            McuHspdm320Frequency = 320000000
            McuHspdmClkEnable = false
            McuI2CFrequency = 66666667
            McuLowPowerDivValue = LOW_POWER_DIVIDER_DISABLE_SEL0
            McuMCanClockSourceSelection = MCAN_CLOCK_SOURCE_OSC_SEL2
            McuMCanFrequency = 20000000
            McuMcanHFrequency = 100000000
            McuMscClockSourceSelection = MSC_CLOCK_SOURCE_DISABLED_SEL0
            McuMscFrequency = 200000000
            McuQspiClockSourceSelection = QSPI_CLOCK_SOURCE_DISABLED_SEL0
            McuQspiFrequency = 200000000
            McuReferenceFrequency1 = 12500000
            McuReferenceFrequency2 = 6666667
            McuSPBFrequency = 100000000
            McuSRIFrequency = 300000000
            McuSTMFrequency = 100000000
          McuSystemPllSettingConfig:
            McuClockReferencePointFrequency0 = 300000000
            McuFMPllModAmp = 1.25
            McuFmPllEnable = false
            McuPllInputSrcSelection = OSC_CLOCK_SRC_SELECT_SEL1
            McuSysPllK2DivStepDownChangeDelay = 10
            McuSysPllK2DivStepUpChangeDelay = 10
            McuSystemPllK2Divider = 1
            McuSystemPllNDivider = 29
            McuSystemPllPDivider = 0
        McuSystemClockSetting
          McuCpuMainSysClk: McuClockName=CLK_CPU, McuClockValue=1400000000
        McuModuleClockSetting
          McuDebugTracePortClk: McuClockName=CLK_ZTR, McuClockSelection=PLL1CLK_DIV3_ID_1, McuClockValue=533333333.3
          McuDebugTraceBusClk: McuClockName=CLK_ZT, McuClockSelection=PLL1CLK_DIV3_ID_1, McuClockValue=533333333.3
          McuDebugClk: McuClockName=CLK_ZS, McuClockSelection=PLL1CLK_DIV6_ID_3, McuClockValue=266666666.7
          McuZR{0..2}Clk: McuClockName=CLK_CPU, McuClockDivider=0, McuClockValue=1399440000
          McuZB3Clk: McuClockName=CLK_ZB3, McuClockSelection=PLL3VCO_DIV2_ID_0, McuClockValue=799680000
          McuCA76Clk: McuClockName=CLK_Z0, McuClockDivider=0, McuClockValue=1699320000
          McuZGClk: McuClockName=CLK_ZG, McuClockDivider=16, McuClockValue=599760000
          McuSDSRCClk: McuClockName=CLK_SDSRC, McuClockSelection=PLL5VCOD2_DIV2_ID_0, McuClockValue=799680000
          McuSD0HClk: McuClockName=CLK_SD0H, McuClockCtrlSel=STOP_ID_1, McuClockSelection=CLK_SDSRC_DIV4_ID_2, McuClockValue=199920000
          McuSD0Clk: McuClockName=CLK_SD0, McuClockCtrlSel=ACTIVATE_ID_0, McuClockSelection=CLK_SD0H_DIV4_ID_1, McuClockValue=49980000
          McuRPCClk: McuClockName=CLK_RPC, McuClockCtrlSel=ACTIVATE_ID_0, McuClockSelection=PLL5VCOD5_DIV2_ID_17, McuClockValue=319872000
          McuRPCD2Clk: McuClockName=CLK_RPCD2, McuClockCtrlSel=ACTIVATE_ID_0, McuClockValue=159936000
          McuMSOClk: McuClockName=CLK_MSO, McuClockCtrlSel=ACTIVATE_ID_0, McuClockDivider=63, McuClockValue=12495000
          McuCANFDClk: McuClockName=CLK_CANFD, McuClockCtrlSel=ACTIVATE_ID_0, McuClockDivider=63, McuClockValue=12495000
          McuCSIClk: McuClockName=CLK_CSI, McuClockCtrlSel=STOP_ID_1, McuClockDivider=31, McuClockValue=24990000
          McuPOSTClk: McuClockName=CLK_POST, McuClockCtrlSel=ACTIVATE_ID_0, McuClockDivider=11, McuClockValue=66640000
          McuPOST2Clk: McuClockName=CLK_POST2, McuClockCtrlSel=ACTIVATE_ID_0, McuClockDivider=5, McuClockValue=133280000
          McuPOST3Clk: McuClockName=CLK_POST3, McuClockCtrlSel=ACTIVATE_ID_0, McuClockDivider=11, McuClockValue=66640000
          McuPOST4Clk: McuClockName=CLK_POST4, McuClockCtrlSel=ACTIVATE_ID_0, McuClockDivider=11, McuClockValue=66640000
          McuDSIEXTClk: McuClockName=CLK_DSIEXT, McuClockCtrlSel=STOP_ID_1, McuClockDivider=0, McuClockValue=799680000
          McuSASYNCRTClk: McuClockName=CLK_SASYNCRT, McuClockValue=16666667
          McuSASYNCPERD1Clk: McuClockName=CLK_SASYNCPERD1, McuClockValue=266666667
          McuSASYNCPERD2Clk: McuClockName=CLK_SASYNCPERD2, McuClockValue=133333333
          McuSASYNCPERD4Clk: McuClockName=CLK_SASYNCPERD4, McuClockValue=66666667
          McuIMPAClk: McuClockName=CLK_IMPA, McuClockSelection=PLL5_ID_0, McuClockValue=800000000
          McuZXClk: McuClockName=CLK_ZX, McuClockValue=800000000
          McuSVVIPClk: McuClockName=CLK_SV_VIP, McuClockValue=640000000
          McuSVIRClk: McuClockName=CLK_SV_IR, McuClockValue=640000000
          McuS0HSCClk: McuClockName=CLK_S0_HSC, McuClockValue=800000000
          McuS0VCClk: McuClockName=CLK_S0_VC, McuClockValue=800000000
          McuS0VIOClk: McuClockName=CLK_S0_VIO, McuClockValue=800000000
          McuIMPA1Clk: McuClockName=CLK_IMPA1, McuClockValue=800000000
          McuVCBUSClk: McuClockName=CLK_VC, McuClockValue=533330000
          McuVIOBUSClk: McuClockName=CLK_VIO, McuClockValue=533330000
          McuRCLKClk: McuClockName=CLK_RCLK, McuClockSelection=CLK_OCO, McuClockValue=32800
        McuPllClockSetting: McuMainOsc=CLOCK_FREQUENCY_16_66_MHZ
          McuPll1ClockSetting: McuPllCircuitEnable=true, McuPllFrequency=3200000000
            McuPllStopConditions:
              McuPllStopByA3IR = false
              McuPllStopBy3DGB = false
              McuPllStopByA3ISP0 = false
              McuPllStopByA3ISP1 = false
              McuPllStopByA3DUL = false
              McuPllStopByA3VIP{0..2} = false
              McuPllStopByA2E0D1 = false
              McuPllStopByA2E0D0 = false
          McuPll2ClockSetting:
            McuPllCircuitEnable = true
            McuMultiplicationRatio = 101
            McuFreqDitherMode = INTEGER_FIXED_FREQUENCY_MODE_ID_0
            McuDownSpreadModuleDepth = SSDEPT_VALUE_0
            McuFractionalMultiplication = 0
            McuSSCGModulationFreq = 0
            McuPllFrequency = 3398640000
            McuPllStopConditions:
              McuPllStopByA3IR = false
              McuPllStopBy3DGB = false
              McuPllStopByA3ISP1 = false
              McuPllStopByA3ISP0 = false
              McuPllStopByA3DUL = false
              McuPllStopByA3VIP{0..2} = false
          McuPll3ClockSetting:
            McuMultiplicationRatio = 95
            McuFreqDitherMode = INTEGER_FIXED_FREQUENCY_MODE_ID_0
            McuFractionalMultiplication = 0
            McuPllFrequency = 3198720000
            McuPllCircuitEnable = true
            McuPllStopConditions:
              McuPllStopByA3IR = false
              McuPllStopBy3DGB = false
              McuPllStopByA3ISP1 = false
              McuPllStopByA3ISP0 = false
              McuPllStopByA3DUL = false
              McuPllStopByA3VIP{0..2} = false
              McuPllStopByA2E0D1 = false
              McuPllStopByA2E0D0 = false
          McuPll4ClockSetting:
            McuPllCircuitEnable = true
            McuMultiplicationRatio = 71
            McuFreqDitherMode = INTEGER_FIXED_FREQUENCY_MODE_ID_0
            McuDownSpreadModuleDepth = SSDEPT_VALUE_0
            McuFractionalMultiplication = 0
            McuSSCGModulationFreq = 0
            McuPllFrequency = 2399040000
            McuPllStopConditions:
              McuPllStopByA3IR = false
              McuPllStopBy3DGB = false
              McuPllStopByA3ISP1 = false
              McuPllStopByA3ISP0 = false
              McuPllStopByA3DUL = false
              McuPllStopByA3VIP{0..2} = false
              McuPllStopByA2E0D1 = false
              McuPllStopByA2E0D0 = false
          McuPll5ClockSetting: McuPllCircuitEnable=true, McuPllFrequency=3198720000, McuMultiplicationRatio=95, McuFreqDitherMode=INTEGER_FIXED_FREQUENCY_MODE_ID_0
            McuPllStopConditions:
              McuPllStopByA3IR = false
              McuPllStopBy3DGB = false
              McuPllStopByA3ISP1 = false
              McuPllStopByA3ISP0 = false
              McuPllStopByA3DUL = false
              McuPllStopByA3VIP{0..2} = false
              McuPllStopByA2E0D1 = false
              McuPllStopByA2E0D0 = false
          McuPll6ClockSetting:
            McuPllCircuitEnable = true
            McuMultiplicationRatio = 83
            McuFreqDitherMode = INTEGER_FIXED_FREQUENCY_MODE_ID_0
            McuDownSpreadModuleDepth = SSDEPT_VALUE_0
            McuFractionalMultiplication = 0
            McuSSCGModulationFreq = 0
            McuPllFrequency = 2798880000
            McuPllStopConditions:
              McuPllStopByA3IR = false
              McuPllStopBy3DGB = false
              McuPllStopByA3ISP1 = false
              McuPllStopByA3ISP0 = false
              McuPllStopByA3DUL = false
              McuPllStopByA3VIP{0..2} = false
              McuPllStopByA2E0D1 = false
              McuPllStopByA2E0D0 = false
        McuModuleClockSupplySetting:
          McuIMPPSCClockSupplyEnable = true
          McuIMPDMAC0ClockSupplyEnable = true
          McuIMP1ClockSupplyEnable = true
          McuIMP0ClockSupplyEnable = true
          McuSPMCClockSupplyEnable = true
          McuIMPCNNClockSupplyEnable = true
          McuISP1ClockSupplyEnable = false
          McuISP0ClockSupplyEnable = false
          McuUMFL0ClockSupplyEnable = false
          McuSMPS0ClockSupplyEnable = false
          McuSMPO0ClockSupplyEnable = false
          McuRGXClockSupplyEnable = true
          McuADGClockSupplyEnable = false
          McuSPMIClockSupplyEnable = true
          McuIMPSLVClockSupplyEnable = true
          McuIMPDTAClockSupplyEnable = true
          McuIMPDMAC1ClockSupplyEnable = true
          McuIMP3ClockSupplyEnable = true
          McuIMP2ClockSupplyEnable = true
          McuAVB2ClockSupplyEnable = false
          McuAVB1ClockSupplyEnable = false
          McuAVB0ClockSupplyEnable = false
          McuCSITOP0ClockSupplyEnable = false
          McuCANFDClockSupplyEnable = false
          McuDSITXLINK1ClockSupplyEnable = true
          McuDSITXLINK0ClockSupplyEnable = true
          McuDOC2CHClockSupplyEnable = true
          McuDIS0ClockSupplyEnable = true
          McuCSITOP1ClockSupplyEnable = true
          McuIMS1ClockSupplyEnable = false
          McuIMS0ClockSupplyEnable = false
          McuIMR2ClockSupplyEnable = false
          McuIMR1ClockSupplyEnable = false
          McuIMR0ClockSupplyEnable = false
          McuFRAY00ClockSupplyEnable = true
          McuFCPVD1ClockSupplyEnable = false
          McuFCPVD0ClockSupplyEnable = false
          McuFCPCSClockSupplyEnable = true
          McuPWMClockSupplyEnable = true
          McuMSI5ClockSupplyEnable = true
          McuMSI4ClockSupplyEnable = true
          McuIVCP1EClockSupplyEnable = false
          McuISPCS1ClockSupplyEnable = false
          McuISPCS0ClockSupplyEnable = false
          McuINTTPClockSupplyEnable = true
          McuIPCClockSupplyEnable = false
          McuVIN01ClockSupplyEnable = false
          McuVIN00ClockSupplyEnable = false
          McuVCPL4ClockSupplyEnable = false
          McuTPU0ClockSupplyEnable = false
          McuVSPD1ClockSupplyEnable = false
          McuVSPD0ClockSupplyEnable = false
          McuVIN17ClockSupplyEnable = false
          McuVIN16ClockSupplyEnable = false
          McuVIN15ClockSupplyEnable = false
          McuVIN14ClockSupplyEnable = false
          McuVIN13ClockSupplyEnable = false
          McuVIN12ClockSupplyEnable = false
          McuVIN11ClockSupplyEnable = false
          McuVIN10ClockSupplyEnable = false
          McuVIN07ClockSupplyEnable = false
          McuVIN06ClockSupplyEnable = false
          McuVIN05ClockSupplyEnable = false
          McuVIN04ClockSupplyEnable = false
          McuVIN03ClockSupplyEnable = false
          McuVIN02ClockSupplyEnable = false
          McuPFC3ClockSupplyEnable = true
          McuPFC2ClockSupplyEnable = true
          McuPFC1ClockSupplyEnable = true
          McuVSPX1ClockSupplyEnable = false
          McuVSPX0ClockSupplyEnable = false
          McuFCPVX1ClockSupplyEnable = false
          McuFCPVX0ClockSupplyEnable = false
          McuMTIClockSupplyEnable = false
          McuCSBRGIRA2ClockSupplyEnable = true
          McuCSBRGIRA3ClockSupplyEnable = true
          McuTSNClockSupplyEnable = false
          McuIMPSDMAC1ClockSupplyEnable = true
          McuIMPSDMAC0ClockSupplyEnable = true
          McuCVE3ClockSupplyEnable = true
          McuCVE2ClockSupplyEnable = true
          McuCVE1ClockSupplyEnable = true
          McuCVE0ClockSupplyEnable = true
          McuDSCClockSupplyEnable = false
          McuFCPRCClockSupplyEnable = false
          McuSSIClockSupplyEnable = false
          McuSSIUClockSupplyEnable = false
          McuADVFSCClockSupplyEnable = false
          McuCR0ClockSupplyEnable = true
          McuINTAPClockSupplyEnable = true
          McuI2C5ClockSupplyEnable = true
          McuI2C4ClockSupplyEnable = true
          McuI2C3ClockSupplyEnable = true
          McuI2C2ClockSupplyEnable = true
          McuI2C1ClockSupplyEnable = true
          McuI2C0ClockSupplyEnable = true
          McuHSCIF3ClockSupplyEnable = false
          McuHSCIF2ClockSupplyEnable = false
          McuHSCIF1ClockSupplyEnable = false
          McuHSCIF0ClockSupplyEnable = false
          McuRTDM1ClockSupplyEnable = true
          McuRTDM0ClockSupplyEnable = true
          McuRPCClockSupplyEnable = true
          McuPCIE1ClockSupplyEnable = false
          McuPCIE0ClockSupplyEnable = false
          McuMSI3ClockSupplyEnable = true
          McuMSI2ClockSupplyEnable = true
          McuMSI1ClockSupplyEnable = true
          McuMSI0ClockSupplyEnable = true
          McuIRQCClockSupplyEnable = true
          McuTMU4ClockSupplyEnable = false
          McuTMU3ClockSupplyEnable = false
          McuTMU2ClockSupplyEnable = false
          McuTMU1ClockSupplyEnable = false
          McuTMU0ClockSupplyEnable = false
          McuSYDM2ClockSupplyEnable = true
          McuSYDM1ClockSupplyEnable = true
          McuSECROMClockSupplyEnable = true
          McuSDHI0ClockSupplyEnable = true
          McuSCIF4ClockSupplyEnable = false
          McuSCIF3ClockSupplyEnable = true
          McuSCIF1ClockSupplyEnable = true
          McuSCIF0ClockSupplyEnable = true
          McuRTDM3ClockSupplyEnable = true
          McuRTDM2ClockSupplyEnable = true
          McuUCMTClockSupplyEnable = true
          McuPFC0ClockSupplyEnable = true
          McuCMT3ClockSupplyEnable = false
          McuCMT2ClockSupplyEnable = false
          McuCMT1ClockSupplyEnable = false
          McuCMT0ClockSupplyEnable = false
          McuWDTClockSupplyEnable = true
          McuWCRC3ClockSupplyEnable = false
          McuWCRC2ClockSupplyEnable = false
          McuWCRC1ClockSupplyEnable = false
          McuWCRC0ClockSupplyEnable = false
          McuKCRC4ClockSupplyEnable = false
          McuFSOClockSupplyEnable = true
          McuCRC3ClockSupplyEnable = false
          McuCRC2ClockSupplyEnable = false
          McuCRC1ClockSupplyEnable = false
          McuCRC0ClockSupplyEnable = false
          McuADVFSClockSupplyEnable = false
          McuKCRC7ClockSupplyEnable = false
          McuKCRC6ClockSupplyEnable = false
          McuKCRC5ClockSupplyEnable = false
          McuAESACCWrapperClockSupplyEnable = false
          McuAESACC{0..7}ClockSupplyEnable = false
          McuPAPDEBUGClockSupplyEnable = true
          McuTSCClockSupplyEnable = true
          McuLPDDRMSTPCR4b09ClockSupplyEnable = true
          McuLPDDRMSTPCR4b10ClockSupplyEnable = true
          McuVDSP1MSTPCR28b31ClockSupplyEnable = true
          McuVDSP1MSTPCR28b30ClockSupplyEnable = true
          McuVDSP0MSTPCR28b28ClockSupplyEnable = true
          McuVDSP0MSTPCR28b27ClockSupplyEnable = true
          McuVDSP0MSTPCR28b26ClockSupplyEnable = true
          McuVDSP0MSTPCR28b25ClockSupplyEnable = true
          McuVDSP0MSTPCR28b24ClockSupplyEnable = true
          McuVDSP0MSTPCR28b23ClockSupplyEnable = true
          McuVDSP0MSTPCR28b22ClockSupplyEnable = true
          McuVDSP0MSTPCR28b21ClockSupplyEnable = true
          McuPAPSDMACClockSupplyEnable = true
          McuPAPTOPClockSupplyEnable = true
          McuPAPBUSClockSupplyEnable = true
          McuVDSP3MSTPCR28b04ClockSupplyEnable = true
          McuVDSP2MSTPCR28b03ClockSupplyEnable = true
          McuVDSP1MSTPCR28b02ClockSupplyEnable = true
          McuVDSP0MSTPCR28b01ClockSupplyEnable = true
          McuVDSP3MSTPCR29b23ClockSupplyEnable = true
          McuVDSP3MSTPCR29b22ClockSupplyEnable = true
          McuVDSP3MSTPCR29b21ClockSupplyEnable = true
          McuVDSP3MSTPCR29b20ClockSupplyEnable = true
          McuVDSP3MSTPCR29b19ClockSupplyEnable = true
          McuVDSP3MSTPCR29b18ClockSupplyEnable = true
          McuVDSP3MSTPCR29b17ClockSupplyEnable = true
          McuVDSP3MSTPCR29b16ClockSupplyEnable = true
          McuVDSP2MSTPCR29b14ClockSupplyEnable = true
          McuVDSP2MSTPCR29b13ClockSupplyEnable = true
          McuVDSP2MSTPCR29b12ClockSupplyEnable = true
          McuVDSP2MSTPCR29b11ClockSupplyEnable = true
          McuVDSP2MSTPCR29b10ClockSupplyEnable = true
          McuVDSP2MSTPCR29b09ClockSupplyEnable = true
          McuVDSP2MSTPCR29b08ClockSupplyEnable = true
          McuVDSP2MSTPCR29b07ClockSupplyEnable = true
          McuVDSP1MSTPCR29b05ClockSupplyEnable = true
          McuVDSP1MSTPCR29b04ClockSupplyEnable = true
          McuVDSP1MSTPCR29b03ClockSupplyEnable = true
          McuVDSP1MSTPCR29b02ClockSupplyEnable = true
          McuVDSP1MSTPCR29b01ClockSupplyEnable = true
          McuVDSP1MSTPCR29b00ClockSupplyEnable = true
      McuEruGlobalConf: McuEruInputFilterRegVal=0
      McuGpt12PrescalerConf: Gpt1BlockPrescalerSel=GPT1_BLOCK_NOT_USED, Gpt2BlockPrescalerSel=GPT2_BLOCK_NOT_USED
      McuModeSettingConf_0 (McuModeSettingConf): McuEvrcLPMOnSleepReqEnable=false, McuMode=0, McuModeType=MCU_RUN_MODE
        McuStdbyModeSettingConf:
          McuStdbyModeBlankingFilterDelay = DELAY_0_MS_SEL0
          McuStdbyModeClkSelection = SCR_CLOCK_SEL0
          McuStdbyModeESR0TriStateEnable = false
          McuStdbyModePORSTFilterEnable = false
          McuStdbyModePortTriStateEnable = false
          McuStdbyModeRamEnable = MCU_STANDBYRAM_DISABLED_SEL0
          McuStdbyModeWakeupFromEVR = false
          McuStdbyModeWakeupFromPORST = false
          McuStdbyModeWakeupFromSCR = false
          McuStdbyModeESR0Conf: McuStdbyModeESR0EdgeDetection=ESR0_TRIG_RISING_EDGE_SEL1, McuStdbyModeESR0FltEnable=false, McuStdbyModeESR0WakeupEnable=false
          McuStdbyModeESR1Conf: McuStdbyModeESR1EdgeDetection=ESR1_TRIG_RISING_EDGE_SEL1, McuStdbyModeESR1FltEnable=false, McuStdbyModeESR1WakeupEnable=false
          McuStdbyModePinAConf: McuStdbyModePinAEdgeDetection=PINA_TRIG_RISING_EDGE_SEL1, McuStdbyModePinAFltEnable=false, McuStdbyModePinAWakeupEnable=false
          McuStdbyModePinBConf: McuStdbyModePinBEdgeDetection=PINB_TRIG_RISING_EDGE_SEL1, McuStdbyModePinBFltEnable=false, McuStdbyModePinBWakeupEnable=false
          McuStdbyModeVddVextConf:
            McuStdbyModeEntryOnVDDRampDown = false
            McuStdbyModeEntryOnVEXTRampDown = false
            McuStdbyModeVddUMMonMode = VDD_UV_MON_MODE_SEL2
            McuStdbyModeVddUVThres = 184
            McuStdbyModeVextUMMonMode = VEXT_UV_MON_MODE_SEL2
            McuStdbyModeVextUVThres = 117
          McuStdbyModeWakeupTimerConf:
            McuStdbyModeWakeupTimerClkDiv = WUT_70KHZ_NO_DIV_CLK_SEL0
            McuStdbyModeWakeupTimerEnable = false
            McuStdbyModeWakeupTimerMode = WUT_AUTO_RELOAD_MODE_SEL0
            McuStdbyModeWakeupTimerValue = 16777215
      McuResetSettingConf:
        McuESR0ResetConf = MCU_ESR0_NO_RESET_SEL0
        McuESR1ResetConf = MCU_ESR1_NO_RESET_SEL0
        McuSMUResetConf = MCU_SMU_NO_RESET_SEL0
        McuSTM0ResetConf = MCU_STM0_NO_RESET_SEL0
        McuSTM0ResetOnApplResetEnable = true
        McuSTM1ResetConf = MCU_STM1_NO_RESET_SEL0
        McuSTM1ResetOnApplResetEnable = true
        McuSTM2ResetConf = MCU_STM2_NO_RESET_SEL0
        McuSTM2ResetOnApplResetEnable = true
        McuSTM3ResetConf = MCU_STM3_NO_RESET_SEL0
        McuSTM3ResetOnApplResetEnable = true
        McuSTM4ResetConf = MCU_STM4_NO_RESET_SEL0
        McuSTM4ResetOnApplResetEnable = true
        McuSTM5ResetConf = MCU_STM5_NO_RESET_SEL0
        McuSTM5ResetOnApplResetEnable = true
        McuSWResetConf = MCU_SW_NO_RESET_SEL0
      McuTrapSettingConf:
        McuCPU0ESR0TrapEnable = false
        McuCPU0ESR1TrapEnable = false
        McuCPU0SMUTrapEnable = false
        McuCPU0Trap2Enable = false
        McuCPU1ESR0TrapEnable = false
        McuCPU1ESR1TrapEnable = false
        McuCPU1SMUTrapEnable = false
        McuCPU1Trap2Enable = false
        McuCPU2ESR0TrapEnable = false
        McuCPU2ESR1TrapEnable = false
        McuCPU2SMUTrapEnable = false
        McuCPU2Trap2Enable = false
        McuCPU3ESR0TrapEnable = false
        McuCPU3ESR1TrapEnable = false
        McuCPU3SMUTrapEnable = false
        McuCPU3Trap2Enable = false
        McuCPU4ESR0TrapEnable = false
        McuCPU4ESR1TrapEnable = false
        McuCPU4SMUTrapEnable = false
        McuCPU4Trap2Enable = false
        McuCPU5ESR0TrapEnable = false
        McuCPU5ESR1TrapEnable = false
        McuCPU5SMUTrapEnable = false
        McuCPU5Trap2Enable = false
    McuPublishedInformation
      21 x McuResetReasonConf:
        MCU_CB0_RESET: McuResetReason=11
        MCU_CB1_RESET: McuResetReason=12
        MCU_CB3_RESET: McuResetReason=13
        MCU_ESR0_RESET: McuResetReason=0
        MCU_ESR1_RESET: McuResetReason=1
        MCU_EVR33_RESET: McuResetReason=15
        MCU_EVRC_RESET: McuResetReason=14
        MCU_LBIST_RESET: McuResetReason=18
        MCU_POWER_ON_RESET: McuResetReason=10
        MCU_RESET_MULTIPLE: McuResetReason=254
        MCU_RESET_UNDEFINED: McuResetReason=255
        MCU_SMU_RESET: McuResetReason=2
        MCU_STBYR_RESET: McuResetReason=17
        MCU_STM0_RESET: McuResetReason=4
        MCU_STM1_RESET: McuResetReason=5
        MCU_STM2_RESET: McuResetReason=6
        MCU_STM3_RESET: McuResetReason=7
        MCU_STM4_RESET: McuResetReason=8
        MCU_STM5_RESET: McuResetReason=9
        MCU_SUPPLY_WDOG_RESET: McuResetReason=16
        MCU_SW_RESET: McuResetReason=3
      McuPowerOnResetConf: McuResetReason=0
      McuSWDTResetConf: McuResetReason=2
      McuRWDTResetConf: McuResetReason=1
      McuMultiResetConf: McuResetReason=5
      McuResetUndefinedConf: McuResetReason=7
      McuNoneResetConf: McuResetReason=6
      McuSwResetConf: McuResetReason=3
