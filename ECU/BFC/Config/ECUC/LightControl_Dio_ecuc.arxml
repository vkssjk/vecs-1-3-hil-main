AUTOSAR XML (schema 00049)
package /ActiveEcuC
  module config Dio: implementation-config-variant=VARIANT-LINK-TIME, module-description=Dio_Impl
    DioConfig
      DioPort: DioPortId=33, DioPortName=GPIO_0_BITS_00_TO_18
        DioChannel_Output_HeadLight (DioChannel): DioChannelId=11, DioChannelBitPosition=0
    DioGeneral:
      DioDevErrorDetect = false
      DioFlipChannelApi = false
      DioMaskedWritePortApi = false
      DioVersionInfoApi = false
      DioSafetyEnable = false
      DioCriticalSectionProtection = true
      DioDeviceName = V4H
      DioReadChannelGroupOutputValueApi = true
      DioReadChannelOutputValueApi = true
      DioVersionCheckExternalModules = true
      DioExclusiveControl = true
      DioExclusiveTimeout = 256410
      DioExclusiveSelection = MFISLCKR1
    CommonPublishedInformation:
      ArMajorVersion = 4
      ArMinorVersion = 4
      ArPatchVersion = 0
      SwMajorVersion = 20
      SwMinorVersion = 25
      SwPatchVersion = 0
      ModuleId = 120
      VendorId = 17
      Release = _TRICORE_TC397_ADAS
