AUTOSAR XML (schema 00049)
package /ActiveEcuC
  module config VTTFls: implementation-config-variant=VARIANT-PRE-COMPILE, module-description=VTTFls_Impl
    FlsGeneral:
      FlsBaseAddress = 2936012800
      FlsCancelApi = false
      FlsCompareApi = false
      FlsDevErrorDetect = false
      FlsDriverIndex = 0
      FlsGetJobResultApi = false
      FlsGetStatusApi = false
      FlsSetModeApi = true
      FlsTotalSize = 1048576
      FlsVersionInfoApi = false
      FlsSafeBswChecks = false
      FlsAcLoadOnJobStart = false
      FlsUseInterrupts = false
    FlsPublishedInformation:
      FlsErasedValue = 255
      FlsSpecifiedEraseCycles = 125000
      FlsAcLocationErase = 0
      FlsAcSizeErase = 0
      FlsAcSizeWrite = 0
      FlsEraseTime = 1897500
      FlsExpectedHwId = 0
      FlsAcLocationWrite = 0
      FlsWriteTime = 5154
    FlsConfigSet:
      FlsCallCycle = 0.01
      FlsDefaultMode = MEMIF_MODE_SLOW
      FlsMaxReadFastMode = 64
      FlsMaxReadNormalMode = 32
      FlsMaxWriteFastMode = 32
      FlsMaxWriteNormalMode = 32
      FlsAcWrite = 0
      FlsJobErrorNotification = Fee_JobErrorNotification
      FlsProtection = 0
      FlsJobEndNotification = Fee_JobEndNotification
      FlsAcErase = 0
      FlsSectorList
        FlsSector: FlsNumberOfSectors=2, FlsPageSize=8, FlsSectorSize=524288, FlsSectorStartaddress=0
