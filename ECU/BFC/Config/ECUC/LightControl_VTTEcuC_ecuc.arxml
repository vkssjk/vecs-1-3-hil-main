AUTOSAR XML (schema 00049)
package /ActiveEcuC
  module config VTTEcuC: implementation-config-variant=VARIANT-PRE-COMPILE, module-description=VTTEcuC_Impl
    EcucGeneral:
      BitFieldDataType = INT
      BitOrder = LSB_to_MSB
      EcucBswImplementationCodeType = EcuCSourceCode
      SizeOfEnum = Size32Bit
      SizeOfRAMPointer = Size32Bit
      SizeOfROMPointer = Size32Bit
      ByteOrder = LITTLE_ENDIAN
      AtomicBitAccessInBitfield = false
      AtomicVariableAccess = Atomic32BitAccess
      CPUType = CPU32Bit
      SizeOfInt = Size32Bit
      StructAlignment = Auto
      ArrayAlignment = Auto
      StructInArrayAlignment = Auto
      DummyFunction = false
      DummyStatement = false
      ConditionalGenerating = true
      EcuCUseStdReturnTypeForRte = false
      DummyStatementKind = None
    EcucHardware
      EcucCoreDefinition: EcucCoreId=0
