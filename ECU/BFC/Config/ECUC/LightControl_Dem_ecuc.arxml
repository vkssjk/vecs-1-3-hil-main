AUTOSAR XML (schema 00049)
package /ActiveEcuC
  module config Dem: implementation-config-variant=VARIANT-PRE-COMPILE, module-description=Dem_Impl
    DemGeneral:
      DemOBDSupport = DEM_OBD_NO_OBD_SUPPORT
      DemAgingCycleCounterProcessing = DEM_PROCESS_AGINGCTR_INTERN
      DemDebounceCounterBasedSupport = true
      DemPTOSupport = false
      DemDtcStatusAvailabilityMask = 255
      DemGeneralInterfaceSupport = false
      DemDataElementDefaultEndianness = LITTLE_ENDIAN
      DemAgingRequieresTestedCycle = false
      DemMaxNumberEventEntryMirror = 0
      DemTriggerMonitorInitBeforeClearOk = true
      DemExtendedDataCapture = DEM_TRIGGER_EVENT_MEMORY_STORAGE
      DemFreezeFrameCapture = DEM_TRIGGER_EVENT_MEMORY_STORAGE
      DemOperationCycleProcessing = DEM_PROCESS_OPCYC_STATE
      DemAvailabilitySupport = DEM_EVENT_AVAILABILITY
      DemAvailabilityStorage = false
      DemBswErrorBufferSize = 0
      DemClearDTCBehavior = DEM_CLRRESP_NONVOLATILE_FINISH
      DemClearDTCLimitation = DEM_ALL_SUPPORTED_DTCS
      DemDebounceTimeBasedSupport = false
      DemDevErrorDetect = true
      DemEnableConditionSupport = false
      DemEventCombinationSupport = DEM_EVCOMB_DISABLED
      DemEventDisplacementStrategy = DEM_DISPLACEMENT_LEGACY_403
      DemMaxNumberEventEntryOBDFreezeFrame = 0
      DemMaxNumberEventEntryPermanent = 0
      DemMaxNumberPrestoredFF = 0
      DemOccurrenceCounterProcessing = DEM_PROCESS_OCCCTR_TF
      DemOperationCycleStatusStorage = false
      DemResetConfirmedBitOnOverflow = false
      DemStatusBitHandlingTestFailedSinceLastClear = DEM_STATUS_BIT_NORMAL
      DemStatusBitStorageTestFailed = true
      DemStorageConditionSupport = false
      DemSuppressionSupport = DEM_NO_SUPPRESSION
      DemTaskTime = 0.01
      DemTriggerDcmReports = false
      DemTriggerDltReports = false
      DemTriggerFiMReports = false
      DemTriggerFiMReportsExtended = false
      DemTriggerMonitorInitForEnableConditions = false
      DemTypeOfDTCSupported = DEM_DTC_TRANSLATION_ISO14229_1
      DemVersionInfoApi = false
      DemBswApiVersion = DEM_BSW_API_4_XX_XX
      DemBswApiVersionNvM = DEM_BSW_API_4_XX_XX
      DemBswApiVersionFiM = DEM_BSW_API_4_XX_XX
      DemAgingAfterHealing = DEM_AGING_WHILE_HEALING
      DemAgingBehavior = DEM_AGING_TYPE_1
      DemAgingCounterBehavior = DEM_AGING_COUNT_ALWAYS
      DemAgingCounterReporting = DEM_AGING_NORMAL_REPORTING
      DemAgingRetainEnvironmentalData = true
      DemCompiledPostbuildCrc = 3059659263
      DemCompiledPostbuildCrcMode = DEM_POSTBUILD_CRC_AUTOMATIC
      DemEventDisplacementFallbackStrategy = DEM_FALLBACK_DISCARD_NEW_EVENT
      DemGeneralDiagnosticInfoSupport = true
      DemJ1939Support = false
      DemNvSynchronizeSupport = false
      DemPendingDtcProcessing = DEM_PROCESS_PDTC_ALL_DTC
      DemResetDebounceBehavior = DEM_RESET_DEBOUNCE_ON_DISABLE_ENABLE_CONDITIONS
      DemResetTestFailedOnOperationCycleStart = false
      DemRetryStorageSupport = false
      DemSafeBswChecks = false
      DemUseMemcopyMacros = false
      DemUseRte = true
      DemUserControlledWirBehavior = DEM_DISABLED_DURING_CONTROLDTCSETTING
      DemUserDefinedCompareAndSwap = false
      DemWarningIndicatorRequestedProcessing = DEM_PROCESS_WIR_ALL_DTC
      DemUseMultiPartitionFiM = false
      DemReportSuppressedDTCsInService19x0A = false
      DemSupportAgingForAllDTCs = false
      DemLatchTestFailedBehavior = DEM_LATCH_TF_CONFIRMED_AND_THIS_CYCLE
      DemSupportService19x04DIDLength = false
      DemSupportStorageIndependentCycleCounters = false
      DemUseNvm = false
      DemDcmSupport = true
      DemClearEventsWithoutDTCEventMemoryRef = PrimaryMemory
      DemOperationCycle: DemOperationCycleType=DEM_OPCYC_OTHER, DemOperationCycleAutomaticEnd=false, DemOperationCycleAutostart=false
      DemPostbuild:
        DemEventAvailableDefaultSupport = true
        DemMaxSizeFreezeFrame = 0
        DemMaxNumberDtr = 0
        DemMaxSizeGlobalFreezeFrame = 0
        DemMaxSizeOBDonUDSFreezeFrame = 0
        DemMaxNumberEventsWithMonitorActivityData = 0
        DemMaxNumberEventsPtoTimer = 0
      4 x DemGroupOfDTC:
        DEM_DTC_GROUP_POWERTRAIN_DTCS: DemGroupDTCs=1
        DEM_DTC_GROUP_CHASSIS_DTCS: DemGroupDTCs=4194304
        DEM_DTC_GROUP_BODY_DTCS: DemGroupDTCs=8388608
        DEM_DTC_GROUP_NETWORK_COM_DTCS: DemGroupDTCs=12582912
      DemEventMemorySet
        PrimaryMemory (DemPrimaryMemory):
          DemTypeOfFreezeFrameRecordNumeration = DEM_FF_RECNUM_CONFIGURED
          DemMaxNumberEventEntryPrimary = 8
          DemEventMemoryEntryStorageTrigger = DEM_STORAGE_ON_TEST_FAILED
          DemMaxNumberTimeSeriesSnapshots = 0
          DemTimeSeriesSnapshotFifoSupport = false
          DemMaxNumberCustomTriggeredSnapshots = 0
      OccurrenceCounter (DemExtendedDataRecordClass):
        DemExtendedDataRecordNumber = 1
        DemExtendedDataRecordTrigger = DEM_TRIGGER_ON_TEST_FAILED
        DemExtendedDataRecordUpdate = DEM_UPDATE_RECORD_NO
        DemDataClassRef = OccurrenceCounter_Occurrence_Counter
      WarmUpCycle (DemOperationCycle): DemOperationCycleType=DEM_OPCYC_WARMUP, DemOperationCycleAutomaticEnd=false, DemOperationCycleAutostart=false
      IgnitionCycle (DemOperationCycle): DemOperationCycleType=DEM_OPCYC_IGNITION, DemOperationCycleAutomaticEnd=false, DemOperationCycleAutostart=false
      OccurrenceCounter_Occurrence_Counter (DemDataClass): DemDataElementDataSize=1, DemDataElementInternalData=DEM_OCCCTR, DemDataElementUsePort=USE_DATA_INTERNAL, DemDataElementStoreNonVolatile=true
      ExtendedDataClass_83dcefb7 (DemExtendedDataClass): DemExtendedDataRecordClassRef=OccurrenceCounter
      DID_0xF412 (DemDidClass): DemDidIdentifier=62482, DemDidDataClassRef=PID_0x12_DID_Data
      PID_0x12_DID_Data (DemDataClass):
        DemDataElementDataSize = 2
        DemDataElementDataType = UINT16
        DemDataElementEndianness = BIG_ENDIAN
        DemDataElementUsePort = USE_DATA_CLIENT_SERVER_PORT
        DemDataElementStoreNonVolatile = true
      DID_0xF413 (DemDidClass): DemDidIdentifier=62483, DemDidDataClassRef=PID_0x13_DID_Data
      DID_0x1_DID_Data_GlobalTime (DemDataClass):
        DemDataElementDataSize = 6
        DemDataElementDataType = UINT8_N
        DemDataElementEndianness = opaque
        DemDataElementUsePort = USE_DATA_CLIENT_SERVER_PORT
        DemDataElementStoreNonVolatile = true
      OBDDrivingCycle (DemOperationCycle): DemOperationCycleType=DEM_OPCYC_OBD_DCY, DemOperationCycleAutomaticEnd=false, DemOperationCycleAutostart=false
      FreezeFrameClass_7d61125a (DemFreezeFrameClass): DemDidClassRef=Example_ReadOnlyDID
      Example_ReadOnlyDID (DemDidClass): DemDidIdentifier=1, DemDidDataClassRef=DID_0x1_DID_Data_GlobalTime
      WarningIndicator (DemIndicator): DemIndicatorID=0
      FreezeFrameClass_89a2d1a5 (DemFreezeFrameClass): DemDidClassRef=Example_ReadOnlyDID, DemDidClassRef=DID_0xF412, DemDidClassRef=DID_0xF413
      PowerCycle (DemOperationCycle): DemOperationCycleType=DEM_OPCYC_POWER, DemOperationCycleAutomaticEnd=false, DemOperationCycleAutostart=false
      PID_0x13_DID_Data (DemDataClass):
        DemDataElementDataSize = 2
        DemDataElementDataType = UINT16
        DemDataElementEndianness = BIG_ENDIAN
        DemDataElementUsePort = USE_DATA_CLIENT_SERVER_PORT
        DemDataElementStoreNonVolatile = true
      DemClient: DemClientId=0
    DemConfigSet
      9 x DemEventParameter, all with DemEventAvailable=true, DemEventAvailableInVariant=true, DemEventLatchTestFailed=false, DemEventCreateInfoPort=true:
        CAN_E_TIMEOUT: DemEventId=1, DemEventKind=DEM_EVENT_KIND_BSW
          DemEventClass:
            DemAgingAllowed = false
            DemConsiderPtoStatus = false
            DemEventOBDReadinessGroup = DEM_OBD_RDY_NONE
            DemEventPriority = 2
            DemFFPrestorageSupported = false
            DemOperationCycleRef = DemOperationCycle
          DemDebounceAlgorithmClass
            DemDebounceCounterBased: DemDebounceCounterBasedClassRef=DemCounterBasedDebounceClass_Of_CAN_E_TIMEOUT
        NVM_REQ_FAILED: DemEventId=5, DemEventKind=DEM_EVENT_KIND_BSW
          DemEventClass:
            DemAgingAllowed = false
            DemConsiderPtoStatus = false
            DemEventOBDReadinessGroup = DEM_OBD_RDY_NONE
            DemEventPriority = 2
            DemFFPrestorageSupported = false
            DemOperationCycleRef = DemOperationCycle
          DemDebounceAlgorithmClass
            DemDebounceCounterBased: DemDebounceCounterBasedClassRef=DemCounterBasedDebounceClass_Of_NVM_REQ_FAILED
        NVM_INTEGRITY_FAILED: DemEventId=2, DemEventKind=DEM_EVENT_KIND_BSW
          DemEventClass:
            DemAgingAllowed = false
            DemConsiderPtoStatus = false
            DemEventOBDReadinessGroup = DEM_OBD_RDY_NONE
            DemEventPriority = 2
            DemFFPrestorageSupported = false
            DemOperationCycleRef = DemOperationCycle
          DemDebounceAlgorithmClass
            DemDebounceCounterBased: DemDebounceCounterBasedClassRef=DemCounterBasedDebounceClass_Of_NVM_INTEGRITY_FAILED
        NVM_LOSS_OF_REDUNDANCY: DemEventId=3, DemEventKind=DEM_EVENT_KIND_BSW
          DemEventClass:
            DemAgingAllowed = false
            DemConsiderPtoStatus = false
            DemEventOBDReadinessGroup = DEM_OBD_RDY_NONE
            DemEventPriority = 2
            DemFFPrestorageSupported = false
            DemOperationCycleRef = DemOperationCycle
          DemDebounceAlgorithmClass
            DemDebounceCounterBased: DemDebounceCounterBasedClassRef=DemCounterBasedDebounceClass_Of_NVM_LOSS_OF_REDUNDANCY
        NVM_QUEUE_OVERFLOW: DemEventId=4, DemEventKind=DEM_EVENT_KIND_BSW
          DemEventClass:
            DemAgingAllowed = false
            DemConsiderPtoStatus = false
            DemEventOBDReadinessGroup = DEM_OBD_RDY_NONE
            DemEventPriority = 2
            DemFFPrestorageSupported = false
            DemOperationCycleRef = DemOperationCycle
          DemDebounceAlgorithmClass
            DemDebounceCounterBased: DemDebounceCounterBasedClassRef=DemCounterBasedDebounceClass_Of_NVM_QUEUE_OVERFLOW
        NVM_WRITE_PROTECTED: DemEventId=7, DemEventKind=DEM_EVENT_KIND_BSW
          DemEventClass:
            DemAgingAllowed = false
            DemConsiderPtoStatus = false
            DemEventOBDReadinessGroup = DEM_OBD_RDY_NONE
            DemEventPriority = 2
            DemFFPrestorageSupported = false
            DemOperationCycleRef = DemOperationCycle
          DemDebounceAlgorithmClass
            DemDebounceCounterBased: DemDebounceCounterBasedClassRef=DemCounterBasedDebounceClass_Of_NVM_WRITE_PROTECTED
        NVM_VERIFY_FAILED: DemEventId=6, DemEventKind=DEM_EVENT_KIND_BSW
          DemEventClass:
            DemAgingAllowed = false
            DemConsiderPtoStatus = false
            DemEventOBDReadinessGroup = DEM_OBD_RDY_NONE
            DemEventPriority = 2
            DemFFPrestorageSupported = false
            DemOperationCycleRef = DemOperationCycle
          DemDebounceAlgorithmClass
            DemDebounceCounterBased: DemDebounceCounterBasedClassRef=DemCounterBasedDebounceClass_Of_NVM_VERIFY_FAILED
        NVM_WRONG_BLOCK_ID: DemEventId=8, DemEventKind=DEM_EVENT_KIND_BSW
          DemEventClass:
            DemAgingAllowed = false
            DemConsiderPtoStatus = false
            DemEventOBDReadinessGroup = DEM_OBD_RDY_NONE
            DemEventPriority = 2
            DemFFPrestorageSupported = false
            DemOperationCycleRef = DemOperationCycle
          DemDebounceAlgorithmClass
            DemDebounceCounterBased: DemDebounceCounterBasedClassRef=DemCounterBasedDebounceClass_Of_NVM_WRONG_BLOCK_ID
        ADC_E_TIMEOUT: DemEventId=9, DemEventKind=DEM_EVENT_KIND_SWC
          DemEventClass: DemAgingAllowed=false, DemConsiderPtoStatus=false, DemEventPriority=2, DemFFPrestorageSupported=false, DemOperationCycleRef=DemOperationCycle
          DemDebounceAlgorithmClass
            DemDebounceCounterBased: DemDebounceCounterBasedClassRef=DemCounterBasedDebounceClass_Of_ADC_E_TIMEOUT
      DemDTCAttributesPrimary (DemDTCAttributes): DemMemoryDestinationRef=PrimaryMemory
      9 x DemDebounceCounterBasedClass, all with DemDebounceBehavior=DEM_DEBOUNCE_FREEZE, DemDebounceContinuous=false, DemDebounceCounterStorage=false, DemDebounceCounterDecrementStepSize=1, DemDebounceCounterFailedThreshold=127, DemDebounceCounterIncrementStepSize=1, DemDebounceCounterJumpDown=true, DemDebounceCounterJumpDownValue=0, DemDebounceCounterJumpUp=true, DemDebounceCounterJumpUpValue=0, DemDebounceCounterPassedThreshold=-128:
        DemCounterBasedDebounceClass_Of_CAN_E_TIMEOUT
        DemCounterBasedDebounceClass_Of_NVM_REQ_FAILED
        DemCounterBasedDebounceClass_Of_NVM_INTEGRITY_FAILED
        DemCounterBasedDebounceClass_Of_NVM_LOSS_OF_REDUNDANCY
        DemCounterBasedDebounceClass_Of_NVM_QUEUE_OVERFLOW
        DemCounterBasedDebounceClass_Of_NVM_WRITE_PROTECTED
        DemCounterBasedDebounceClass_Of_NVM_VERIFY_FAILED
        DemCounterBasedDebounceClass_Of_NVM_WRONG_BLOCK_ID
        DemCounterBasedDebounceClass_Of_ADC_E_TIMEOUT
      DTCClass_DTC_0x000003 (DemDTCClass): DemDTCSeverity=DEM_DTC_SEV_NO_SEVERITY, DemUdsDTC=3, DemImmediateNvStorage=false, DemDTCAttributesRef=DtcAttributes_41914fb7
      DtcAttributes_41914fb7 (DemDTCAttributes): DemMemoryDestinationRef=PrimaryMemory
      DTC_0x000002_DebounceAlgorithmProperties (DemDebounceCounterBasedClass):
        DemDebounceCounterDecrementStepSize = 1
        DemDebounceCounterIncrementStepSize = 1
        DemDebounceCounterJumpDown = false
        DemDebounceCounterJumpUp = true
        DemDebounceCounterFailedThreshold = 127
        DemDebounceCounterPassedThreshold = -128
        DemDebounceCounterJumpDownValue = 0
        DemDebounceBehavior = DEM_DEBOUNCE_FREEZE
        DemDebounceCounterStorage = false
        DemDebounceCounterJumpUpValue = 0
        DemDebounceContinuous = false
      DTCClass_DTC_0x000002 (DemDTCClass): DemDTCSeverity=DEM_DTC_SEV_NO_SEVERITY, DemUdsDTC=2, DemImmediateNvStorage=false, DemDTCAttributesRef=DtcAttributes_41914fb7
      DemEventParameter:
        DemEventAvailable = true
        DemEventId = 10
        DemEventKind = DEM_EVENT_KIND_SWC
        DemEventAvailableInVariant = true
        DemEventLatchTestFailed = false
        DemEventCreateInfoPort = true
        DemEventClass: DemAgingAllowed=false, DemConsiderPtoStatus=false, DemEventPriority=2, DemFFPrestorageSupported=false, DemOperationCycleRef=DemOperationCycle
        DemDebounceAlgorithmClass
          DemDebounceCounterBased: DemDebounceCounterBasedClassRef=DemDebounceCounterBasedClass
      DemDebounceCounterBasedClass:
        DemDebounceCounterIncrementStepSize = 1
        DemDebounceCounterDecrementStepSize = 1
        DemDebounceCounterFailedThreshold = 127
        DemDebounceCounterPassedThreshold = -128
        DemDebounceCounterJumpUp = true
        DemDebounceCounterJumpDown = true
        DemDebounceCounterJumpDownValue = 0
        DemDebounceBehavior = DEM_DEBOUNCE_FREEZE
        DemDebounceCounterStorage = false
        DemDebounceCounterJumpUpValue = 0
        DemDebounceContinuous = false
