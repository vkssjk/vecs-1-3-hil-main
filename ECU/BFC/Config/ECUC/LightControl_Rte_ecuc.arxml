AUTOSAR XML (schema 00049)
package /ActiveEcuC
  module config Rte: implementation-config-variant=VARIANT-PRE-COMPILE, module-description=Rte_Impl
    CanSM (RteBswModuleInstance): RteBswImplementationRef=CanSM_Impl, RteBswModuleConfigurationRef=CanSM
      CANSM_EXCLUSIVE_AREA_1 (RteBswExclusiveAreaImpl): RteExclusiveAreaImplMechanism=ALL_INTERRUPT_BLOCKING, RteBswExclusiveAreaRef=CANSM_EXCLUSIVE_AREA_1
      CanSM_MainFunctionTimingEvent0 (RteBswEventToTaskMapping):
        RteBswImmediateRestart = false
        RteBswPositionInTask = 5
        RteBswEventRef = CanSM_MainFunctionTimingEvent0
        RteBswMappedToTaskRef = BswTask
        RteBswUsedOsAlarmRef = Rte_Al_TE2_BswTask_0_10ms
        RteBswUsedOsEventRef = Rte_Ev_Cyclic2_BswTask_0_10ms
      5 x RteBswExclusiveAreaImpl, all with RteExclusiveAreaImplMechanism=ALL_INTERRUPT_BLOCKING:
        CANSM_EXCLUSIVE_AREA_{2..6}: RteBswExclusiveAreaRef=CANSM_EXCLUSIVE_AREA_{2..6}
    RteGeneration:
      RteCalibrationSupport = NONE
      RteCodeVendorId = 30
      RteDevErrorDetect = true
      RteDevErrorDetectUninit = false
      RteGenerationMode = COMPATIBILITY_MODE
      RteIocInteractionReturnValue = RTE_IOC
      RteMeasurementSupport = false
      RteOptimizationMode = MEMORY
      RteValueRangeCheckEnabled = false
      RteVfbTraceEnabled = false
      RteVttVfbTraceFunction = Rte_Vtt_Task_WaitEventRet
      RteVttVfbTraceFunction = Rte_Vtt_Task_Dispatch
      RteEnableMemoryProtection = false
      RteEnableMultiCore = false
    Det (RteBswModuleInstance): RteBswImplementationRef=Det_Impl, RteBswModuleConfigurationRef=Det
      DET_EXCLUSIVE_AREA_0 (RteBswExclusiveAreaImpl): RteExclusiveAreaImplMechanism=ALL_INTERRUPT_BLOCKING, RteBswExclusiveAreaRef=DET_EXCLUSIVE_AREA_0
    CanIf (RteBswModuleInstance): RteBswImplementationRef=CanIf_Impl, RteBswModuleConfigurationRef=CanIf
      8 x RteBswExclusiveAreaImpl, all with RteExclusiveAreaImplMechanism=ALL_INTERRUPT_BLOCKING:
        CANIF_EXCLUSIVE_AREA_0: RteBswExclusiveAreaRef=CANIF_EXCLUSIVE_AREA_0
        CANIF_EXCLUSIVE_AREA_2: RteBswExclusiveAreaRef=CANIF_EXCLUSIVE_AREA_2
        CANIF_EXCLUSIVE_AREA_1: RteBswExclusiveAreaRef=CANIF_EXCLUSIVE_AREA_1
        CANIF_EXCLUSIVE_AREA_4: RteBswExclusiveAreaRef=CANIF_EXCLUSIVE_AREA_4
        CANIF_EXCLUSIVE_AREA_3: RteBswExclusiveAreaRef=CANIF_EXCLUSIVE_AREA_3
        CANIF_EXCLUSIVE_AREA_6: RteBswExclusiveAreaRef=CANIF_EXCLUSIVE_AREA_6
        CANIF_EXCLUSIVE_AREA_5: RteBswExclusiveAreaRef=CANIF_EXCLUSIVE_AREA_5
        CANIF_EXCLUSIVE_AREA_7: RteBswExclusiveAreaRef=CANIF_EXCLUSIVE_AREA_7
    RteBswGeneral: RteSchMVersionInfoApi=false, RteUseComShadowSignalApi=false
    6 x RteBswModuleInstance:
      BswM: RteBswImplementationRef=BswM_Impl, RteBswModuleConfigurationRef=BswM
        BSWM_EXCLUSIVE_AREA_0 (RteBswExclusiveAreaImpl): RteExclusiveAreaImplMechanism=ALL_INTERRUPT_BLOCKING, RteBswExclusiveAreaRef=BSWM_EXCLUSIVE_AREA_0
        BswM_MainFunctionTimingEvent0 (RteBswEventToTaskMapping):
          RteBswImmediateRestart = false
          RteBswPositionInTask = 7
          RteBswEventRef = BswM_MainFunctionTimingEvent0
          RteBswMappedToTaskRef = BswTask
          RteBswUsedOsAlarmRef = Rte_Al_TE2_BswTask_0_10ms
          RteBswUsedOsEventRef = Rte_Ev_Cyclic2_BswTask_0_10ms
      PduR: RteBswImplementationRef=PduR_Impl, RteBswModuleConfigurationRef=PduR
        PDUR_EXCLUSIVE_AREA_0 (RteBswExclusiveAreaImpl): RteExclusiveAreaImplMechanism=ALL_INTERRUPT_BLOCKING, RteBswExclusiveAreaRef=PDUR_EXCLUSIVE_AREA_0
      Com: RteBswImplementationRef=Com_Impl, RteBswModuleConfigurationRef=Com
        3 x RteBswExclusiveAreaImpl, all with RteExclusiveAreaImplMechanism=ALL_INTERRUPT_BLOCKING:
          COM_EXCLUSIVE_AREA_RX: RteBswExclusiveAreaRef=COM_EXCLUSIVE_AREA_RX
          COM_EXCLUSIVE_AREA_TX: RteBswExclusiveAreaRef=COM_EXCLUSIVE_AREA_TX
          COM_EXCLUSIVE_AREA_BOTH: RteBswExclusiveAreaRef=COM_EXCLUSIVE_AREA_BOTH
        Com_MainFunctionTx_ComMainFunctionTxTimingEvent0 (RteBswEventToTaskMapping):
          RteBswImmediateRestart = false
          RteBswPositionInTask = 0
          RteBswEventRef = Com_MainFunctionTx_ComMainFunctionTxTimingEvent0
          RteBswMappedToTaskRef = BswTask
          RteBswUsedOsEventRef = Rte_Ev_Cyclic2_BswTask_0_10ms
          RteBswUsedOsAlarmRef = Rte_Al_TE2_BswTask_0_10ms
        Com_MainFunctionRx_ComMainFunctionRxTimingEvent0 (RteBswEventToTaskMapping):
          RteBswImmediateRestart = false
          RteBswPositionInTask = 1
          RteBswEventRef = Com_MainFunctionRx_ComMainFunctionRxTimingEvent0
          RteBswMappedToTaskRef = BswTask
          RteBswUsedOsEventRef = Rte_Ev_Cyclic2_BswTask_0_10ms
          RteBswUsedOsAlarmRef = Rte_Al_TE2_BswTask_0_10ms
      Rte: RteBswImplementationRef=Rte_Impl, RteBswModuleConfigurationRef=Rte
      EcuM: RteBswImplementationRef=EcuM_Impl, RteBswModuleConfigurationRef=EcuM
        3 x RteBswExclusiveAreaImpl, all with RteExclusiveAreaImplMechanism=ALL_INTERRUPT_BLOCKING:
          ECUM_EXCLUSIVE_AREA_1: RteBswExclusiveAreaRef=ECUM_EXCLUSIVE_AREA_1
          ECUM_EXCLUSIVE_AREA_0: RteBswExclusiveAreaRef=ECUM_EXCLUSIVE_AREA_0
          ECUM_EXCLUSIVE_AREA_2: RteBswExclusiveAreaRef=ECUM_EXCLUSIVE_AREA_2
        EcuM_MainFunctionTimingEvent0 (RteBswEventToTaskMapping):
          RteBswImmediateRestart = false
          RteBswPositionInTask = 3
          RteBswEventRef = EcuM_MainFunctionTimingEvent0
          RteBswMappedToTaskRef = BswTask
          RteBswUsedOsEventRef = Rte_Ev_Cyclic2_BswTask_0_10ms
          RteBswUsedOsAlarmRef = Rte_Al_TE2_BswTask_0_10ms
        ECUM_EXCLUSIVE_AREA_3 (RteBswExclusiveAreaImpl): RteExclusiveAreaImplMechanism=ALL_INTERRUPT_BLOCKING, RteBswExclusiveAreaRef=ECUM_EXCLUSIVE_AREA_3
      ComM: RteBswImplementationRef=ComM_Impl, RteBswModuleConfigurationRef=ComM
        ComM_MainFunction_0TimingEvent0 (RteBswEventToTaskMapping):
          RteBswImmediateRestart = false
          RteBswPositionInTask = 4
          RteBswEventRef = ComM_MainFunction_0TimingEvent0
          RteBswMappedToTaskRef = BswTask
          RteBswUsedOsAlarmRef = Rte_Al_TE2_BswTask_0_20ms
          RteBswUsedOsEventRef = Rte_Ev_Cyclic2_BswTask_0_20ms
        6 x RteBswExclusiveAreaImpl:
          COMM_EXCLUSIVE_AREA_1: RteExclusiveAreaImplMechanism=ALL_INTERRUPT_BLOCKING, RteBswExclusiveAreaRef=COMM_EXCLUSIVE_AREA_1
          COMM_EXCLUSIVE_AREA_0: RteExclusiveAreaImplMechanism=ALL_INTERRUPT_BLOCKING, RteBswExclusiveAreaRef=COMM_EXCLUSIVE_AREA_0
          COMM_EXCLUSIVE_AREA_{2..5}: RteExclusiveAreaImplMechanism=NONE, RteBswExclusiveAreaRef=COMM_EXCLUSIVE_AREA_{2..5}
    4 x RteSwComponentInstance:
      Det_EcuSwComposition: RteSoftwareComponentInstanceRef=Det
      BswM_EcuSwComposition: RteSoftwareComponentInstanceRef=BswM
        Timer_BswM_MainFunction (RteEventToTaskMapping):
          RteImmediateRestart = false
          RtePositionInTask = 7
          RteEventRef = Timer_BswM_MainFunction
          RteMappedToTaskRef = BswTask
          RteUsedOsEventRef = Rte_Ev_Cyclic2_BswTask_0_10ms
          RteUsedOsAlarmRef = Rte_Al_TE2_BswTask_0_10ms
      ComM_EcuSwComposition: RteSoftwareComponentInstanceRef=ComM
        13 x RteEventToTaskMapping, all with RteImmediateRestart=false:
          Timer_ComM_MainFunction_0: RtePositionInTask=4, RteEventRef=Timer_ComM_MainFunction_0, RteMappedToTaskRef=BswTask, RteUsedOsAlarmRef=Rte_Al_TE2_BswTask_0_20ms, RteUsedOsEventRef=Rte_Ev_Cyclic2_BswTask_0_20ms
          OpEventLimitECUToNoComMode_LimitECUToNoComMode_modeLimitation: RtePositionInTask=9, RteEventRef=OpEventLimitECUToNoComMode_LimitECUToNoComMode_modeLimitation, RteMappedToTaskRef=BswTask
          OpEventReadInhibitCounter_ReadInhibitCounter_modeLimitation: RtePositionInTask=10, RteEventRef=OpEventReadInhibitCounter_ReadInhibitCounter_modeLimitation, RteMappedToTaskRef=BswTask
          OpEventResetInhibitCounter_ResetInhibitCounter_modeLimitation: RtePositionInTask=11, RteEventRef=OpEventResetInhibitCounter_ResetInhibitCounter_modeLimitation, RteMappedToTaskRef=BswTask
          OpEventSetECUGroupClassification_SetECUGroupClassification_modeLimitation: RtePositionInTask=12, RteEventRef=OpEventSetECUGroupClassification_SetECUGroupClassification_modeLimitation, RteMappedToTaskRef=BswTask
          OpEventGetCurrentComMode_GetCurrentComMode_UR_USR_CHNL_f276589c: RteEventRef=OpEventGetCurrentComMode_GetCurrentComMode_UR_USR_CHNL_f276589c
          OpEventGetRequestedComMode_GetRequestedComMode_UR_USR_CHNL_f276589c: RteEventRef=OpEventGetRequestedComMode_GetRequestedComMode_UR_USR_CHNL_f276589c
          OpEventGetMaxComMode_GetMaxComMode_UR_USR_CHNL_f276589c: RteEventRef=OpEventGetMaxComMode_GetMaxComMode_UR_USR_CHNL_f276589c
          OpEventRequestComMode_RequestComMode_UR_USR_CHNL_f276589c: RteEventRef=OpEventRequestComMode_RequestComMode_UR_USR_CHNL_f276589c
          OpEventLimitChannelToNoComMode_LimitChannelToNoComMode_CL_CN_CAN00_a2373004: RteEventRef=OpEventLimitChannelToNoComMode_LimitChannelToNoComMode_CL_CN_CAN00_a2373004
          OpEventPreventWakeUp_PreventWakeUp_CW_CN_CAN00_a2373004: RteEventRef=OpEventPreventWakeUp_PreventWakeUp_CW_CN_CAN00_a2373004
          OpEventGetInhibitionStatus_GetInhibitionStatus_CW_CN_CAN00_a2373004: RteEventRef=OpEventGetInhibitionStatus_GetInhibitionStatus_CW_CN_CAN00_a2373004
          OpEventGetInhibitionStatus_GetInhibitionStatus_CL_CN_CAN00_a2373004: RteEventRef=OpEventGetInhibitionStatus_GetInhibitionStatus_CL_CN_CAN00_a2373004
      EcuM_EcuSwComposition: RteSoftwareComponentInstanceRef=EcuM
        8 x RteEventToTaskMapping, all with RteImmediateRestart=false:
          OpEventSelectShutdownTarget_SelectShutdownTarget_EcuM_ShutdownTarget: RteEventRef=OpEventSelectShutdownTarget_SelectShutdownTarget_EcuM_ShutdownTarget
          OpEventGetShutdownTarget_GetShutdownTarget_EcuM_ShutdownTarget: RteEventRef=OpEventGetShutdownTarget_GetShutdownTarget_EcuM_ShutdownTarget
          OpEventGetLastShutdownTarget_GetLastShutdownTarget_EcuM_ShutdownTarget: RteEventRef=OpEventGetLastShutdownTarget_GetLastShutdownTarget_EcuM_ShutdownTarget
          OpEventSelectShutdownCause_SelectShutdownCause_EcuM_ShutdownTarget: RteEventRef=OpEventSelectShutdownCause_SelectShutdownCause_EcuM_ShutdownTarget
          OpEventGetShutdownCause_GetShutdownCause_EcuM_ShutdownTarget: RteEventRef=OpEventGetShutdownCause_GetShutdownCause_EcuM_ShutdownTarget
          OpEventSelectBootTarget_SelectBootTarget_EcuM_BootTarget: RteEventRef=OpEventSelectBootTarget_SelectBootTarget_EcuM_BootTarget
          OpEventGetBootTarget_GetBootTarget_EcuM_BootTarget: RteEventRef=OpEventGetBootTarget_GetBootTarget_EcuM_BootTarget
          Timer_EcuM_MainFunction: RtePositionInTask=3, RteEventRef=Timer_EcuM_MainFunction, RteMappedToTaskRef=BswTask, RteUsedOsEventRef=Rte_Ev_Cyclic2_BswTask_0_10ms, RteUsedOsAlarmRef=Rte_Al_TE2_BswTask_0_10ms
    Dem (RteBswModuleInstance): RteBswImplementationRef=Dem_Impl, RteBswModuleConfigurationRef=Dem
      Dem_MasterMainFunctionTimingEvent0 (RteBswEventToTaskMapping):
        RteBswImmediateRestart = false
        RteBswPositionInTask = 15
        RteBswEventRef = Dem_MasterMainFunctionTimingEvent0
        RteBswMappedToTaskRef = BswTask
        RteBswUsedOsEventRef = Rte_Ev_Cyclic2_BswTask_0_10ms
        RteBswUsedOsAlarmRef = Rte_Al_TE2_BswTask_0_10ms
      Dem_SatelliteMainFunctionTimingEvent0 (RteBswEventToTaskMapping):
        RteBswImmediateRestart = false
        RteBswPositionInTask = 14
        RteBswEventRef = Dem_SatelliteMainFunctionTimingEvent0
        RteBswMappedToTaskRef = BswTask
        RteBswUsedOsEventRef = Rte_Ev_Cyclic2_BswTask_0_10ms
        RteBswUsedOsAlarmRef = Rte_Al_TE2_BswTask_0_10ms
      5 x RteBswExclusiveAreaImpl, all with RteExclusiveAreaImplMechanism=ALL_INTERRUPT_BLOCKING:
        DEM_EXCLUSIVE_AREA_{0..4}: RteBswExclusiveAreaRef=DEM_EXCLUSIVE_AREA_{0..4}
    LightCtrl (RteSwComponentType): RteComponentTypeRef=LightCtrl
      ComponentTypeCalibration (RteComponentTypeCalibration): RteCalibrationSupportEnabled=false
    RteInitializationBehavior: RteInitializationStrategy=RTE_INITIALIZATION_STRATEGY_AT_DATA_DECLARATION, RteSectionInitializationPolicy=, RteSectionInitializationPolicy=INIT
    RteOsInteraction
      6 x RteUsedOsActivation, all with RteExpectedActivationOffset=0, RteExpectedTickDuration=0:
        Rte_Al_TE2_BswTask_0_10ms: RteActivationOsAlarmRef=Rte_Al_TE2_BswTask_0_10ms, RteActivationOsTaskRef=BswTask
        Rte_Al_TE2_BswTask_0_20ms: RteActivationOsAlarmRef=Rte_Al_TE2_BswTask_0_20ms, RteActivationOsTaskRef=BswTask
        Rte_Al_TE_IoHwAb_IoHwAb_IoHwAb_IoHwAbHandler: RteActivationOsAlarmRef=Rte_Al_TE_IoHwAb_IoHwAb_IoHwAb_IoHwAbHandler, RteActivationOsTaskRef=IoTask
        Rte_Al_TE_SwcTask_0_10ms: RteActivationOsAlarmRef=Rte_Al_TE_SwcTask_0_10ms, RteActivationOsTaskRef=SwcTask
        Rte_Al_TE2_BswTask_0_1s: RteActivationOsAlarmRef=Rte_Al_TE2_BswTask_0_1s, RteActivationOsTaskRef=BswTask
        Rte_Al_TE_CanTp_CanTp_MainFunction: RteActivationOsAlarmRef=Rte_Al_TE_CanTp_CanTp_MainFunction, RteActivationOsTaskRef=BswTask
    IoHwAb_001 (RteSwComponentType): RteComponentTypeRef=IoHwAb, RteImplementationRef=IoHwAbImplementation
      ComponentTypeCalibration (RteComponentTypeCalibration): RteCalibrationSupportEnabled=false
    LightCtrl_EcuSwComposition_001 (RteSwComponentInstance): RteSoftwareComponentInstanceRef=LightCtrl
      5 x RteEventToTaskMapping, all with RteImmediateRestart=false, RteMappedToTaskRef=SwcTask:
        TMT_LightCtrl: RtePositionInTask=1, RteEventRef=TMT_LightCtrl, RteUsedOsEventRef=Rte_Ev_Cyclic_SwcTask_0_10ms, RteUsedOsAlarmRef=Rte_Al_TE_SwcTask_0_10ms
        MST_ECU_Reset_3: RtePositionInTask=3, RteEventRef=MST_ECU_Reset_3, RteUsedOsEventRef=Rte_Ev_Run_LightCtrl_ECU_Reset
        MST_ECU_Reset_1: RtePositionInTask=3, RteEventRef=MST_ECU_Reset_1, RteUsedOsEventRef=Rte_Ev_Run_LightCtrl_ECU_Reset
        MST_ECU_Reset_2: RtePositionInTask=3, RteEventRef=MST_ECU_Reset_2, RteUsedOsEventRef=Rte_Ev_Run_LightCtrl_ECU_Reset
        MST_ECU_Reset_Execution_0: RtePositionInTask=4, RteEventRef=MST_ECU_Reset_Execution_0, RteUsedOsEventRef=Rte_Ev_Run_LightCtrl_ECU_Reset_Execution
    IoHwAb_EcuSwComposition (RteSwComponentInstance): RteSoftwareComponentInstanceRef=IoHwAb
      3 x RteEventToTaskMapping, all with RteImmediateRestart=false:
        Timer_IoHwAb_IoHwAb_IoHwAbHandler: RtePositionInTask=0, RteEventRef=Timer_IoHwAb_IoHwAb_IoHwAbHandler, RteMappedToTaskRef=IoTask, RteUsedOsAlarmRef=Rte_Al_TE_IoHwAb_IoHwAb_IoHwAb_IoHwAbHandler, RteUsedOsEventRef=Rte_Ev_Run_IoHwAb_IoHwAb_IoHwAb_IoHwAbHandler
        OIT_IoHwAb_LightIntensityPort_LightIntensity_LightIntensityPort_LightIntensity: RteEventRef=OIT_IoHwAb_LightIntensityPort_LightIntensity_LightIntensityPort_LightIntensity
        IoHwAb_InitEvent: RtePositionInTask=1, RteEventRef=IoHwAb_InitEvent, RteMappedToTaskRef=IoTask
    BSW_Handler (RteSwComponentType): RteComponentTypeRef=BSW_Handler, RteImplementationRef=BSW_Handler_Implementation
      ComponentTypeCalibration (RteComponentTypeCalibration): RteCalibrationSupportEnabled=false
    4 x RteSwComponentInstance:
      BSW_Handler_EcuSwComposition: RteSoftwareComponentInstanceRef=BSW_Handler
        TMT_LightCtrl (RteEventToTaskMapping):
          RteImmediateRestart = false
          RtePositionInTask = 2
          RteEventRef = TMT_LightCtrl
          RteMappedToTaskRef = SwcTask
          RteUsedOsEventRef = Rte_Ev_Cyclic_SwcTask_0_10ms
          RteUsedOsAlarmRef = Rte_Al_TE_SwcTask_0_10ms
        BSW_Handler_InitEvent (RteEventToTaskMapping): RteImmediateRestart=false, RtePositionInTask=0, RteEventRef=BSW_Handler_InitEvent, RteMappedToTaskRef=SwcTask
      DemMaster_Invalid_OsApplication_EcuSwComposition: RteSoftwareComponentInstanceRef=DemMaster_Invalid_OsApplication
        49 x RteEventToTaskMapping, all with RteImmediateRestart=false:
          Timer_Dem_MasterMainFunction: RtePositionInTask=15, RteEventRef=Timer_Dem_MasterMainFunction, RteMappedToTaskRef=BswTask, RteUsedOsEventRef=Rte_Ev_Cyclic2_BswTask_0_10ms, RteUsedOsAlarmRef=Rte_Al_TE2_BswTask_0_10ms
          OpEventPostRunRequested_GetPostRunRequested_DemServices: RteEventRef=OpEventPostRunRequested_GetPostRunRequested_DemServices
          OpEventGetDTCStatusAvailabilityMask_GetDTCStatusAvailabilityMask_DemServices: RteEventRef=OpEventGetDTCStatusAvailabilityMask_GetDTCStatusAvailabilityMask_DemServices
          OpEventGetEventUdsStatus_GetEventUdsStatus_GeneralEvtInfo: RteEventRef=OpEventGetEventUdsStatus_GetEventUdsStatus_GeneralEvtInfo
          OpEventGetEventStatus_GetEventStatus_GeneralEvtInfo: RteEventRef=OpEventGetEventStatus_GetEventStatus_GeneralEvtInfo
          OpEventGetEventFailed_GetEventFailed_GeneralEvtInfo: RteEventRef=OpEventGetEventFailed_GetEventFailed_GeneralEvtInfo
          OpEventGetEventTested_GetEventTested_GeneralEvtInfo: RteEventRef=OpEventGetEventTested_GetEventTested_GeneralEvtInfo
          OpEventGetDTCOfEvent_GetDTCOfEvent_GeneralEvtInfo: RteEventRef=OpEventGetDTCOfEvent_GetDTCOfEvent_GeneralEvtInfo
          OpEventGetFaultDetectionCounter_GetFaultDetectionCounter_GeneralEvtInfo: RteEventRef=OpEventGetFaultDetectionCounter_GetFaultDetectionCounter_GeneralEvtInfo
          OpEventGetEventFreezeFrameDataEx_GetEventFreezeFrameDataEx_GeneralEvtInfo: RteEventRef=OpEventGetEventFreezeFrameDataEx_GetEventFreezeFrameDataEx_GeneralEvtInfo
          OpEventGetEventExtendedDataRecordEx_GetEventExtendedDataRecordEx_GeneralEvtInfo: RteEventRef=OpEventGetEventExtendedDataRecordEx_GetEventExtendedDataRecordEx_GeneralEvtInfo
          OpEventGetEventEnableCondition_GetEventEnableCondition_GeneralEvtInfo: RteEventRef=OpEventGetEventEnableCondition_GetEventEnableCondition_GeneralEvtInfo
          OpEventGetDebouncingOfEvent_GetDebouncingOfEvent_GeneralEvtInfo: RteEventRef=OpEventGetDebouncingOfEvent_GetDebouncingOfEvent_GeneralEvtInfo
          OpEventGetMonitorStatus_GetMonitorStatus_GeneralEvtInfo: RteEventRef=OpEventGetMonitorStatus_GetMonitorStatus_GeneralEvtInfo
          OpEventSetOperationCycleState_SetOperationCycleState_OpCycle_PowerCycle: RteEventRef=OpEventSetOperationCycleState_SetOperationCycleState_OpCycle_PowerCycle
          OpEventGetNumberOfEventMemoryEntries_GetNumberOfEventMemoryEntries_OverflowIndPrimaryMemory_DemClient: RteEventRef=OpEventGetNumberOfEventMemoryEntries_GetNumberOfEventMemoryEntries_OverflowIndPrimaryMemory_DemClient
          OpEventGetOperationCycleState_GetOperationCycleState_OpCycle_PowerCycle: RteEventRef=OpEventGetOperationCycleState_GetOperationCycleState_OpCycle_PowerCycle
          OpEventSelectDTC_SelectDTC_ClearDTC_DemClient: RteEventRef=OpEventSelectDTC_SelectDTC_ClearDTC_DemClient
          OpEventClearDTC_ClearDTC_ClearDTC_DemClient: RteEventRef=OpEventClearDTC_ClearDTC_ClearDTC_DemClient
          OpEventGetOperationCycleState_GetOperationCycleState_OpCycle_WarmUpCycle: RteEventRef=OpEventGetOperationCycleState_GetOperationCycleState_OpCycle_WarmUpCycle
          OpEventGetOperationCycleState_GetOperationCycleState_OpCycle_OBDDrivingCycle: RteEventRef=OpEventGetOperationCycleState_GetOperationCycleState_OpCycle_OBDDrivingCycle
          OpEventGetOperationCycleState_GetOperationCycleState_OpCycle_IgnitionCycle: RteEventRef=OpEventGetOperationCycleState_GetOperationCycleState_OpCycle_IgnitionCycle
          OpEventGetIndicatorStatus_GetIndicatorStatus_IndStatus_WarningIndicator: RteEventRef=OpEventGetIndicatorStatus_GetIndicatorStatus_IndStatus_WarningIndicator
          OpEventSetOperationCycleState_SetOperationCycleState_OpCycle_IgnitionCycle: RteEventRef=OpEventSetOperationCycleState_SetOperationCycleState_OpCycle_IgnitionCycle
          OpEventGetEventMemoryOverflow_GetEventMemoryOverflow_OverflowIndPrimaryMemory_DemClient: RteEventRef=OpEventGetEventMemoryOverflow_GetEventMemoryOverflow_OverflowIndPrimaryMemory_DemClient
          OpEventSetOperationCycleState_SetOperationCycleState_OpCycle_OBDDrivingCycle: RteEventRef=OpEventSetOperationCycleState_SetOperationCycleState_OpCycle_OBDDrivingCycle
          OpEventSetOperationCycleState_SetOperationCycleState_OpCycle_WarmUpCycle: RteEventRef=OpEventSetOperationCycleState_SetOperationCycleState_OpCycle_WarmUpCycle
          OpEventSetEventAvailable_SetEventAvailable_ControlEventAvailable_NVM_INTEGRITY_FAILED: RteEventRef=OpEventSetEventAvailable_SetEventAvailable_ControlEventAvailable_NVM_INTEGRITY_FAILED
          OpEventSetEventAvailable_SetEventAvailable_ControlEventAvailable_ADC_E_TIMEOUT: RteEventRef=OpEventSetEventAvailable_SetEventAvailable_ControlEventAvailable_ADC_E_TIMEOUT
          OpEventSetEventAvailable_SetEventAvailable_ControlEventAvailable_NVM_REQ_FAILED: RteEventRef=OpEventSetEventAvailable_SetEventAvailable_ControlEventAvailable_NVM_REQ_FAILED
          OpEventGetEventAvailable_GetEventAvailable_ControlEventAvailable_NVM_INTEGRITY_FAILED: RteEventRef=OpEventGetEventAvailable_GetEventAvailable_ControlEventAvailable_NVM_INTEGRITY_FAILED
          OpEventGetOperationCycleState_GetOperationCycleState_OpCycle_DemOperationCycle: RteEventRef=OpEventGetOperationCycleState_GetOperationCycleState_OpCycle_DemOperationCycle
          OpEventSetEventAvailable_SetEventAvailable_ControlEventAvailable_NVM_LOSS_OF_REDUNDANCY: RteEventRef=OpEventSetEventAvailable_SetEventAvailable_ControlEventAvailable_NVM_LOSS_OF_REDUNDANCY
          OpEventGetEventAvailable_GetEventAvailable_ControlEventAvailable_CAN_E_TIMEOUT: RteEventRef=OpEventGetEventAvailable_GetEventAvailable_ControlEventAvailable_CAN_E_TIMEOUT
          OpEventGetEventAvailable_GetEventAvailable_ControlEventAvailable_NVM_LOSS_OF_REDUNDANCY: RteEventRef=OpEventGetEventAvailable_GetEventAvailable_ControlEventAvailable_NVM_LOSS_OF_REDUNDANCY
          OpEventGetEventAvailable_GetEventAvailable_ControlEventAvailable_NVM_REQ_FAILED: RteEventRef=OpEventGetEventAvailable_GetEventAvailable_ControlEventAvailable_NVM_REQ_FAILED
          OpEventGetEventAvailable_GetEventAvailable_ControlEventAvailable_NVM_WRONG_BLOCK_ID: RteEventRef=OpEventGetEventAvailable_GetEventAvailable_ControlEventAvailable_NVM_WRONG_BLOCK_ID
          OpEventGetEventAvailable_GetEventAvailable_ControlEventAvailable_DemEventParameter: RteEventRef=OpEventGetEventAvailable_GetEventAvailable_ControlEventAvailable_DemEventParameter
          OpEventSetEventAvailable_SetEventAvailable_ControlEventAvailable_DemEventParameter: RteEventRef=OpEventSetEventAvailable_SetEventAvailable_ControlEventAvailable_DemEventParameter
          OpEventGetEventAvailable_GetEventAvailable_ControlEventAvailable_ADC_E_TIMEOUT: RteEventRef=OpEventGetEventAvailable_GetEventAvailable_ControlEventAvailable_ADC_E_TIMEOUT
          OpEventSetOperationCycleState_SetOperationCycleState_OpCycle_DemOperationCycle: RteEventRef=OpEventSetOperationCycleState_SetOperationCycleState_OpCycle_DemOperationCycle
          OpEventGetEventAvailable_GetEventAvailable_ControlEventAvailable_NVM_QUEUE_OVERFLOW: RteEventRef=OpEventGetEventAvailable_GetEventAvailable_ControlEventAvailable_NVM_QUEUE_OVERFLOW
          OpEventGetEventAvailable_GetEventAvailable_ControlEventAvailable_NVM_VERIFY_FAILED: RteEventRef=OpEventGetEventAvailable_GetEventAvailable_ControlEventAvailable_NVM_VERIFY_FAILED
          OpEventGetEventAvailable_GetEventAvailable_ControlEventAvailable_NVM_WRITE_PROTECTED: RteEventRef=OpEventGetEventAvailable_GetEventAvailable_ControlEventAvailable_NVM_WRITE_PROTECTED
          OpEventSetEventAvailable_SetEventAvailable_ControlEventAvailable_CAN_E_TIMEOUT: RteEventRef=OpEventSetEventAvailable_SetEventAvailable_ControlEventAvailable_CAN_E_TIMEOUT
          OpEventSetEventAvailable_SetEventAvailable_ControlEventAvailable_NVM_VERIFY_FAILED: RteEventRef=OpEventSetEventAvailable_SetEventAvailable_ControlEventAvailable_NVM_VERIFY_FAILED
          OpEventSetEventAvailable_SetEventAvailable_ControlEventAvailable_NVM_WRITE_PROTECTED: RteEventRef=OpEventSetEventAvailable_SetEventAvailable_ControlEventAvailable_NVM_WRITE_PROTECTED
          OpEventSetEventAvailable_SetEventAvailable_ControlEventAvailable_NVM_QUEUE_OVERFLOW: RteEventRef=OpEventSetEventAvailable_SetEventAvailable_ControlEventAvailable_NVM_QUEUE_OVERFLOW
          OpEventSetEventAvailable_SetEventAvailable_ControlEventAvailable_NVM_WRONG_BLOCK_ID: RteEventRef=OpEventSetEventAvailable_SetEventAvailable_ControlEventAvailable_NVM_WRONG_BLOCK_ID
      DemSatellite_Invalid_OsApplication_EcuSwComposition: RteSoftwareComponentInstanceRef=DemSatellite_Invalid_OsApplication
        144 x RteEventToTaskMapping, all with RteImmediateRestart=false:
          Timer_Dem_SatelliteMainFunction: RtePositionInTask=14, RteEventRef=Timer_Dem_SatelliteMainFunction, RteMappedToTaskRef=BswTask, RteUsedOsEventRef=Rte_Ev_Cyclic2_BswTask_0_10ms, RteUsedOsAlarmRef=Rte_Al_TE2_BswTask_0_10ms
          OpEventGetEventUdsStatus_GetEventUdsStatus_GeneralEvtInfo: RteEventRef=OpEventGetEventUdsStatus_GetEventUdsStatus_GeneralEvtInfo
          OpEventGetEventStatus_GetEventStatus_GeneralEvtInfo: RteEventRef=OpEventGetEventStatus_GetEventStatus_GeneralEvtInfo
          OpEventGetEventFailed_GetEventFailed_GeneralEvtInfo: RteEventRef=OpEventGetEventFailed_GetEventFailed_GeneralEvtInfo
          OpEventGetEventTested_GetEventTested_GeneralEvtInfo: RteEventRef=OpEventGetEventTested_GetEventTested_GeneralEvtInfo
          OpEventGetDTCOfEvent_GetDTCOfEvent_GeneralEvtInfo: RteEventRef=OpEventGetDTCOfEvent_GetDTCOfEvent_GeneralEvtInfo
          OpEventGetFaultDetectionCounter_GetFaultDetectionCounter_GeneralEvtInfo: RteEventRef=OpEventGetFaultDetectionCounter_GetFaultDetectionCounter_GeneralEvtInfo
          OpEventGetEventFreezeFrameDataEx_GetEventFreezeFrameDataEx_GeneralEvtInfo: RteEventRef=OpEventGetEventFreezeFrameDataEx_GetEventFreezeFrameDataEx_GeneralEvtInfo
          OpEventGetEventExtendedDataRecordEx_GetEventExtendedDataRecordEx_GeneralEvtInfo: RteEventRef=OpEventGetEventExtendedDataRecordEx_GetEventExtendedDataRecordEx_GeneralEvtInfo
          OpEventGetEventEnableCondition_GetEventEnableCondition_GeneralEvtInfo: RteEventRef=OpEventGetEventEnableCondition_GetEventEnableCondition_GeneralEvtInfo
          OpEventGetDebouncingOfEvent_GetDebouncingOfEvent_GeneralEvtInfo: RteEventRef=OpEventGetDebouncingOfEvent_GetDebouncingOfEvent_GeneralEvtInfo
          OpEventGetMonitorStatus_GetMonitorStatus_GeneralEvtInfo: RteEventRef=OpEventGetMonitorStatus_GetMonitorStatus_GeneralEvtInfo
          OpEventGetEventTested_GetEventTested_EvtInfo_NVM_WRITE_PROTECTED: RteEventRef=OpEventGetEventTested_GetEventTested_EvtInfo_NVM_WRITE_PROTECTED
          OpEventGetEventEnableCondition_GetEventEnableCondition_EvtInfo_ADC_E_TIMEOUT: RteEventRef=OpEventGetEventEnableCondition_GetEventEnableCondition_EvtInfo_ADC_E_TIMEOUT
          OpEventGetDebouncingOfEvent_GetDebouncingOfEvent_EvtInfo_DemEventParameter: RteEventRef=OpEventGetDebouncingOfEvent_GetDebouncingOfEvent_EvtInfo_DemEventParameter
          OpEventGetMonitorStatus_GetMonitorStatus_EvtInfo_NVM_REQ_FAILED: RteEventRef=OpEventGetMonitorStatus_GetMonitorStatus_EvtInfo_NVM_REQ_FAILED
          OpEventGetEventStatus_GetEventStatus_EvtInfo_NVM_QUEUE_OVERFLOW: RteEventRef=OpEventGetEventStatus_GetEventStatus_EvtInfo_NVM_QUEUE_OVERFLOW
          OpEventGetFaultDetectionCounter_GetFaultDetectionCounter_EvtInfo_DemEventParameter: RteEventRef=OpEventGetFaultDetectionCounter_GetFaultDetectionCounter_EvtInfo_DemEventParameter
          OpEventGetFaultDetectionCounter_GetFaultDetectionCounter_Event_ADC_E_TIMEOUT: RteEventRef=OpEventGetFaultDetectionCounter_GetFaultDetectionCounter_Event_ADC_E_TIMEOUT
          OpEventGetEventUdsStatus_GetEventUdsStatus_EvtInfo_NVM_WRITE_PROTECTED: RteEventRef=OpEventGetEventUdsStatus_GetEventUdsStatus_EvtInfo_NVM_WRITE_PROTECTED
          OpEventGetEventTested_GetEventTested_EvtInfo_CAN_E_TIMEOUT: RteEventRef=OpEventGetEventTested_GetEventTested_EvtInfo_CAN_E_TIMEOUT
          OpEventGetEventExtendedDataRecordEx_GetEventExtendedDataRecordEx_EvtInfo_NVM_REQ_FAILED: RteEventRef=OpEventGetEventExtendedDataRecordEx_GetEventExtendedDataRecordEx_EvtInfo_NVM_REQ_FAILED
          OpEventGetMonitorStatus_GetMonitorStatus_EvtInfo_NVM_INTEGRITY_FAILED: RteEventRef=OpEventGetMonitorStatus_GetMonitorStatus_EvtInfo_NVM_INTEGRITY_FAILED
          OpEventGetEventUdsStatus_GetEventUdsStatus_Event_ADC_E_TIMEOUT: RteEventRef=OpEventGetEventUdsStatus_GetEventUdsStatus_Event_ADC_E_TIMEOUT
          OpEventGetEventExtendedDataRecordEx_GetEventExtendedDataRecordEx_EvtInfo_CAN_E_TIMEOUT: RteEventRef=OpEventGetEventExtendedDataRecordEx_GetEventExtendedDataRecordEx_EvtInfo_CAN_E_TIMEOUT
          OpEventGetEventStatus_GetEventStatus_EvtInfo_NVM_WRITE_PROTECTED: RteEventRef=OpEventGetEventStatus_GetEventStatus_EvtInfo_NVM_WRITE_PROTECTED
          OpEventGetDTCOfEvent_GetDTCOfEvent_EvtInfo_NVM_WRITE_PROTECTED: RteEventRef=OpEventGetDTCOfEvent_GetDTCOfEvent_EvtInfo_NVM_WRITE_PROTECTED
          OpEventGetEventFailed_GetEventFailed_EvtInfo_NVM_LOSS_OF_REDUNDANCY: RteEventRef=OpEventGetEventFailed_GetEventFailed_EvtInfo_NVM_LOSS_OF_REDUNDANCY
          OpEventGetFaultDetectionCounter_GetFaultDetectionCounter_EvtInfo_NVM_WRONG_BLOCK_ID: RteEventRef=OpEventGetFaultDetectionCounter_GetFaultDetectionCounter_EvtInfo_NVM_WRONG_BLOCK_ID
          OpEventGetEventUdsStatus_GetEventUdsStatus_EvtInfo_NVM_WRONG_BLOCK_ID: RteEventRef=OpEventGetEventUdsStatus_GetEventUdsStatus_EvtInfo_NVM_WRONG_BLOCK_ID
          OpEventGetEventFailed_GetEventFailed_EvtInfo_CAN_E_TIMEOUT: RteEventRef=OpEventGetEventFailed_GetEventFailed_EvtInfo_CAN_E_TIMEOUT
          OpEventGetDTCOfEvent_GetDTCOfEvent_EvtInfo_NVM_REQ_FAILED: RteEventRef=OpEventGetDTCOfEvent_GetDTCOfEvent_EvtInfo_NVM_REQ_FAILED
          OpEventGetEventFreezeFrameDataEx_GetEventFreezeFrameDataEx_Event_ADC_E_TIMEOUT: RteEventRef=OpEventGetEventFreezeFrameDataEx_GetEventFreezeFrameDataEx_Event_ADC_E_TIMEOUT
          OpEventGetDTCOfEvent_GetDTCOfEvent_EvtInfo_NVM_LOSS_OF_REDUNDANCY: RteEventRef=OpEventGetDTCOfEvent_GetDTCOfEvent_EvtInfo_NVM_LOSS_OF_REDUNDANCY
          OpEventGetMonitorStatus_GetMonitorStatus_EvtInfo_DemEventParameter: RteEventRef=OpEventGetMonitorStatus_GetMonitorStatus_EvtInfo_DemEventParameter
          OpEventGetEventUdsStatus_GetEventUdsStatus_Event_DemEventParameter: RteEventRef=OpEventGetEventUdsStatus_GetEventUdsStatus_Event_DemEventParameter
          OpEventGetEventStatus_GetEventStatus_EvtInfo_NVM_LOSS_OF_REDUNDANCY: RteEventRef=OpEventGetEventStatus_GetEventStatus_EvtInfo_NVM_LOSS_OF_REDUNDANCY
          OpEventGetDebouncingOfEvent_GetDebouncingOfEvent_EvtInfo_NVM_VERIFY_FAILED: RteEventRef=OpEventGetDebouncingOfEvent_GetDebouncingOfEvent_EvtInfo_NVM_VERIFY_FAILED
          OpEventSetEventStatus_SetEventStatus_Event_DemEventParameter: RteEventRef=OpEventSetEventStatus_SetEventStatus_Event_DemEventParameter
          OpEventGetEventFreezeFrameDataEx_GetEventFreezeFrameDataEx_EvtInfo_NVM_WRONG_BLOCK_ID: RteEventRef=OpEventGetEventFreezeFrameDataEx_GetEventFreezeFrameDataEx_EvtInfo_NVM_WRONG_BLOCK_ID
          OpEventGetDTCOfEvent_GetDTCOfEvent_EvtInfo_CAN_E_TIMEOUT: RteEventRef=OpEventGetDTCOfEvent_GetDTCOfEvent_EvtInfo_CAN_E_TIMEOUT
          OpEventGetDebouncingOfEvent_GetDebouncingOfEvent_EvtInfo_CAN_E_TIMEOUT: RteEventRef=OpEventGetDebouncingOfEvent_GetDebouncingOfEvent_EvtInfo_CAN_E_TIMEOUT
          OpEventGetFaultDetectionCounter_GetFaultDetectionCounter_EvtInfo_NVM_QUEUE_OVERFLOW: RteEventRef=OpEventGetFaultDetectionCounter_GetFaultDetectionCounter_EvtInfo_NVM_QUEUE_OVERFLOW
          OpEventGetDTCOfEvent_GetDTCOfEvent_EvtInfo_ADC_E_TIMEOUT: RteEventRef=OpEventGetDTCOfEvent_GetDTCOfEvent_EvtInfo_ADC_E_TIMEOUT
          OpEventGetMonitorStatus_GetMonitorStatus_EvtInfo_NVM_WRONG_BLOCK_ID: RteEventRef=OpEventGetMonitorStatus_GetMonitorStatus_EvtInfo_NVM_WRONG_BLOCK_ID
          OpEventGetFaultDetectionCounter_GetFaultDetectionCounter_EvtInfo_NVM_WRITE_PROTECTED: RteEventRef=OpEventGetFaultDetectionCounter_GetFaultDetectionCounter_EvtInfo_NVM_WRITE_PROTECTED
          OpEventGetEventFailed_GetEventFailed_Event_DemEventParameter: RteEventRef=OpEventGetEventFailed_GetEventFailed_Event_DemEventParameter
          OpEventGetEventEnableCondition_GetEventEnableCondition_EvtInfo_CAN_E_TIMEOUT: RteEventRef=OpEventGetEventEnableCondition_GetEventEnableCondition_EvtInfo_CAN_E_TIMEOUT
          OpEventSetEventStatus_SetEventStatus_Event_ADC_E_TIMEOUT: RteEventRef=OpEventSetEventStatus_SetEventStatus_Event_ADC_E_TIMEOUT
          OpEventGetEventFreezeFrameDataEx_GetEventFreezeFrameDataEx_EvtInfo_CAN_E_TIMEOUT: RteEventRef=OpEventGetEventFreezeFrameDataEx_GetEventFreezeFrameDataEx_EvtInfo_CAN_E_TIMEOUT
          OpEventGetDebouncingOfEvent_GetDebouncingOfEvent_EvtInfo_NVM_WRITE_PROTECTED: RteEventRef=OpEventGetDebouncingOfEvent_GetDebouncingOfEvent_EvtInfo_NVM_WRITE_PROTECTED
          OpEventGetEventFailed_GetEventFailed_EvtInfo_NVM_INTEGRITY_FAILED: RteEventRef=OpEventGetEventFailed_GetEventFailed_EvtInfo_NVM_INTEGRITY_FAILED
          OpEventGetFaultDetectionCounter_GetFaultDetectionCounter_EvtInfo_NVM_VERIFY_FAILED: RteEventRef=OpEventGetFaultDetectionCounter_GetFaultDetectionCounter_EvtInfo_NVM_VERIFY_FAILED
          OpEventGetFaultDetectionCounter_GetFaultDetectionCounter_EvtInfo_CAN_E_TIMEOUT: RteEventRef=OpEventGetFaultDetectionCounter_GetFaultDetectionCounter_EvtInfo_CAN_E_TIMEOUT
          OpEventGetEventTested_GetEventTested_Event_DemEventParameter: RteEventRef=OpEventGetEventTested_GetEventTested_Event_DemEventParameter
          OpEventGetEventExtendedDataRecordEx_GetEventExtendedDataRecordEx_EvtInfo_NVM_WRONG_BLOCK_ID: RteEventRef=OpEventGetEventExtendedDataRecordEx_GetEventExtendedDataRecordEx_EvtInfo_NVM_WRONG_BLOCK_ID
          OpEventGetMonitorStatus_GetMonitorStatus_EvtInfo_NVM_WRITE_PROTECTED: RteEventRef=OpEventGetMonitorStatus_GetMonitorStatus_EvtInfo_NVM_WRITE_PROTECTED
          OpEventGetDebouncingOfEvent_GetDebouncingOfEvent_EvtInfo_ADC_E_TIMEOUT: RteEventRef=OpEventGetDebouncingOfEvent_GetDebouncingOfEvent_EvtInfo_ADC_E_TIMEOUT
          OpEventGetEventStatus_GetEventStatus_EvtInfo_CAN_E_TIMEOUT: RteEventRef=OpEventGetEventStatus_GetEventStatus_EvtInfo_CAN_E_TIMEOUT
          OpEventGetEventUdsStatus_GetEventUdsStatus_EvtInfo_NVM_QUEUE_OVERFLOW: RteEventRef=OpEventGetEventUdsStatus_GetEventUdsStatus_EvtInfo_NVM_QUEUE_OVERFLOW
          OpEventGetEventExtendedDataRecordEx_GetEventExtendedDataRecordEx_EvtInfo_NVM_INTEGRITY_FAILED: RteEventRef=OpEventGetEventExtendedDataRecordEx_GetEventExtendedDataRecordEx_EvtInfo_NVM_INTEGRITY_FAILED
          OpEventGetMonitorStatus_GetMonitorStatus_EvtInfo_NVM_QUEUE_OVERFLOW: RteEventRef=OpEventGetMonitorStatus_GetMonitorStatus_EvtInfo_NVM_QUEUE_OVERFLOW
          OpEventGetEventFailed_GetEventFailed_EvtInfo_NVM_QUEUE_OVERFLOW: RteEventRef=OpEventGetEventFailed_GetEventFailed_EvtInfo_NVM_QUEUE_OVERFLOW
          OpEventGetDebouncingOfEvent_GetDebouncingOfEvent_EvtInfo_NVM_REQ_FAILED: RteEventRef=OpEventGetDebouncingOfEvent_GetDebouncingOfEvent_EvtInfo_NVM_REQ_FAILED
          OpEventGetEventFreezeFrameDataEx_GetEventFreezeFrameDataEx_EvtInfo_NVM_WRITE_PROTECTED: RteEventRef=OpEventGetEventFreezeFrameDataEx_GetEventFreezeFrameDataEx_EvtInfo_NVM_WRITE_PROTECTED
          OpEventGetEventUdsStatus_GetEventUdsStatus_EvtInfo_DemEventParameter: RteEventRef=OpEventGetEventUdsStatus_GetEventUdsStatus_EvtInfo_DemEventParameter
          OpEventGetEventTested_GetEventTested_EvtInfo_NVM_INTEGRITY_FAILED: RteEventRef=OpEventGetEventTested_GetEventTested_EvtInfo_NVM_INTEGRITY_FAILED
          OpEventGetEventExtendedDataRecordEx_GetEventExtendedDataRecordEx_Event_DemEventParameter: RteEventRef=OpEventGetEventExtendedDataRecordEx_GetEventExtendedDataRecordEx_Event_DemEventParameter
          OpEventGetEventUdsStatus_GetEventUdsStatus_EvtInfo_CAN_E_TIMEOUT: RteEventRef=OpEventGetEventUdsStatus_GetEventUdsStatus_EvtInfo_CAN_E_TIMEOUT
          OpEventGetEventFreezeFrameDataEx_GetEventFreezeFrameDataEx_EvtInfo_NVM_QUEUE_OVERFLOW: RteEventRef=OpEventGetEventFreezeFrameDataEx_GetEventFreezeFrameDataEx_EvtInfo_NVM_QUEUE_OVERFLOW
          OpEventGetEventFailed_GetEventFailed_Event_ADC_E_TIMEOUT: RteEventRef=OpEventGetEventFailed_GetEventFailed_Event_ADC_E_TIMEOUT
          OpEventGetEventFreezeFrameDataEx_GetEventFreezeFrameDataEx_EvtInfo_NVM_REQ_FAILED: RteEventRef=OpEventGetEventFreezeFrameDataEx_GetEventFreezeFrameDataEx_EvtInfo_NVM_REQ_FAILED
          OpEventGetEventFreezeFrameDataEx_GetEventFreezeFrameDataEx_EvtInfo_DemEventParameter: RteEventRef=OpEventGetEventFreezeFrameDataEx_GetEventFreezeFrameDataEx_EvtInfo_DemEventParameter
          OpEventGetDTCOfEvent_GetDTCOfEvent_Event_DemEventParameter: RteEventRef=OpEventGetDTCOfEvent_GetDTCOfEvent_Event_DemEventParameter
          OpEventGetFaultDetectionCounter_GetFaultDetectionCounter_EvtInfo_NVM_REQ_FAILED: RteEventRef=OpEventGetFaultDetectionCounter_GetFaultDetectionCounter_EvtInfo_NVM_REQ_FAILED
          OpEventGetEventExtendedDataRecordEx_GetEventExtendedDataRecordEx_Event_ADC_E_TIMEOUT: RteEventRef=OpEventGetEventExtendedDataRecordEx_GetEventExtendedDataRecordEx_Event_ADC_E_TIMEOUT
          OpEventGetDebouncingOfEvent_GetDebouncingOfEvent_EvtInfo_NVM_LOSS_OF_REDUNDANCY: RteEventRef=OpEventGetDebouncingOfEvent_GetDebouncingOfEvent_EvtInfo_NVM_LOSS_OF_REDUNDANCY
          OpEventGetMonitorStatus_GetMonitorStatus_EvtInfo_CAN_E_TIMEOUT: RteEventRef=OpEventGetMonitorStatus_GetMonitorStatus_EvtInfo_CAN_E_TIMEOUT
          OpEventGetEventFailed_GetEventFailed_EvtInfo_DemEventParameter: RteEventRef=OpEventGetEventFailed_GetEventFailed_EvtInfo_DemEventParameter
          OpEventGetDTCOfEvent_GetDTCOfEvent_EvtInfo_DemEventParameter: RteEventRef=OpEventGetDTCOfEvent_GetDTCOfEvent_EvtInfo_DemEventParameter
          OpEventGetEventUdsStatus_GetEventUdsStatus_EvtInfo_NVM_REQ_FAILED: RteEventRef=OpEventGetEventUdsStatus_GetEventUdsStatus_EvtInfo_NVM_REQ_FAILED
          OpEventGetEventStatus_GetEventStatus_EvtInfo_NVM_INTEGRITY_FAILED: RteEventRef=OpEventGetEventStatus_GetEventStatus_EvtInfo_NVM_INTEGRITY_FAILED
          OpEventGetEventEnableCondition_GetEventEnableCondition_EvtInfo_NVM_VERIFY_FAILED: RteEventRef=OpEventGetEventEnableCondition_GetEventEnableCondition_EvtInfo_NVM_VERIFY_FAILED
          OpEventGetEventUdsStatus_GetEventUdsStatus_EvtInfo_NVM_VERIFY_FAILED: RteEventRef=OpEventGetEventUdsStatus_GetEventUdsStatus_EvtInfo_NVM_VERIFY_FAILED
          OpEventGetEventFreezeFrameDataEx_GetEventFreezeFrameDataEx_EvtInfo_NVM_LOSS_OF_REDUNDANCY: RteEventRef=OpEventGetEventFreezeFrameDataEx_GetEventFreezeFrameDataEx_EvtInfo_NVM_LOSS_OF_REDUNDANCY
          OpEventGetEventTested_GetEventTested_EvtInfo_NVM_REQ_FAILED: RteEventRef=OpEventGetEventTested_GetEventTested_EvtInfo_NVM_REQ_FAILED
          OpEventGetEventExtendedDataRecordEx_GetEventExtendedDataRecordEx_EvtInfo_NVM_QUEUE_OVERFLOW: RteEventRef=OpEventGetEventExtendedDataRecordEx_GetEventExtendedDataRecordEx_EvtInfo_NVM_QUEUE_OVERFLOW
          OpEventGetEventEnableCondition_GetEventEnableCondition_EvtInfo_NVM_LOSS_OF_REDUNDANCY: RteEventRef=OpEventGetEventEnableCondition_GetEventEnableCondition_EvtInfo_NVM_LOSS_OF_REDUNDANCY
          OpEventGetMonitorStatus_GetMonitorStatus_EvtInfo_ADC_E_TIMEOUT: RteEventRef=OpEventGetMonitorStatus_GetMonitorStatus_EvtInfo_ADC_E_TIMEOUT
          OpEventGetEventStatus_GetEventStatus_EvtInfo_NVM_WRONG_BLOCK_ID: RteEventRef=OpEventGetEventStatus_GetEventStatus_EvtInfo_NVM_WRONG_BLOCK_ID
          OpEventGetEventStatus_GetEventStatus_EvtInfo_ADC_E_TIMEOUT: RteEventRef=OpEventGetEventStatus_GetEventStatus_EvtInfo_ADC_E_TIMEOUT
          OpEventGetEventEnableCondition_GetEventEnableCondition_EvtInfo_NVM_INTEGRITY_FAILED: RteEventRef=OpEventGetEventEnableCondition_GetEventEnableCondition_EvtInfo_NVM_INTEGRITY_FAILED
          OpEventGetDebouncingOfEvent_GetDebouncingOfEvent_EvtInfo_NVM_QUEUE_OVERFLOW: RteEventRef=OpEventGetDebouncingOfEvent_GetDebouncingOfEvent_EvtInfo_NVM_QUEUE_OVERFLOW
          OpEventGetEventExtendedDataRecordEx_GetEventExtendedDataRecordEx_EvtInfo_DemEventParameter: RteEventRef=OpEventGetEventExtendedDataRecordEx_GetEventExtendedDataRecordEx_EvtInfo_DemEventParameter
          OpEventResetEventDebounceStatus_ResetEventDebounceStatus_Event_DemEventParameter: RteEventRef=OpEventResetEventDebounceStatus_ResetEventDebounceStatus_Event_DemEventParameter
          OpEventResetEventStatus_ResetEventStatus_Event_DemEventParameter: RteEventRef=OpEventResetEventStatus_ResetEventStatus_Event_DemEventParameter
          OpEventGetEventFailed_GetEventFailed_EvtInfo_ADC_E_TIMEOUT: RteEventRef=OpEventGetEventFailed_GetEventFailed_EvtInfo_ADC_E_TIMEOUT
          OpEventGetEventUdsStatus_GetEventUdsStatus_EvtInfo_ADC_E_TIMEOUT: RteEventRef=OpEventGetEventUdsStatus_GetEventUdsStatus_EvtInfo_ADC_E_TIMEOUT
          OpEventGetFaultDetectionCounter_GetFaultDetectionCounter_EvtInfo_NVM_INTEGRITY_FAILED: RteEventRef=OpEventGetFaultDetectionCounter_GetFaultDetectionCounter_EvtInfo_NVM_INTEGRITY_FAILED
          OpEventGetDebouncingOfEvent_GetDebouncingOfEvent_EvtInfo_NVM_WRONG_BLOCK_ID: RteEventRef=OpEventGetDebouncingOfEvent_GetDebouncingOfEvent_EvtInfo_NVM_WRONG_BLOCK_ID
          OpEventGetEventFailed_GetEventFailed_EvtInfo_NVM_REQ_FAILED: RteEventRef=OpEventGetEventFailed_GetEventFailed_EvtInfo_NVM_REQ_FAILED
          OpEventGetEventFreezeFrameDataEx_GetEventFreezeFrameDataEx_EvtInfo_ADC_E_TIMEOUT: RteEventRef=OpEventGetEventFreezeFrameDataEx_GetEventFreezeFrameDataEx_EvtInfo_ADC_E_TIMEOUT
          OpEventGetEventFailed_GetEventFailed_EvtInfo_NVM_WRONG_BLOCK_ID: RteEventRef=OpEventGetEventFailed_GetEventFailed_EvtInfo_NVM_WRONG_BLOCK_ID
          OpEventGetEventTested_GetEventTested_Event_ADC_E_TIMEOUT: RteEventRef=OpEventGetEventTested_GetEventTested_Event_ADC_E_TIMEOUT
          OpEventGetEventStatus_GetEventStatus_EvtInfo_NVM_VERIFY_FAILED: RteEventRef=OpEventGetEventStatus_GetEventStatus_EvtInfo_NVM_VERIFY_FAILED
          OpEventGetEventExtendedDataRecordEx_GetEventExtendedDataRecordEx_EvtInfo_NVM_LOSS_OF_REDUNDANCY: RteEventRef=OpEventGetEventExtendedDataRecordEx_GetEventExtendedDataRecordEx_EvtInfo_NVM_LOSS_OF_REDUNDANCY
          OpEventGetEventEnableCondition_GetEventEnableCondition_EvtInfo_NVM_REQ_FAILED: RteEventRef=OpEventGetEventEnableCondition_GetEventEnableCondition_EvtInfo_NVM_REQ_FAILED
          OpEventGetEventExtendedDataRecordEx_GetEventExtendedDataRecordEx_EvtInfo_NVM_WRITE_PROTECTED: RteEventRef=OpEventGetEventExtendedDataRecordEx_GetEventExtendedDataRecordEx_EvtInfo_NVM_WRITE_PROTECTED
          OpEventGetFaultDetectionCounter_GetFaultDetectionCounter_EvtInfo_ADC_E_TIMEOUT: RteEventRef=OpEventGetFaultDetectionCounter_GetFaultDetectionCounter_EvtInfo_ADC_E_TIMEOUT
          OpEventGetEventStatus_GetEventStatus_Event_DemEventParameter: RteEventRef=OpEventGetEventStatus_GetEventStatus_Event_DemEventParameter
          OpEventGetEventEnableCondition_GetEventEnableCondition_EvtInfo_NVM_WRITE_PROTECTED: RteEventRef=OpEventGetEventEnableCondition_GetEventEnableCondition_EvtInfo_NVM_WRITE_PROTECTED
          OpEventGetEventEnableCondition_GetEventEnableCondition_EvtInfo_NVM_WRONG_BLOCK_ID: RteEventRef=OpEventGetEventEnableCondition_GetEventEnableCondition_EvtInfo_NVM_WRONG_BLOCK_ID
          OpEventResetEventStatus_ResetEventStatus_Event_ADC_E_TIMEOUT: RteEventRef=OpEventResetEventStatus_ResetEventStatus_Event_ADC_E_TIMEOUT
          OpEventGetEventStatus_GetEventStatus_EvtInfo_NVM_REQ_FAILED: RteEventRef=OpEventGetEventStatus_GetEventStatus_EvtInfo_NVM_REQ_FAILED
          OpEventGetEventTested_GetEventTested_EvtInfo_NVM_LOSS_OF_REDUNDANCY: RteEventRef=OpEventGetEventTested_GetEventTested_EvtInfo_NVM_LOSS_OF_REDUNDANCY
          OpEventGetEventEnableCondition_GetEventEnableCondition_EvtInfo_DemEventParameter: RteEventRef=OpEventGetEventEnableCondition_GetEventEnableCondition_EvtInfo_DemEventParameter
          OpEventGetDTCOfEvent_GetDTCOfEvent_EvtInfo_NVM_QUEUE_OVERFLOW: RteEventRef=OpEventGetDTCOfEvent_GetDTCOfEvent_EvtInfo_NVM_QUEUE_OVERFLOW
          OpEventGetEventTested_GetEventTested_EvtInfo_DemEventParameter: RteEventRef=OpEventGetEventTested_GetEventTested_EvtInfo_DemEventParameter
          OpEventGetDTCOfEvent_GetDTCOfEvent_EvtInfo_NVM_VERIFY_FAILED: RteEventRef=OpEventGetDTCOfEvent_GetDTCOfEvent_EvtInfo_NVM_VERIFY_FAILED
          OpEventGetEventExtendedDataRecordEx_GetEventExtendedDataRecordEx_EvtInfo_NVM_VERIFY_FAILED: RteEventRef=OpEventGetEventExtendedDataRecordEx_GetEventExtendedDataRecordEx_EvtInfo_NVM_VERIFY_FAILED
          OpEventGetEventTested_GetEventTested_EvtInfo_NVM_WRONG_BLOCK_ID: RteEventRef=OpEventGetEventTested_GetEventTested_EvtInfo_NVM_WRONG_BLOCK_ID
          OpEventGetFaultDetectionCounter_GetFaultDetectionCounter_EvtInfo_NVM_LOSS_OF_REDUNDANCY: RteEventRef=OpEventGetFaultDetectionCounter_GetFaultDetectionCounter_EvtInfo_NVM_LOSS_OF_REDUNDANCY
          OpEventGetMonitorStatus_GetMonitorStatus_EvtInfo_NVM_LOSS_OF_REDUNDANCY: RteEventRef=OpEventGetMonitorStatus_GetMonitorStatus_EvtInfo_NVM_LOSS_OF_REDUNDANCY
          OpEventGetEventTested_GetEventTested_EvtInfo_NVM_QUEUE_OVERFLOW: RteEventRef=OpEventGetEventTested_GetEventTested_EvtInfo_NVM_QUEUE_OVERFLOW
          OpEventGetEventExtendedDataRecordEx_GetEventExtendedDataRecordEx_EvtInfo_ADC_E_TIMEOUT: RteEventRef=OpEventGetEventExtendedDataRecordEx_GetEventExtendedDataRecordEx_EvtInfo_ADC_E_TIMEOUT
          OpEventGetEventFreezeFrameDataEx_GetEventFreezeFrameDataEx_Event_DemEventParameter: RteEventRef=OpEventGetEventFreezeFrameDataEx_GetEventFreezeFrameDataEx_Event_DemEventParameter
          OpEventGetDTCOfEvent_GetDTCOfEvent_Event_ADC_E_TIMEOUT: RteEventRef=OpEventGetDTCOfEvent_GetDTCOfEvent_Event_ADC_E_TIMEOUT
          OpEventGetEventFreezeFrameDataEx_GetEventFreezeFrameDataEx_EvtInfo_NVM_INTEGRITY_FAILED: RteEventRef=OpEventGetEventFreezeFrameDataEx_GetEventFreezeFrameDataEx_EvtInfo_NVM_INTEGRITY_FAILED
          OpEventResetEventDebounceStatus_ResetEventDebounceStatus_Event_ADC_E_TIMEOUT: RteEventRef=OpEventResetEventDebounceStatus_ResetEventDebounceStatus_Event_ADC_E_TIMEOUT
          OpEventGetEventTested_GetEventTested_EvtInfo_ADC_E_TIMEOUT: RteEventRef=OpEventGetEventTested_GetEventTested_EvtInfo_ADC_E_TIMEOUT
          OpEventGetEventUdsStatus_GetEventUdsStatus_EvtInfo_NVM_LOSS_OF_REDUNDANCY: RteEventRef=OpEventGetEventUdsStatus_GetEventUdsStatus_EvtInfo_NVM_LOSS_OF_REDUNDANCY
          OpEventGetEventFailed_GetEventFailed_EvtInfo_NVM_VERIFY_FAILED: RteEventRef=OpEventGetEventFailed_GetEventFailed_EvtInfo_NVM_VERIFY_FAILED
          OpEventGetMonitorStatus_GetMonitorStatus_EvtInfo_NVM_VERIFY_FAILED: RteEventRef=OpEventGetMonitorStatus_GetMonitorStatus_EvtInfo_NVM_VERIFY_FAILED
          OpEventGetEventEnableCondition_GetEventEnableCondition_EvtInfo_NVM_QUEUE_OVERFLOW: RteEventRef=OpEventGetEventEnableCondition_GetEventEnableCondition_EvtInfo_NVM_QUEUE_OVERFLOW
          OpEventGetEventStatus_GetEventStatus_EvtInfo_DemEventParameter: RteEventRef=OpEventGetEventStatus_GetEventStatus_EvtInfo_DemEventParameter
          OpEventGetDTCOfEvent_GetDTCOfEvent_EvtInfo_NVM_INTEGRITY_FAILED: RteEventRef=OpEventGetDTCOfEvent_GetDTCOfEvent_EvtInfo_NVM_INTEGRITY_FAILED
          OpEventGetDTCOfEvent_GetDTCOfEvent_EvtInfo_NVM_WRONG_BLOCK_ID: RteEventRef=OpEventGetDTCOfEvent_GetDTCOfEvent_EvtInfo_NVM_WRONG_BLOCK_ID
          OpEventGetEventTested_GetEventTested_EvtInfo_NVM_VERIFY_FAILED: RteEventRef=OpEventGetEventTested_GetEventTested_EvtInfo_NVM_VERIFY_FAILED
          OpEventGetEventFreezeFrameDataEx_GetEventFreezeFrameDataEx_EvtInfo_NVM_VERIFY_FAILED: RteEventRef=OpEventGetEventFreezeFrameDataEx_GetEventFreezeFrameDataEx_EvtInfo_NVM_VERIFY_FAILED
          OpEventGetEventStatus_GetEventStatus_Event_ADC_E_TIMEOUT: RteEventRef=OpEventGetEventStatus_GetEventStatus_Event_ADC_E_TIMEOUT
          OpEventGetDebouncingOfEvent_GetDebouncingOfEvent_EvtInfo_NVM_INTEGRITY_FAILED: RteEventRef=OpEventGetDebouncingOfEvent_GetDebouncingOfEvent_EvtInfo_NVM_INTEGRITY_FAILED
          OpEventGetFaultDetectionCounter_GetFaultDetectionCounter_Event_DemEventParameter: RteEventRef=OpEventGetFaultDetectionCounter_GetFaultDetectionCounter_Event_DemEventParameter
          OpEventGetEventUdsStatus_GetEventUdsStatus_EvtInfo_NVM_INTEGRITY_FAILED: RteEventRef=OpEventGetEventUdsStatus_GetEventUdsStatus_EvtInfo_NVM_INTEGRITY_FAILED
          OpEventGetEventFailed_GetEventFailed_EvtInfo_NVM_WRITE_PROTECTED: RteEventRef=OpEventGetEventFailed_GetEventFailed_EvtInfo_NVM_WRITE_PROTECTED
      Os_OsCore_swc_EcuSwComposition: RteSoftwareComponentInstanceRef=Os_OsCore_swc
        OpEventGetCounterValue_GetCounterValue_OsService_SystemTimer (RteEventToTaskMapping): RteImmediateRestart=false, RteEventRef=OpEventGetCounterValue_GetCounterValue_OsService_SystemTimer
        OpEventGetElapsedValue_GetElapsedValue_OsService_SystemTimer (RteEventToTaskMapping): RteImmediateRestart=false, RteEventRef=OpEventGetElapsedValue_GetElapsedValue_OsService_SystemTimer
    12 x RteBswModuleInstance:
      vCan: RteBswImplementationRef=vCan_Impl, RteBswModuleConfigurationRef=vCan
        VCAN_30_MCAN_EXCLUSIVE_AREA_0 (RteBswExclusiveAreaImpl): RteExclusiveAreaImplMechanism=ALL_INTERRUPT_BLOCKING, RteBswExclusiveAreaRef=VCAN_30_MCAN_EXCLUSIVE_AREA_0
        VCAN_30_MCAN_EXCLUSIVE_AREA_1 (RteBswExclusiveAreaImpl): RteExclusiveAreaImplMechanism=ALL_INTERRUPT_BLOCKING, RteBswExclusiveAreaRef=VCAN_30_MCAN_EXCLUSIVE_AREA_1
      Can: RteBswImplementationRef=Can_Impl, RteBswModuleConfigurationRef=Can
        6 x RteBswExclusiveAreaImpl, all with RteExclusiveAreaImplMechanism=ALL_INTERRUPT_BLOCKING:
          CAN_30_CORE_EXCLUSIVE_AREA_1: RteBswExclusiveAreaRef=CAN_30_CORE_EXCLUSIVE_AREA_1
          CAN_30_CORE_EXCLUSIVE_AREA_2: RteBswExclusiveAreaRef=CAN_30_CORE_EXCLUSIVE_AREA_2
          CAN_30_CORE_EXCLUSIVE_AREA_{4..7}: RteBswExclusiveAreaRef=CAN_30_CORE_EXCLUSIVE_AREA_{4..7}
        5 x RteBswEventToTaskMapping, all with RteBswImmediateRestart=false, RteBswMappedToTaskRef=BswTask:
          Can_30_Core_MainFunction_WriteTimingEvent0: RteBswPositionInTask=26, RteBswEventRef=Can_30_Core_MainFunction_WriteTimingEvent0, RteBswUsedOsEventRef=Rte_Ev_Cyclic2_BswTask_0_1s, RteBswUsedOsAlarmRef=Rte_Al_TE2_BswTask_0_1s
          Can_30_Core_MainFunction_ReadTimingEvent0: RteBswPositionInTask=24, RteBswEventRef=Can_30_Core_MainFunction_ReadTimingEvent0, RteBswUsedOsEventRef=Rte_Ev_Cyclic2_BswTask_0_1s, RteBswUsedOsAlarmRef=Rte_Al_TE2_BswTask_0_1s
          Can_30_Core_MainFunction_BusOffTimingEvent0: RteBswPositionInTask=22, RteBswEventRef=Can_30_Core_MainFunction_BusOffTimingEvent0, RteBswUsedOsEventRef=Rte_Ev_Cyclic2_BswTask_0_10ms, RteBswUsedOsAlarmRef=Rte_Al_TE2_BswTask_0_10ms
          Can_30_Core_MainFunction_WakeupTimingEvent0: RteBswPositionInTask=25, RteBswEventRef=Can_30_Core_MainFunction_WakeupTimingEvent0, RteBswUsedOsEventRef=Rte_Ev_Cyclic2_BswTask_0_10ms, RteBswUsedOsAlarmRef=Rte_Al_TE2_BswTask_0_10ms
          Can_30_Core_MainFunction_ModeTimingEvent0: RteBswPositionInTask=23, RteBswEventRef=Can_30_Core_MainFunction_ModeTimingEvent0, RteBswUsedOsEventRef=Rte_Ev_Cyclic2_BswTask_0_10ms, RteBswUsedOsAlarmRef=Rte_Al_TE2_BswTask_0_10ms
      McalLib: RteBswImplementationRef=McalLib_Impl, RteBswModuleConfigurationRef=McalLib
        4 x RteBswExclusiveAreaImpl, all with RteExclusiveAreaImplMechanism=ALL_INTERRUPT_BLOCKING:
          CpuEndInit: RteBswExclusiveAreaRef=CpuEndInit
          PeripheralEndInit: RteBswExclusiveAreaRef=PeripheralEndInit
          SafetyEndInit: RteBswExclusiveAreaRef=SafetyEndInit
          StmTimerResolution: RteBswExclusiveAreaRef=StmTimerResolution
      Dio: RteBswImplementationRef=Dio_Impl, RteBswModuleConfigurationRef=Dio
      Mcu: RteBswImplementationRef=Mcu_Impl, RteBswModuleConfigurationRef=Mcu
        AtomAgcReg (RteBswExclusiveAreaImpl): RteExclusiveAreaImplMechanism=ALL_INTERRUPT_BLOCKING, RteBswExclusiveAreaRef=AtomAgcReg
        TomTgcReg (RteBswExclusiveAreaImpl): RteExclusiveAreaImplMechanism=ALL_INTERRUPT_BLOCKING, RteBswExclusiveAreaRef=TomTgcReg
      Adc: RteBswImplementationRef=Adc_Impl, RteBswModuleConfigurationRef=Adc
        KernelData (RteBswExclusiveAreaImpl): RteExclusiveAreaImplMechanism=ALL_INTERRUPT_BLOCKING, RteBswExclusiveAreaRef=KernelData
        SrcRegAccess (RteBswExclusiveAreaImpl): RteExclusiveAreaImplMechanism=ALL_INTERRUPT_BLOCKING, RteBswExclusiveAreaRef=SrcRegAccess
      Port: RteBswImplementationRef=Port_Impl, RteBswModuleConfigurationRef=Port
      Irq: RteBswImplementationRef=Irq_Impl, RteBswModuleConfigurationRef=Irq
      CanTp: RteBswImplementationRef=CanTp_Impl, RteBswModuleConfigurationRef=CanTp
        CanTp_MainFunctionTimingEvent0 (RteBswEventToTaskMapping):
          RteBswImmediateRestart = false
          RteBswPositionInTask = 2
          RteBswEventRef = CanTp_MainFunctionTimingEvent0
          RteBswMappedToTaskRef = BswTask
          RteBswUsedOsEventRef = Rte_Ev_Run_CanTp_CanTp_MainFunction
          RteBswUsedOsAlarmRef = Rte_Al_TE_CanTp_CanTp_MainFunction
        CANTP_EXCLUSIVE_AREA_0 (RteBswExclusiveAreaImpl): RteExclusiveAreaImplMechanism=ALL_INTERRUPT_BLOCKING, RteBswExclusiveAreaRef=CANTP_EXCLUSIVE_AREA_0
      Fee: RteBswImplementationRef=Fee_Impl, RteBswModuleConfigurationRef=Fee
        Fee_MainFunctionTimingEvent0 (RteBswEventToTaskMapping):
          RteBswImmediateRestart = false
          RteBswPositionInTask = 18
          RteBswEventRef = Fee_MainFunctionTimingEvent0
          RteBswMappedToTaskRef = BswTask
          RteBswUsedOsEventRef = Rte_Ev_Cyclic2_BswTask_0_10ms
          RteBswUsedOsAlarmRef = Rte_Al_TE2_BswTask_0_10ms
      NvM: RteBswImplementationRef=NvM_Impl, RteBswModuleConfigurationRef=NvM
        NvM_MainFunctionTimingEvent0 (RteBswEventToTaskMapping):
          RteBswImmediateRestart = false
          RteBswPositionInTask = 20
          RteBswEventRef = NvM_MainFunctionTimingEvent0
          RteBswMappedToTaskRef = BswTask
          RteBswUsedOsEventRef = Rte_Ev_Cyclic2_BswTask_0_10ms
          RteBswUsedOsAlarmRef = Rte_Al_TE2_BswTask_0_10ms
        NVM_EXCLUSIVE_AREA_0 (RteBswExclusiveAreaImpl): RteExclusiveAreaImplMechanism=ALL_INTERRUPT_BLOCKING, RteBswExclusiveAreaRef=NVM_EXCLUSIVE_AREA_0
      Fls: RteBswImplementationRef=Fls_Impl, RteBswModuleConfigurationRef=Fls
        Fls_17_Dmu_MainFunctionTimingEvent0 (RteBswEventToTaskMapping):
          RteBswImmediateRestart = false
          RteBswPositionInTask = 19
          RteBswEventRef = Fls_17_Dmu_MainFunctionTimingEvent0
          RteBswMappedToTaskRef = BswTask
          RteBswUsedOsEventRef = Rte_Ev_Cyclic2_BswTask_0_10ms
          RteBswUsedOsAlarmRef = Rte_Al_TE2_BswTask_0_10ms
        6 x RteBswExclusiveAreaImpl, all with RteExclusiveAreaImplMechanism=ALL_INTERRUPT_BLOCKING:
          Init: RteBswExclusiveAreaRef=Init
          Erase: RteBswExclusiveAreaRef=Erase
          Write: RteBswExclusiveAreaRef=Write
          Main: RteBswExclusiveAreaRef=Main
          ResumeErase: RteBswExclusiveAreaRef=ResumeErase
          UserContentCount: RteBswExclusiveAreaRef=UserContentCount
    Dcm_EcuSwComposition (RteSwComponentInstance): RteSoftwareComponentInstanceRef=Dcm
      7 x RteEventToTaskMapping, all with RteImmediateRestart=false:
        Timer_Dcm_MainFunction: RtePositionInTask=13, RteEventRef=Timer_Dcm_MainFunction, RteMappedToTaskRef=BswTask, RteUsedOsEventRef=Rte_Ev_Cyclic2_BswTask_0_10ms, RteUsedOsAlarmRef=Rte_Al_TE2_BswTask_0_10ms
        OpEventGetActiveProtocol_GetActiveProtocol_DCMServices: RteEventRef=OpEventGetActiveProtocol_GetActiveProtocol_DCMServices
        OpEventGetSesCtrlType_GetSesCtrlType_DCMServices: RteEventRef=OpEventGetSesCtrlType_GetSesCtrlType_DCMServices
        OpEventResetToDefaultSession_ResetToDefaultSession_DCMServices: RteEventRef=OpEventResetToDefaultSession_ResetToDefaultSession_DCMServices
        OpEventGetSecurityLevel_GetSecurityLevel_DCMServices: RteEventRef=OpEventGetSecurityLevel_GetSecurityLevel_DCMServices
        OpEventSetActiveDiagnostic_SetActiveDiagnostic_DCMServices: RteEventRef=OpEventSetActiveDiagnostic_SetActiveDiagnostic_DCMServices
        OpEventGetRequestKind_GetRequestKind_DCMServices: RteEventRef=OpEventGetRequestKind_GetRequestKind_DCMServices
    NvM_EcuSwComposition (RteSwComponentInstance): RteSoftwareComponentInstanceRef=NvM
      Timer_NvM_MainFunction (RteEventToTaskMapping):
        RteImmediateRestart = false
        RtePositionInTask = 20
        RteEventRef = Timer_NvM_MainFunction
        RteMappedToTaskRef = BswTask
        RteUsedOsEventRef = Rte_Ev_Cyclic2_BswTask_0_10ms
        RteUsedOsAlarmRef = Rte_Al_TE2_BswTask_0_10ms
    Dcm (RteBswModuleInstance): RteBswImplementationRef=Dcm_Impl, RteBswModuleConfigurationRef=Dcm
      Dcm_MainFunctionTimingEvent0 (RteBswEventToTaskMapping):
        RteBswImmediateRestart = false
        RteBswPositionInTask = 13
        RteBswEventRef = Dcm_MainFunctionTimingEvent0
        RteBswMappedToTaskRef = BswTask
        RteBswUsedOsEventRef = Rte_Ev_Cyclic2_BswTask_0_10ms
        RteBswUsedOsAlarmRef = Rte_Al_TE2_BswTask_0_10ms
      DCM_EXCLUSIVE_AREA_0 (RteBswExclusiveAreaImpl): RteExclusiveAreaImplMechanism=ALL_INTERRUPT_BLOCKING, RteBswExclusiveAreaRef=DCM_EXCLUSIVE_AREA_0
