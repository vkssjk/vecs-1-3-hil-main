AUTOSAR XML (schema 00049)
package /ActiveEcuC
  module config Fls: implementation-config-variant=VARIANT-POST-BUILD, module-description=Fls_Implementation
    FlsConfigSet:
      FlsAcErase = 0
      FlsAcWrite = 0
      FlsCallCycle = 0.01
      FlsDefaultMode = MEMIF_MODE_SLOW
      FlsMaxReadFastMode = 64
      FlsMaxReadNormalMode = 32
      FlsMaxWriteFastMode = 32
      FlsMaxWriteNormalMode = 32
      FlsProtection = 0
      FlsWaitStateRead = FLS_17_DMU_WAITSTATE_READ_9
      FlsWaitStateErrorCorrection = FLS_17_DMU_WAITSTATE_ERRCOREC_1
      FlsJobEndNotification = Fee_JobEndNotification
      FlsJobErrorNotification = Fee_JobErrorNotification
      FlsEraseVerifyErrNotif = Fee_17_JobEraseErrorNotification
      FlsProgVerifyErrNotif = Fee_17_JobProgErrorNotification
      FlsSectorList
        FlsSector: FlsNumberOfSectors=2, FlsPageSize=8, FlsSectorSize=524288, FlsSectorStartaddress=0
      FlsSerialFlashConfig
        FlsSerialFlashRead:
          FlsAddressAndDataBitSize = ONE_BIT
          FlsAddressAndDataRate = SDR
          FlsAddressLength = THREE_BYTES
          FlsClockDelay = ONE_CYCLE
          FlsCommand = 3
          FlsRpcFrequency = FREQ_80MHz
          FlsDummyCycle = 0
          FlsInternalStrobeDelay = 0
          FlsNegationDelay = FIVE_DOT_FIVE_CYCLES
          FlsNextAccessDelay = ONE_CYCLE
          FlsOptionalData = 2779096485
          FlsOptionalDataLength = NOT_USED
        FlsSerialFlashReadStatusReg:
          FlsClockDelay = ONE_CYCLE
          FlsCommand = 5
          FlsDataBitSize = ONE_BIT
          FlsDataRate = SDR
          FlsRpcFrequency = FREQ_80MHz
          FlsDummyCycle = 0
          FlsNegationDelay = FIVE_DOT_FIVE_CYCLES
          FlsNextAccessDelay = ONE_CYCLE
          FlsPositionOfBusyBit = 0
          FlsPositionOfEraseErrorBit = 5
          FlsPositionOfProgramErrorBit = 6
          FlsPositionOfWriteEnableBit = 1
        FlsSerialFlashReadHwId:
          FlsClockDelay = ONE_CYCLE
          FlsCommand = 159
          FlsDataBitSize = ONE_BIT
          FlsDataRate = SDR
          FlsRpcFrequency = FREQ_80MHz
          FlsDummyCycle = 0
          FlsNegationDelay = FIVE_DOT_FIVE_CYCLES
          FlsNextAccessDelay = ONE_CYCLE
        FlsSerialFlashErase:
          FlsAddressAndDataBitSize = ONE_BIT
          FlsAddressAndDataRate = SDR
          FlsAddressLength = THREE_BYTES
          FlsClockDelay = ONE_CYCLE
          FlsCommand = 216
          FlsRpcFrequency = FREQ_80MHz
          FlsDummyCycle = 0
          FlsNegationDelay = FIVE_DOT_FIVE_CYCLES
          FlsNextAccessDelay = ONE_CYCLE
        FlsSerialFlashProgram:
          FlsAddressAndDataBitSize = ONE_BIT
          FlsAddressAndDataRate = SDR
          FlsAddressLength = THREE_BYTES
          FlsClockDelay = ONE_CYCLE
          FlsCommand = 2
          FlsRpcFrequency = FREQ_80MHz
          FlsDummyCycle = 0
          FlsNegationDelay = FIVE_DOT_FIVE_CYCLES
          FlsNextAccessDelay = ONE_CYCLE
        FlsSerialFlashWriteEnable:
          FlsClockDelay = ONE_CYCLE
          FlsCommand = 6
          FlsDataBitSize = ONE_BIT
          FlsDataRate = SDR
          FlsRpcFrequency = FREQ_80MHz
          FlsDummyCycle = 0
          FlsNegationDelay = FIVE_DOT_FIVE_CYCLES
          FlsNextAccessDelay = ONE_CYCLE
      FlsHyperFlashConfig
        FlsHyperFlashRead: FlsClockDelay=ONE_CYCLE, FlsRpcFrequency=FREQ_80MHz, FlsDummyCycle=0, FlsNegationDelay=FIVE_DOT_FIVE_CYCLES, FlsNextAccessDelay=ONE_CYCLE
        FlsHyperFlashReadStatusReg:
          FlsClockDelay = ONE_CYCLE
          FlsRpcFrequency = FREQ_80MHz
          FlsDummyCycle = 0
          FlsNegationDelay = FIVE_DOT_FIVE_CYCLES
          FlsNextAccessDelay = ONE_CYCLE
          FlsPositionOfDeviceReadyBit = 7
          FlsPositionOfEraseErrorBit = 5
          FlsPositionOfProgramErrorBit = 4
          FlsReadStatusSetupCycle: FlsTransactionAddress=0, FlsTransactionData=0
        FlsHyperFlashReadHwId:
          FlsIDReadAddress0 = 0
          FlsClockDelay = ONE_CYCLE
          FlsRpcFrequency = FREQ_80MHz
          FlsDummyCycle = 0
          FlsNegationDelay = FIVE_DOT_FIVE_CYCLES
          FlsNextAccessDelay = ONE_CYCLE
          FlsEnterCFI: FlsTransactionAddress=0, FlsTransactionData=0
          FlsExitCFI: FlsTransactionAddress=0, FlsTransactionData=0
        FlsHyperFlashErase:
          FlsCommand = 48
          FlsClockDelay = ONE_CYCLE
          FlsRpcFrequency = FREQ_80MHz
          FlsDummyCycle = 0
          FlsNegationDelay = FIVE_DOT_FIVE_CYCLES
          FlsNextAccessDelay = ONE_CYCLE
          FlsEraseSetupCycle: FlsTransactionAddress=0, FlsTransactionData=0
        FlsHyperFlashProgram: FlsClockDelay=ONE_CYCLE, FlsRpcFrequency=FREQ_80MHz, FlsDummyCycle=0, FlsNegationDelay=FIVE_DOT_FIVE_CYCLES, FlsNextAccessDelay=ONE_CYCLE
          FlsProgramSetupCycle: FlsTransactionAddress=0, FlsTransactionData=0
      FlsDemEventParameterRefs: FLS_E_CLOCK_SET_FAILURE=(unset)
    FlsGeneral:
      FlsAcLoadOnJobStart = false
      FlsBaseAddress = 2936012800
      FlsBlankCheckApi = false
      FlsInitCheckApi = false
      FlsEccErrorInfoApi = false
      FlsCancelApi = false
      FlsCompareApi = false
      FlsDevErrorDetect = true
      FlsRunTimeErrorDetect = true
      FlsSafetyEnable = true
      FlsIfxFeeUse = true
      FlsDriverIndex = 0
      FlsEraseVerificationEnabled = false
      FlsGetJobResultApi = false
      FlsGetStatusApi = false
      FlsSetModeApi = true
      FlsTimeoutSupervisionEnabled = false
      FlsTotalSize = 1048576
      FlsUseInterrupts = false
      FlsVersionInfoApi = false
      FlsWriteVerificationEnabled = false
      FlsInitApiMode = FLS_17_DMU_MCAL_SUPERVISOR
      FlsRuntimeApiMode = FLS_17_DMU_MCAL_SUPERVISOR
      FlsAccess = FLS_SERIAL_FLASH_DEVICE
      FlsCriticalSectionProtection = true
      FlsDeviceName = V4H
      FlsExclusiveControl = false
      FlsExternalSpaceReadMode = true
      FlsRuntimeErrorDetect = true
      FlsSelectPinGroup = FLS_QSPI0_PIN_GROUP
      FlsSemaphore = false
      FlsBurstLengthValue = 0
      FlsPageBufferWrap = FLS_PAGE_BUFFER_WRAP_256
      FlsTimeoutMonitoring = false
      FlsVersionCheckExternalModules = true
      FlsWriteBuffer = true
      FlsWriteVerifyCheck = false
      FlsCpgExclusiveControl = false
      FlsClockSetConfirmTimeout = 0.1
      FlsClockSetTendCheckTimeout = 0.1
      FlsExpectedHwIdMask = 0xFFFFFFFF
      FlsReadTime = 0.1
      FlsCpgWriteVerifyCheck = false
      FlsTransientFaultDetect = true
      FlsSuspendApi = false
      FlsResumeApi = false
      FlsSpecificConfigApi = false
      FlsOsCounterRef = (unset)
      FlsSerialFlashGeneral: FlsEnableEraseErrorBit=true, FlsEnableProgramErrorBit=true, FlsDDRCalibration=false
      FlsHyperFlashGeneral: FlsEnableEraseErrorBit=true, FlsEnableProgramErrorBit=true
    FlsPublishedInformation:
      FlsAcLocationErase = 0
      FlsAcLocationWrite = 0
      FlsAcSizeErase = 0
      FlsAcSizeWrite = 0
      FlsEraseTime = 1897500
      FlsErasedValue = 0
      FlsExpectedHwId = 0
      FlsSpecifiedEraseCycles = 125000
      FlsWriteTime = 5154
    FlsIfxSpecificConfig: FlsStateVarStruct=FlsStateVar, FlsUseEraseSuspend=false, FlsEraseSuspendTimeout=12000, FlsIllegalStateNotification=NULL_PTR
    CommonPublishedInformation:
      ArMajorVersion = 4
      ArMinorVersion = 4
      ArPatchVersion = 0
      SwMajorVersion = 20
      SwMinorVersion = 30
      SwPatchVersion = 0
      ModuleId = 92
      VendorId = 17
      VendorApiInfix = Dmu
      Release = _TRICORE_TC397_ADAS
