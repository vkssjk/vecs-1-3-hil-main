AUTOSAR XML (schema 00049)
package /ActiveEcuC
  module config Fls: implementation-config-variant=VARIANT-POST-BUILD, module-description=Fls_Impl
    FlsConfigSet:
      FlsAcErase = 0
      FlsAcWrite = 0
      FlsCallCycle = 0.01
      FlsDefaultMode = MEMIF_MODE_SLOW
      FlsMaxReadFastMode = 64
      FlsMaxReadNormalMode = 32
      FlsMaxWriteFastMode = 32
      FlsMaxWriteNormalMode = 32
      FlsProtection = 0
      FlsWaitStateRead = FLS_17_DMU_WAITSTATE_READ_9
      FlsWaitStateErrorCorrection = FLS_17_DMU_WAITSTATE_ERRCOREC_1
      FlsJobEndNotification = Fee_JobEndNotification
      FlsJobErrorNotification = Fee_JobErrorNotification
      FlsEraseVerifyErrNotif = Fee_17_JobEraseErrorNotification
      FlsProgVerifyErrNotif = Fee_17_JobProgErrorNotification
      FlsSectorList
        FlsSector: FlsNumberOfSectors=2, FlsPageSize=8, FlsSectorSize=524288, FlsSectorStartaddress=0
    FlsGeneral:
      FlsAcLoadOnJobStart = false
      FlsBaseAddress = 2936012800
      FlsBlankCheckApi = false
      FlsInitCheckApi = false
      FlsEccErrorInfoApi = false
      FlsCancelApi = false
      FlsCompareApi = false
      FlsDevErrorDetect = true
      FlsRunTimeErrorDetect = true
      FlsSafetyEnable = true
      FlsIfxFeeUse = true
      FlsDriverIndex = 0
      FlsEraseVerificationEnabled = false
      FlsGetJobResultApi = false
      FlsGetStatusApi = false
      FlsSetModeApi = true
      FlsTimeoutSupervisionEnabled = false
      FlsTotalSize = 1048576
      FlsUseInterrupts = false
      FlsVersionInfoApi = false
      FlsWriteVerificationEnabled = false
      FlsInitApiMode = FLS_17_DMU_MCAL_SUPERVISOR
      FlsRuntimeApiMode = FLS_17_DMU_MCAL_SUPERVISOR
    FlsPublishedInformation:
      FlsAcLocationErase = 0
      FlsAcLocationWrite = 0
      FlsAcSizeErase = 0
      FlsAcSizeWrite = 0
      FlsEraseTime = 1897500
      FlsErasedValue = 0
      FlsExpectedHwId = 0
      FlsSpecifiedEraseCycles = 125000
      FlsWriteTime = 5154
    FlsIfxSpecificConfig: FlsStateVarStruct=FlsStateVar, FlsUseEraseSuspend=false, FlsEraseSuspendTimeout=12000, FlsIllegalStateNotification=NULL_PTR
    CommonPublishedInformation:
      ArMajorVersion = 4
      ArMinorVersion = 4
      ArPatchVersion = 0
      SwMajorVersion = 20
      SwMinorVersion = 30
      SwPatchVersion = 0
      ModuleId = 92
      VendorId = 17
      VendorApiInfix = Dmu
      Release = _TRICORE_TC397_ADAS
