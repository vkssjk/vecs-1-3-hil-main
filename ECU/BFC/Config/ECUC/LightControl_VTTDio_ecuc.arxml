AUTOSAR XML (schema 00049)
package /ActiveEcuC
  module config VTTDio: implementation-config-variant=VARIANT-PRE-COMPILE, module-description=VTTDio_Impl
    DioGeneral: DioDevErrorDetect=false, DioFlipChannelApi=false, DioVersionInfoApi=false, DioSafeBswChecks=false
    DioConfig
      DioPort: DioPortId=33
        DioChannel_Output_HeadLight (DioChannel): DioChannelId=11
