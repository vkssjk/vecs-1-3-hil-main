AUTOSAR XML (schema 00049)
package /ActiveEcuC
  module config VTTCntrl: implementation-config-variant=VARIANT-PRE-COMPILE, module-description=VTTCntrl_Impl
    VttGeneral: VttEntryPointName=main, VttHeaderFile=, VttPreferredInputAsrVersion=4.2.1, VttRequiredEcucGeneratorVersion=1.0, VttUserCalloutOnStateChange=false
    VttSystemVariables
      3 x VttSysVarType:
        sint64
        float64
        uint64
