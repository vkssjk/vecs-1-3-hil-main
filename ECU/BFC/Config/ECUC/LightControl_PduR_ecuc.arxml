AUTOSAR XML (schema 00049)
package /ActiveEcuC
  module config PduR: implementation-config-variant=VARIANT-PRE-COMPILE, module-description=PduR_Impl
    PduRRoutingTables: PduRConfigurationId=0
      PduRRoutingTable
        5 x PduRRoutingPath, all with PduRMulticoreRoutingPath=false, PduRLockRef=PduRLock_PduRExclusiveArea:
          LightCtrl_oCAN00_2e88b3f5_Tx: PduRRoutingPathCommunicationType=COMMUNICATION_INTERFACE
            PduRSrcPdu_30bff602 (PduRSrcPdu): PduRSourcePduHandleId=0, PduRSrcPduDirection=TRANSMIT, PduRSrcPduRef=LightCtrl_oCAN00_2e88b3f5_Tx, PduRSrcPduPduRBswModulesRef=Com
            LightCtrl_oCAN00_0afee19e_Tx (PduRDestPdu):
              PduRDestPduHandleId = 0
              PduRDestPduDirection = TRANSMIT
              PduRDestPduRoutingType = API_FORWARDING
              PduRDestPduDataProcessing = IMMEDIATE
              PduRPduLengthHandlingStrategy = IGNORE
              PduRDestPduCrossPartitionDestination = false
              PduRDestPduDataProvision = PDUR_DIRECT
              PduRTransmissionConfirmation = false
              PduRDestPduRef = LightCtrl_oCAN00_0afee19e_Tx
              PduRDestPduPduRBswModulesRef = CanIf
          LightSwitch_oCAN00_8d4de26e_Rx: PduRRoutingPathCommunicationType=COMMUNICATION_INTERFACE
            LightSwitch_oCAN00_8d4de26e_Rx_d73f9532_Rx (PduRDestPdu):
              PduRDestPduHandleId = 0
              PduRDestPduDirection = RECEIVE
              PduRDestPduRoutingType = API_FORWARDING
              PduRDestPduDataProcessing = IMMEDIATE
              PduRPduLengthHandlingStrategy = IGNORE
              PduRDestPduCrossPartitionDestination = false
              PduRTransmissionConfirmation = false
              PduRDestPduRef = LightSwitch_oCAN00_d3b6d56e_Rx
              PduRDestPduPduRBswModulesRef = Com
            PduRSrcPdu_d73f9532 (PduRSrcPdu): PduRSourcePduHandleId=0, PduRSrcPduDirection=RECEIVE, PduRSrcPduRef=LightSwitch_oCAN00_8d4de26e_Rx, PduRSrcPduPduRBswModulesRef=CanIf
          Msg_Diag_Response_BFC_oCAN00_61e49ee1_Tx: PduRRoutingPathCommunicationType=TRANSPORT_PROTOCOL
            Msg_Diag_Response_BFC_oCAN00_68c05815_Tx (PduRDestPdu):
              PduRDestPduHandleId = 0
              PduRDestPduDirection = TRANSMIT
              PduRDestPduRoutingType = API_FORWARDING
              PduRDestPduDataProcessing = IMMEDIATE
              PduRPduLengthHandlingStrategy = UNUSED
              PduRDestPduCrossPartitionDestination = false
              PduRDestPduRef = Msg_Diag_Response_BFC_oCAN00_68c05815_Tx
              PduRDestPduPduRBswModulesRef = CanTp
            PduRSrcPdu_07e648d9 (PduRSrcPdu): PduRSourcePduHandleId=1, PduRSrcPduDirection=TRANSMIT, PduRSrcPduRef=Msg_Diag_Response_BFC_oCAN00_61e49ee1_Tx, PduRSrcPduPduRBswModulesRef=Dcm
          Msg_Diag_Request_BFC_oCAN00_7ad4193d_Rx: PduRRoutingPathCommunicationType=TRANSPORT_PROTOCOL
            Msg_Diag_Request_BFC_oCAN00_7ad4193d_Rx_4456ad7e_Rx (PduRDestPdu):
              PduRDestPduHandleId = 0
              PduRDestPduDirection = RECEIVE
              PduRDestPduRoutingType = API_FORWARDING
              PduRDestPduDataProcessing = IMMEDIATE
              PduRPduLengthHandlingStrategy = UNUSED
              PduRDestPduCrossPartitionDestination = false
              PduRDestPduRef = Msg_Diag_Request_BFC_oCAN00_dced82e4_Rx
              PduRDestPduPduRBswModulesRef = Dcm
            PduRSrcPdu_4456ad7e (PduRSrcPdu): PduRSourcePduHandleId=0, PduRSrcPduDirection=RECEIVE, PduRSrcPduRef=Msg_Diag_Request_BFC_oCAN00_7ad4193d_Rx, PduRSrcPduPduRBswModulesRef=CanTp
          Msg_Diag_Request_Global_oCAN00_4d90f286_Rx: PduRRoutingPathCommunicationType=TRANSPORT_PROTOCOL
            PduRSrcPdu_46121bfc (PduRSrcPdu): PduRSourcePduHandleId=1, PduRSrcPduDirection=RECEIVE, PduRSrcPduRef=Msg_Diag_Request_Global_oCAN00_4d90f286_Rx, PduRSrcPduPduRBswModulesRef=CanTp
            Msg_Diag_Request_Global_oCAN00_4d90f286_Rx_46121bfc_Rx (PduRDestPdu):
              PduRDestPduHandleId = 1
              PduRDestPduDirection = RECEIVE
              PduRDestPduRoutingType = API_FORWARDING
              PduRDestPduDataProcessing = IMMEDIATE
              PduRPduLengthHandlingStrategy = UNUSED
              PduRDestPduCrossPartitionDestination = false
              PduRDestPduRef = Msg_Diag_Request_Global_oCAN00_85e930b7_Rx
              PduRDestPduPduRBswModulesRef = Dcm
      PduRLock_PduRExclusiveArea (PduRLock)
        PduRExclusiveArea: PduRExclusiveAreaId=0
    PduRGeneral:
      PduRDevErrorDetect = true
      PduRVersionInfoApi = false
      PduRMetaDataSupport = false
      PduRPduCallback = false
      PduRSafeBswChecks = false
      PduREnableDeferredTransmission = false
      PduREnableDeferredReception = false
      PduRSupportMulticore = false
      PduRRoutingTypeGateway = false
      PduRSpinlockRetryCounter = 4294967295
      PduRExtendedErrorChecks = false
      PduRGeneration:
        PduROutOfBoundsWriteProtectionStrategy = NONE
        PduROutOfBoundsWriteSanitizer = false
        PduROutOfBoundsReadSanitizer = false
        PduRNumericalDataTypeMinimizationStrategy = WITH_CAST
        PduRReduceConstantData2Define = false
        PduRBoolDataInArrayOfStructStrategy = BITMASKING
        PduRDeduplicateIndirectedData = true
        PduRDataDeduplicationStrategy = WITH_CAST
        PduRReduceBoolDataByNegationThreshold = 2
        PduRReduceBoolDataByNumericalComparisonThreshold = 2
        PduRReduceBoolDataByNumericalRelationThreshold = 2
        PduRReduceBoolDataByNumericalOperandStrategy = WITH_ANY_VALUE
        PduRReduceNumericalDataByOffsetThreshold = 2
        PduRReduceNumericalDataByArraySubtractionThreshold = 2
        PduRReduceDataByStreaming = false
        PduRShortSymbols = false
        PduRInterfacesForDeactivatedData = false
        PduRReferringKeysInComments = false
    4 x PduRBswModules, all with PduRCancelReceive=false, PduRChangeParameterRequestApi=false, PduRTriggertransmit=false, PduRTxConfirmation=false:
      CanIf: PduRCancelTransmit=false, PduRCommunicationInterface=true, PduRLowerModule=true, PduRTransportProtocol=false, PduRUpperModule=false, PduRUseTag=false, PduRBswModuleRef=CanIf
      Com: PduRCancelTransmit=false, PduRCommunicationInterface=true, PduRLowerModule=false, PduRTransportProtocol=false, PduRUpperModule=true, PduRUseTag=false, PduRBswModuleRef=Com
      CanTp: PduRCancelTransmit=false, PduRCommunicationInterface=false, PduRLowerModule=true, PduRTransportProtocol=true, PduRUpperModule=false, PduRUseTag=false, PduRBswModuleRef=CanTp
      Dcm: PduRCancelTransmit=true, PduRCommunicationInterface=false, PduRLowerModule=false, PduRTransportProtocol=true, PduRUpperModule=true, PduRUseTag=true, PduRBswModuleRef=Dcm
