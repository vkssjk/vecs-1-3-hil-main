AUTOSAR XML (schema 00049)
package /ActiveEcuC
  module config VTTMcu: implementation-config-variant=VARIANT-PRE-COMPILE, module-description=VTTMcu_Impl
    McuPublishedInformation
      21 x McuResetReasonConf:
        MCU_SUPPLY_WDOG_RESET: McuResetReason=16
        MCU_STBYR_RESET: McuResetReason=17
        MCU_STM1_RESET: McuResetReason=5
        MCU_SW_RESET: McuResetReason=3
        MCU_POWER_ON_RESET: McuResetReason=10
        MCU_CB3_RESET: McuResetReason=13
        MCU_LBIST_RESET: McuResetReason=18
        MCU_ESR1_RESET: McuResetReason=1
        MCU_RESET_MULTIPLE: McuResetReason=254
        MCU_SMU_RESET: McuResetReason=2
        MCU_STM0_RESET: McuResetReason=4
        MCU_CB0_RESET: McuResetReason=11
        MCU_STM3_RESET: McuResetReason=7
        MCU_ESR0_RESET: McuResetReason=0
        MCU_RESET_UNDEFINED: McuResetReason=255
        MCU_EVR33_RESET: McuResetReason=15
        MCU_CB1_RESET: McuResetReason=12
        MCU_EVRC_RESET: McuResetReason=14
        MCU_STM2_RESET: McuResetReason=6
        MCU_STM4_RESET: McuResetReason=8
        MCU_STM5_RESET: McuResetReason=9
    McuGeneralConfiguration:
      McuDevErrorDetect = false
      McuGetRamStateApi = false
      McuInitClock = true
      McuNoPll = false
      McuPerformResetApi = true
      McuVersionInfoApi = false
      McuSafeBswChecks = false
    McuModuleConfiguration: McuClockSrcFailureNotification=DISABLED, McuNumberOfMcuModes=1, McuRamSectors=0
      McuClockSettingConfig_0 (McuClockSettingConfig): McuClockSettingId=0
        McuClockReferencePoint_CAN (McuClockReferencePoint): McuClockReferencePointFrequency=20000000
      McuModeSettingConf_0 (McuModeSettingConf): McuMode=0, McuVttMode=VTTMCU_MODE_NORMAL
