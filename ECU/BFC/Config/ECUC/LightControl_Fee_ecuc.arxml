AUTOSAR XML (schema 00049)
package /ActiveEcuC
  module config Fee: implementation-config-variant=VARIANT-POST-BUILD, module-description=Fee_Impl
    FeeGeneral:
      FeeDevErrorDetect = true
      FeeSafetyEnable = false
      FeeInitCheckApi = false
      FeeMainFunctionPeriod = 0.01
      FeePollingMode = false
      FeeSetModeSupported = true
      FeeVersionInfoApi = false
      FeeVirtualPageSize = 8
      FeeBlockTypeConfigured = FEE_DOUBLE_SECTOR_DATA_ONLY
    FeePublishedInformation: FeeBlockOverhead=17, FeePageOverhead=1
    FeeIfxSpecificConfig:
      FeeThresholdValue = 200
      FeeMaxBlockCount = 16
      FeeRunTimeErrorDetect = true
      FeeBlocksScannedPerCycle = 0
      FeeUseEraseSuspend = false
      FeeStateVarStructure = Fee_StateVar
      FeeUnConfigBlock = FEE_UNCONFIG_BLOCK_IGNORE
      FeeUnConfigBlkOverflowHandle = FEE_CONTINUE
      FeeGcRestart = FEE_GC_RESTART_INIT
      FeeGetCycleCountApi = false
      FeeEccErrorInfoApi = false
      FeeEraseAllEnable = true
      FeeGetPrevDataApi = false
      FeeCancelAllApi = false
      FeeMaxBytesPerCycle = FEE_MAX_BYTES_512
      FeeNvmIllegalStateNotification = NULL_PTR
      FeeQsIllegalStateNotification = NULL_PTR
      FeeQsHardenErrorNotification = NULL_PTR
      FeeVirginFlashIllegalState = false
      FeeOngoingWriteCancelSupport = false
    CommonPublishedInformation:
      ArMajorVersion = 4
      ArMinorVersion = 4
      ArPatchVersion = 0
      SwMajorVersion = 20
      SwMinorVersion = 30
      SwPatchVersion = 0
      ModuleId = 21
      VendorId = 17
      Release = _TRICORE_TC397_ADAS
    10 x FeeBlockConfiguration, all with FeeQsBlockInstances=0, FeeQsBlockAddress=0, FeeQuasiStaticManager=false, FeeNumberOfWriteCycles=0, FeeDeviceIndex=FlsGeneral:
      FeeBlockDescriptor_ApplValidity: FeeBlockNumber=128, FeeBlockSize=3, FeeImmediateData=false
      FeeBlockDescriptor_DcmDslRxTesterSourceAddr: FeeBlockNumber=16, FeeBlockSize=4, FeeImmediateData=false
      FeeBlockDescriptor_MetaData: FeeBlockNumber=32, FeeBlockSize=13, FeeImmediateData=true
      FeeBlockDescriptor_ProgReqFlag: FeeBlockNumber=48, FeeBlockSize=3, FeeImmediateData=false
      FeeBlockDescriptor_ResetResponseFlag: FeeBlockNumber=64, FeeBlockSize=1, FeeImmediateData=true
      FeeBlockDescriptor_SecAccessDelayFlag: FeeBlockNumber=80, FeeBlockSize=1, FeeImmediateData=true
      FeeBlockDescriptor_SecAccessInvalidCount: FeeBlockNumber=96, FeeBlockSize=1, FeeImmediateData=true
      FeeBlockDescriptor_ValidityFlags: FeeBlockNumber=112, FeeBlockSize=1, FeeImmediateData=true
      FeeBlockDescriptor_MetaData_cons0: FeeBlockNumber=33, FeeBlockSize=13, FeeImmediateData=true
      FeeBlockDescriptor_MetaData_cons1: FeeBlockNumber=34, FeeBlockSize=13, FeeImmediateData=true
    FeeDemEventParameterRefs:
      FEE_E_GC_ERASE = DemEventParameter
      FEE_E_GC_INIT = DemEventParameter
      FEE_E_GC_READ = DemEventParameter
      FEE_E_GC_TRIG = DemEventParameter
      FEE_E_GC_WRITE = DemEventParameter
      FEE_E_INVALIDATE = DemEventParameter
      FEE_E_READ = DemEventParameter
      FEE_E_UNCONFIG_BLK_EXCEEDED = DemEventParameter
      FEE_E_WRITE = DemEventParameter
      FEE_E_WRITE_CYCLES_EXHAUSTED = DemEventParameter
    FeeBlockConfiguration:
      FeeBlockNumber = 416
      FeeQsBlockInstances = 0
      FeeQsBlockAddress = 0
      FeeQuasiStaticManager = false
      FeeBlockSize = 4
      FeeImmediateData = false
      FeeNumberOfWriteCycles = 0
      FeeDeviceIndex = FlsGeneral
    FeeBlockConfiguration_cons0 (FeeBlockConfiguration):
      FeeBlockNumber = 417
      FeeQsBlockInstances = 0
      FeeQsBlockAddress = 0
      FeeQuasiStaticManager = false
      FeeBlockSize = 4
      FeeImmediateData = false
      FeeNumberOfWriteCycles = 0
      FeeDeviceIndex = FlsGeneral
