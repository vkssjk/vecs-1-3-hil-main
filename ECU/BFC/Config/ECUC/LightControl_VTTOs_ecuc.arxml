AUTOSAR XML (schema 00049)
package /ActiveEcuC
  module config VTTOs: implementation-config-variant=VARIANT-PRE-COMPILE, module-description=Os_Impl
    OsOS:
      OsStackMonitoring = true
      OsStatus = EXTENDED
      OsUseGetServiceId = false
      OsUseParameterAccess = false
      OsUseResScheduler = true
      OsScalabilityClass = SC1
      OsGenerateMemMap = EMPTY
      OsGenerateMemMapForThreads = false
      OsForcibleTermination = false
      OsStackUsageMeasurement = false
      OsNumberOfCores = 1
      OsUseXSignalAsyncApiCalls = false
      OsGenerateMemMapForNearAddressing = true
      OsGenerateCalloutStubs = true
      OsServiceProtection = false
      OsFpuUsage = NONE
      OsUseCase = STANDARD
      OsUseArti = false
      OsMasterCore = OsCore
      OsHooks: OsErrorHook=false, OsPostTaskHook=false, OsPreTaskHook=false, OsShutdownHook=false, OsStartupHook=false, OsProtectionHook=false
      OsStackSummary
        8 x OsStack, all with OsStackCore=OsCore:
          OsCore_Kernel: OsStackSize=1024, OsStackType=CORE_KERNEL_STACK, OsStackUser=OsCore
          OsCore_Init: OsStackSize=1024, OsStackType=CORE_INIT_STACK, OsStackUser=OsCore
          OsCore_Isr_Core: OsStackSize=1024, OsStackType=ISR_SHARED_CORE_STACK, OsStackUser=CanIsrRx_0, OsStackUser=AdcIsr_0, OsStackUser=CanIsrErr_0, OsStackUser=CanIsrTx_0, OsStackUser=CanIsrWakeup_0, OsStackUser=CounterIsr_SystemTimer
          BswTask: OsStackSize=320, OsStackType=TASK_EXTENDED_STACK, OsStackUser=VTTOs/BswTask
          IoTask: OsStackSize=320, OsStackType=TASK_EXTENDED_STACK, OsStackUser=VTTOs/IoTask
          OsCore_Task_Prio4294967295: OsStackSize=1024, OsStackType=TASK_SHARED_PRIORITY_STACK, OsStackUser=IdleTask_OsCore
          SwcTask: OsStackSize=320, OsStackType=TASK_EXTENDED_STACK, OsStackUser=VTTOs/SwcTask
          OsCore_Task_NonPreemptiveBasic: OsStackSize=1024, OsStackType=TASK_SHARED_NONPRE_STACK, OsStackUser=Default_Init_Task, OsStackUser=Default_Init_Task_Trusted
    OSDEFAULTAPPMODE (OsAppMode)
    RES_SCHEDULER_OsCore (OsResource): OsResourceProperty=STANDARD, OsResourceAccessingApplication=SystemApplication_OsCore
    Rte_Ev_Cyclic2_BswTask_0_10ms (OsEvent)
    3 x OsTask, all with OsTaskActivation=1, OsTaskSchedule=NON, OsTaskStackSharing=false, OsTaskStackSize=320, OsTaskType=AUTO, OsTaskUsesFpu=false, OsTaskAccessingApplication=SystemApplication_OsCore, OsTaskResourceRef=RES_SCHEDULER_OsCore:
      IoTask: OsTaskPriority=3, OsTaskEventRef=Rte_Ev_Run_IoHwAb_IoHwAb_IoHwAb_IoHwAbHandler
      BswTask: OsTaskPriority=2, OsTaskEventRef=Rte_Ev_Cyclic2_BswTask_0_10ms, OsTaskEventRef=Rte_Ev_Cyclic2_BswTask_0_20ms, OsTaskEventRef=Rte_Ev_Cyclic2_BswTask_0_1s, OsTaskEventRef=Rte_Ev_Run_CanTp_CanTp_MainFunction
      SwcTask: OsTaskPriority=1, OsTaskEventRef=Rte_Ev_Cyclic_SwcTask_0_10ms, OsTaskEventRef=Rte_Ev_Run_LightCtrl_ECU_Reset, OsTaskEventRef=Rte_Ev_Run_LightCtrl_ECU_Reset_Execution
    Rte_Al_TE2_BswTask_0_20ms (OsAlarm): OsAlarmCounterRef=SystemTimer, OsAlarmAccessingApplication=SystemApplication_OsCore
      OsAlarmAction
        OsAlarmSetEvent: OsAlarmSetEventRef=Rte_Ev_Cyclic2_BswTask_0_20ms, OsAlarmSetEventTaskRef=VTTOs/BswTask
    Rte_Ev_Cyclic2_BswTask_0_20ms (OsEvent)
    Rte_Al_TE2_BswTask_0_10ms (OsAlarm): OsAlarmCounterRef=SystemTimer, OsAlarmAccessingApplication=SystemApplication_OsCore
      OsAlarmAction
        OsAlarmSetEvent: OsAlarmSetEventRef=Rte_Ev_Cyclic2_BswTask_0_10ms, OsAlarmSetEventTaskRef=VTTOs/BswTask
    SystemTimer (OsCounter):
      OsCounterMinCycle = 1
      OsCounterTicksPerBase = 1
      OsCounterType = HARDWARE
      OsCounterAlgorithm = HEAP
      OsSecondsPerTick = 0.001
      OsCounterMaxAllowedValue = 2147483647
      OsCounterAccessingApplication = SystemApplication_OsCore
      OsDriver: OsDriverHighResolution=false, OsDriverHardwareTimerChannelRef=STM0_Ch0, OsDriverIsrRef=CounterIsr_SystemTimer
    Rte_Al_TE_IoHwAb_IoHwAb_IoHwAb_IoHwAbHandler (OsAlarm): OsAlarmCounterRef=SystemTimer, OsAlarmAccessingApplication=SystemApplication_OsCore
      OsAlarmAction
        OsAlarmSetEvent: OsAlarmSetEventRef=Rte_Ev_Run_IoHwAb_IoHwAb_IoHwAb_IoHwAbHandler, OsAlarmSetEventTaskRef=VTTOs/IoTask
    5 x OsIsr, all with OsIsrCategory=CATEGORY_2, OsIsrEnableNesting=false, OsIsrInterruptType=EXTERNAL, OsIsrStackSize=1024, OsIsrUsesFpu=false:
      AdcIsr_0: OsIsrInterruptPriority=5, OsIsrInterruptSource=0, OsIsrInitialEnableInterruptSource=true  # Os Interrupt Service Routine PLAIN_TEXT ADC Completed Interrupt for 0. This OsInterrupt container has been created automatically based on the driver conﬁguration
      CanIsrRx_0: OsIsrInterruptPriority=10, OsIsrInterruptSource=1, OsIsrInitialEnableInterruptSource=false  # /ActiveEcuC/VTTCan PLAIN_TEXT Can RX messages event (common for all controllers)
      CanIsrTx_0: OsIsrInterruptPriority=10, OsIsrInterruptSource=2, OsIsrInitialEnableInterruptSource=false  # /ActiveEcuC/VTTCan PLAIN_TEXT Can TX messages event (common for all controllers)
      CanIsrErr_0: OsIsrInterruptPriority=10, OsIsrInterruptSource=3, OsIsrInitialEnableInterruptSource=false  # /ActiveEcuC/VTTCan PLAIN_TEXT Can BusOff event (common for all controllers)
      CanIsrWakeup_0: OsIsrInterruptPriority=10, OsIsrInterruptSource=4, OsIsrInitialEnableInterruptSource=false  # /ActiveEcuC/VTTCan PLAIN_TEXT Can Wakeup event (common for all controllers)
    Rte_Ev_Run_IoHwAb_IoHwAb_IoHwAb_IoHwAbHandler (OsEvent)
    Rte_Al_TE_SwcTask_0_10ms (OsAlarm): OsAlarmCounterRef=SystemTimer, OsAlarmAccessingApplication=SystemApplication_OsCore
      OsAlarmAction
        OsAlarmSetEvent: OsAlarmSetEventRef=Rte_Ev_Cyclic_SwcTask_0_10ms, OsAlarmSetEventTaskRef=VTTOs/SwcTask
    Rte_Ev_Cyclic_SwcTask_0_10ms (OsEvent)
    OsPublishedInformation: OsKernelVersion=7, OsPlatformName=TriCoreAurix
      TC38x (OsDerivativeInformation):
        OsMpuAlignment = 8
        OsMpuEndAddressAccessible = false
        OsMpuPrivilegedRegionsConfigurable = false
        OsStackAlignment = 8
        OsInterruptVectorTableAlignment = 8192
        OsExceptionVectorTableAlignment = 256
        OsHardwareManuals = User Manual: TC3XX_ts__TargetSpec_rev1v3v0.pdf V1.3.0, 2016-02 TC38X_ts_appx_V2.3.0.pdf V2.3.0 2017-09
        OsMpuMemoryGapSize = 16
        AURIXTC3XX_IR (OsSystemIntCtrl): OsSystemIntCtrlMaxSources=4092, OsSystemIntCtrlMaxPrios=255, OsSystemIntCtrlPrioOrder=ASC, OsSystemIntCtrlBaseAddress=4026757120
        DMA (OsInterruptSupportedType):
          OsInterruptSupportedTypeSeparateSources = false
          OsInterruptSupportedTypeSeparatePriority = true
          OsInterruptSupportedTypeIsMapped = false
          OsInterruptSupportedTypePostActionRequired = false
        5 x OsHardwareTimer:
          GPT: OsHardwareTimerId=0, OsHardwareTimerUnit=PIT, OsHardwareTimerSize=16, OsHardwareTimerBaseAddress=4026537984, OsHardwareTimerType=PIT
            GPT_Ch0 (OsHardwareTimerChannel): OsHardwareTimerChannelId=0, OsHardwareTimerChannelIntSource=744, OsHardwareTimerChannelOffset=0
            GPT_Ch1 (OsHardwareTimerChannel): OsHardwareTimerChannelId=1, OsHardwareTimerChannelIntSource=756, OsHardwareTimerChannelOffset=1
          STM0: OsHardwareTimerId=0, OsHardwareTimerUnit=FRT, OsHardwareTimerSize=32, OsHardwareTimerBaseAddress=4026535936, OsHardwareTimerType=STM
            STM0_Ch0 (OsHardwareTimerChannel): OsHardwareTimerChannelId=0, OsHardwareTimerChannelIntSource=768, OsHardwareTimerChannelOffset=0
            STM0_Ch1 (OsHardwareTimerChannel): OsHardwareTimerChannelId=1, OsHardwareTimerChannelIntSource=772, OsHardwareTimerChannelOffset=1
          STM3: OsHardwareTimerId=3, OsHardwareTimerUnit=FRT, OsHardwareTimerSize=32, OsHardwareTimerBaseAddress=4026536704, OsHardwareTimerType=STM
            STM3_Ch0 (OsHardwareTimerChannel): OsHardwareTimerChannelId=0, OsHardwareTimerChannelIntSource=792, OsHardwareTimerChannelOffset=0
            STM3_Ch1 (OsHardwareTimerChannel): OsHardwareTimerChannelId=1, OsHardwareTimerChannelIntSource=796, OsHardwareTimerChannelOffset=1
          STM1: OsHardwareTimerId=1, OsHardwareTimerUnit=FRT, OsHardwareTimerSize=32, OsHardwareTimerBaseAddress=4026536192, OsHardwareTimerType=STM
            STM1_Ch1 (OsHardwareTimerChannel): OsHardwareTimerChannelId=1, OsHardwareTimerChannelIntSource=780, OsHardwareTimerChannelOffset=1
            STM1_Ch0 (OsHardwareTimerChannel): OsHardwareTimerChannelId=0, OsHardwareTimerChannelIntSource=776, OsHardwareTimerChannelOffset=0
          STM2: OsHardwareTimerId=2, OsHardwareTimerUnit=FRT, OsHardwareTimerSize=32, OsHardwareTimerBaseAddress=4026536448, OsHardwareTimerType=STM
            STM2_Ch0 (OsHardwareTimerChannel): OsHardwareTimerChannelId=0, OsHardwareTimerChannelIntSource=784, OsHardwareTimerChannelOffset=0
            STM2_Ch1 (OsHardwareTimerChannel): OsHardwareTimerChannelId=1, OsHardwareTimerChannelIntSource=788, OsHardwareTimerChannelOffset=1
        4 x OsPhysicalCore, all with OsPhysicalCoreExceptionSources=8, OsPhysicalCorePrivelegedHwAccess=true, OsPhysicalCoreType=TC1.6.2P:
          Core2: OsPhysicalCoreId=2, OsPhysicalCoreIsAutostart=false, OsPhysicalCoreMasterStartAllowed=false, OsPhysicalCoreDefaultEntrySymbol=_start_tc2, OsPhysicalCoreStackProtectionUnit=OsPhysicalCore2DataMpu
            OsPhysicalCore2DataMpu (OsPhysicalCoreMpu): OsPhysicalCoreMpuId=0, OsPhysicalCoreMpuMaxRegions=18, OsPhysicalCoreMpuType=DATA
            OsPhysicalCore2CodeMpu (OsPhysicalCoreMpu): OsPhysicalCoreMpuId=1, OsPhysicalCoreMpuMaxRegions=10, OsPhysicalCoreMpuType=CODE
          Core3: OsPhysicalCoreId=3, OsPhysicalCoreIsAutostart=false, OsPhysicalCoreMasterStartAllowed=false, OsPhysicalCoreDefaultEntrySymbol=_start_tc3, OsPhysicalCoreStackProtectionUnit=OsPhysicalCore3DataMpu
            OsPhysicalCore3CodeMpu (OsPhysicalCoreMpu): OsPhysicalCoreMpuId=1, OsPhysicalCoreMpuMaxRegions=10, OsPhysicalCoreMpuType=CODE
            OsPhysicalCore3DataMpu (OsPhysicalCoreMpu): OsPhysicalCoreMpuId=0, OsPhysicalCoreMpuMaxRegions=18, OsPhysicalCoreMpuType=DATA
          Core1: OsPhysicalCoreId=1, OsPhysicalCoreIsAutostart=false, OsPhysicalCoreMasterStartAllowed=false, OsPhysicalCoreDefaultEntrySymbol=_start_tc1, OsPhysicalCoreStackProtectionUnit=OsPhysicalCore1DataMpu
            OsPhysicalCore1DataMpu (OsPhysicalCoreMpu): OsPhysicalCoreMpuId=0, OsPhysicalCoreMpuMaxRegions=18, OsPhysicalCoreMpuType=DATA
            OsPhysicalCore1CodeMpu (OsPhysicalCoreMpu): OsPhysicalCoreMpuId=1, OsPhysicalCoreMpuMaxRegions=10, OsPhysicalCoreMpuType=CODE
          Core0: OsPhysicalCoreId=0, OsPhysicalCoreIsAutostart=true, OsPhysicalCoreMasterStartAllowed=true, OsPhysicalCoreDefaultEntrySymbol=_start_tc0, OsPhysicalCoreStackProtectionUnit=OsPhysicalCore0DataMpu
            OsPhysicalCore0DataMpu (OsPhysicalCoreMpu): OsPhysicalCoreMpuId=0, OsPhysicalCoreMpuMaxRegions=18, OsPhysicalCoreMpuType=DATA
            OsPhysicalCore0CodeMpu (OsPhysicalCoreMpu): OsPhysicalCoreMpuId=1, OsPhysicalCoreMpuMaxRegions=10, OsPhysicalCoreMpuType=CODE
        OsMemoryRegionSpecifics
          18 x OsMemoryRegionAccess:
            PS3_R: OsMemoryRegionAccessRights=R, OsMemoryRegionAccessType=PROTECTION_SET3
            PS3_X: OsMemoryRegionAccessRights=X, OsMemoryRegionAccessType=PROTECTION_SET3
            PS0_R: OsMemoryRegionAccessRights=R, OsMemoryRegionAccessType=PROTECTION_SET0
            PS5_X: OsMemoryRegionAccessRights=X, OsMemoryRegionAccessType=PROTECTION_SET5
            PS1_X: OsMemoryRegionAccessRights=X, OsMemoryRegionAccessType=PROTECTION_SET1
            PS1_W: OsMemoryRegionAccessRights=W, OsMemoryRegionAccessType=PROTECTION_SET1
            PS2_W: OsMemoryRegionAccessRights=W, OsMemoryRegionAccessType=PROTECTION_SET2
            PS2_R: OsMemoryRegionAccessRights=R, OsMemoryRegionAccessType=PROTECTION_SET2
            PS2_X: OsMemoryRegionAccessRights=X, OsMemoryRegionAccessType=PROTECTION_SET2
            PS0_W: OsMemoryRegionAccessRights=W, OsMemoryRegionAccessType=PROTECTION_SET0
            PS5_R: OsMemoryRegionAccessRights=R, OsMemoryRegionAccessType=PROTECTION_SET5
            PS0_X: OsMemoryRegionAccessRights=X, OsMemoryRegionAccessType=PROTECTION_SET0
            PS5_W: OsMemoryRegionAccessRights=W, OsMemoryRegionAccessType=PROTECTION_SET5
            PS4_X: OsMemoryRegionAccessRights=X, OsMemoryRegionAccessType=PROTECTION_SET4
            PS3_W: OsMemoryRegionAccessRights=W, OsMemoryRegionAccessType=PROTECTION_SET3
            PS1_R: OsMemoryRegionAccessRights=R, OsMemoryRegionAccessType=PROTECTION_SET1
            PS4_R: OsMemoryRegionAccessRights=R, OsMemoryRegionAccessType=PROTECTION_SET4
            PS4_W: OsMemoryRegionAccessRights=W, OsMemoryRegionAccessType=PROTECTION_SET4
    OS_APPMODE_ANY (OsAppMode)
    SystemApplication_OsCore (OsApplication):
      OsTrusted = true
      OsTrustedApplicationDelayTimingViolationCall = false
      OsTrustedApplicationWithProtection = false
      OsApplicationIsPrivileged = true
      OsAppUseTrustedFunctionStubs = false
      OsAppAlarmRef = Rte_Al_TE2_BswTask_0_10ms
      OsAppAlarmRef = Rte_Al_TE2_BswTask_0_20ms
      OsAppAlarmRef = Rte_Al_TE2_BswTask_0_1s
      OsAppAlarmRef = Rte_Al_TE_IoHwAb_IoHwAb_IoHwAb_IoHwAbHandler
      OsAppAlarmRef = Rte_Al_TE_SwcTask_0_10ms
      OsApplicationCoreRef = EcucCoreDefinition
      OsAppTaskRef = IdleTask_OsCore
      OsAppTaskRef = VTTOs/BswTask
      OsAppTaskRef = VTTOs/IoTask
      OsAppTaskRef = VTTOs/SwcTask
      OsAppTaskRef = Default_Init_Task
      OsAppCounterRef = SystemTimer
      OsAppIsrRef = CanIsrWakeup_0
      OsAppIsrRef = CanIsrTx_0
      OsAppIsrRef = CanIsrRx_0
      OsAppIsrRef = CanIsrErr_0
      OsAppIsrRef = AdcIsr_0
      OsAppIsrRef = CounterIsr_SystemTimer
      OsAppTaskRef = Default_Init_Task_Trusted
      OsAppAlarmRef = Rte_Al_TE_CanTp_CanTp_MainFunction
      OsApplicationHooks: OsAppErrorHook=false, OsAppShutdownHook=false, OsAppStartupHook=false
    IdleTask_OsCore (OsTask):
      OsTaskActivation = 1
      OsTaskPriority = 4294967295
      OsTaskSchedule = FULL
      OsTaskStackSharing = false
      OsTaskStackSize = 1024
      OsTaskType = AUTO
      OsTaskUsesFpu = false
      OsTaskAccessingApplication = SystemApplication_OsCore
      OsTaskResourceRef = RES_SCHEDULER_OsCore
      OsTaskAutostart: OsTaskAppModeRef=OS_APPMODE_ANY
    CounterIsr_SystemTimer (OsIsr):
      OsIsrCategory = CATEGORY_2
      OsIsrInterruptType = EXTERNAL
      OsIsrInterruptSource = 5
      OsIsrInterruptPriority = 20
      OsIsrStackSize = 1024
      OsIsrEnableNesting = false
      OsIsrSpecialFunctionName = Os_TimerPfrtIsr
      OsIsrUsesFpu = false
      OsIsrInitialEnableInterruptSource = false
    OsCore:
      OsCoreIsAutostart = true
      OsCoreIsAutosar = true
      OsCoreEntrySymbol = _start_tc0
      OsCorePhysicalCoreRef = Core0
      OsCoreSystemApplication = SystemApplication_OsCore
      OsCoreEcucCoreRef = EcucCoreDefinition
      OsCoreResScheduler = RES_SCHEDULER_OsCore
      OsCoreIdleTask = IdleTask_OsCore
      OsCoreStacks:
        OsCoreKernelStackSize = 1024
        OsCoreStartupStackSize = 1024
        OsCoreShutdownStackSize = 1024
        OsCoreErrorStackSize = 1024
        OsCoreProtectionStackSize = 1024
        OsCoreInitStackSize = 1024
    Rte_Ev_Cyclic2_BswTask_0_1s (OsEvent)
    Rte_Al_TE2_BswTask_0_1s (OsAlarm): OsAlarmCounterRef=SystemTimer, OsAlarmAccessingApplication=SystemApplication_OsCore
      OsAlarmAction
        OsAlarmSetEvent: OsAlarmSetEventRef=Rte_Ev_Cyclic2_BswTask_0_1s, OsAlarmSetEventTaskRef=VTTOs/BswTask
    Default_Init_Task (OsTask):
      OsTaskActivation = 1
      OsTaskPriority = 50
      OsTaskSchedule = NON
      OsTaskStackSharing = true
      OsTaskStackSize = 1024
      OsTaskType = BASIC
      OsTaskUsesFpu = false
      OsTaskAccessingApplication = SystemApplication_OsCore
      OsTaskResourceRef = RES_SCHEDULER_OsCore
      OsTaskAutostart: OsTaskAppModeRef=OSDEFAULTAPPMODE
    Default_Init_Task_Trusted (OsTask):
      OsTaskActivation = 1
      OsTaskPriority = 49
      OsTaskSchedule = NON
      OsTaskStackSharing = true
      OsTaskStackSize = 1024
      OsTaskType = BASIC
      OsTaskUsesFpu = false
      OsTaskAccessingApplication = SystemApplication_OsCore
      OsTaskResourceRef = RES_SCHEDULER_OsCore
      OsTaskAutostart: OsTaskAppModeRef=OSDEFAULTAPPMODE
    Rte_Al_TE_CanTp_CanTp_MainFunction (OsAlarm): OsAlarmCounterRef=SystemTimer, OsAlarmAccessingApplication=SystemApplication_OsCore
      OsAlarmAction
        OsAlarmSetEvent: OsAlarmSetEventRef=Rte_Ev_Run_CanTp_CanTp_MainFunction, OsAlarmSetEventTaskRef=VTTOs/BswTask
    3 x OsEvent:
      Rte_Ev_Run_CanTp_CanTp_MainFunction
      Rte_Ev_Run_LightCtrl_ECU_Reset
      Rte_Ev_Run_LightCtrl_ECU_Reset_Execution
