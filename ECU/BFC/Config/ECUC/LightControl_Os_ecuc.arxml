AUTOSAR XML (schema 00049)
package /ActiveEcuC
  module config Os: implementation-config-variant=VARIANT-PRE-COMPILE, module-description=Os_Impl
    SystemTimer (OsCounter):
      OsCounterMinCycle = 1
      OsCounterType = HARDWARE
      OsCounterAlgorithm = HEAP
      OsSecondsPerTick = 0.001
      OsCounterTicksPerBase = 100000
      OsCounterMaxAllowedValue = 2147483647
      OsCounterAccessingApplication = SystemApplication_OsCore
      OsDriver: OsDriverHighResolution=false, OsDriverHardwareTimerChannelRef=STM0_Ch0, OsDriverIsrRef=CounterIsr_SystemTimer
    OsOS:
      OsStackMonitoring = true
      OsStatus = EXTENDED
      OsUseGetServiceId = false
      OsUseParameterAccess = false
      OsUseResScheduler = true
      OsScalabilityClass = SC1
      OsGenerateMemMap = EMPTY
      OsGenerateMemMapForThreads = false
      OsForcibleTermination = false
      OsGenerateCalloutStubs = true
      OsGenerateMemMapForNearAddressing = false
      OsServiceProtection = false
      OsStackUsageMeasurement = false
      OsUseXSignalAsyncApiCalls = false
      OsNumberOfCores = 1
      OsFpuUsage = NONE
      OsUseCase = STANDARD
      OsUseArti = false
      OsMasterCore = OsCore
      OsHooks: OsErrorHook=false, OsPostTaskHook=false, OsPreTaskHook=false, OsShutdownHook=false, OsStartupHook=false, OsProtectionHook=false
      OsStackSummary
        8 x OsStack, all with OsStackCore=OsCore:
          OsCore_Init: OsStackSize=1024, OsStackType=CORE_INIT_STACK, OsStackUser=OsCore
          OsCore_Kernel: OsStackSize=1024, OsStackType=CORE_KERNEL_STACK, OsStackUser=OsCore
          OsCore_Isr_Core: OsStackSize=1024, OsStackType=ISR_SHARED_CORE_STACK, OsStackUser=CounterIsr_SystemTimer, OsStackUser=vCan_30_Mcan_Isr_0, OsStackUser=ADC0SR0_ISR
          BswTask: OsStackSize=320, OsStackType=TASK_EXTENDED_STACK, OsStackUser=Os/BswTask
          IoTask: OsStackSize=320, OsStackType=TASK_EXTENDED_STACK, OsStackUser=Os/IoTask
          OsCore_Task_Prio4294967295: OsStackSize=1024, OsStackType=TASK_SHARED_PRIORITY_STACK, OsStackUser=IdleTask_OsCore
          SwcTask: OsStackSize=320, OsStackType=TASK_EXTENDED_STACK, OsStackUser=Os/SwcTask
          OsCore_Task_NonPreemptiveBasic: OsStackSize=1024, OsStackType=TASK_SHARED_NONPRE_STACK, OsStackUser=Default_Init_Task, OsStackUser=Default_Init_Task_Trusted
    OSDEFAULTAPPMODE (OsAppMode)
    BswTask (OsTask):
      OsTaskActivation = 1
      OsTaskPriority = 2
      OsTaskSchedule = NON
      OsTaskStackSize = 320
      OsTaskStackSharing = false
      OsTaskType = AUTO
      OsTaskUsesFpu = false
      OsTaskEventRef = Rte_Ev_Cyclic2_BswTask_0_10ms
      OsTaskEventRef = Rte_Ev_Cyclic2_BswTask_0_20ms
      OsTaskResourceRef = RES_SCHEDULER_OsCore
      OsTaskAccessingApplication = SystemApplication_OsCore
      OsTaskEventRef = Rte_Ev_Cyclic2_BswTask_0_1s
      OsTaskEventRef = Rte_Ev_Run_CanTp_CanTp_MainFunction
    IoTask (OsTask):
      OsTaskActivation = 1
      OsTaskPriority = 3
      OsTaskSchedule = NON
      OsTaskStackSize = 320
      OsTaskStackSharing = false
      OsTaskType = AUTO
      OsTaskUsesFpu = false
      OsTaskEventRef = Rte_Ev_Run_IoHwAb_IoHwAb_IoHwAb_IoHwAbHandler
      OsTaskAccessingApplication = SystemApplication_OsCore
      OsTaskResourceRef = RES_SCHEDULER_OsCore
    RES_SCHEDULER_OsCore (OsResource): OsResourceProperty=STANDARD, OsResourceAccessingApplication=SystemApplication_OsCore
    Rte_Al_TE2_BswTask_0_10ms (OsAlarm): OsAlarmCounterRef=SystemTimer, OsAlarmAccessingApplication=SystemApplication_OsCore
      OsAlarmAction
        OsAlarmSetEvent: OsAlarmSetEventRef=Rte_Ev_Cyclic2_BswTask_0_10ms, OsAlarmSetEventTaskRef=Os/BswTask
    Rte_Al_TE2_BswTask_0_20ms (OsAlarm): OsAlarmCounterRef=SystemTimer, OsAlarmAccessingApplication=SystemApplication_OsCore
      OsAlarmAction
        OsAlarmSetEvent: OsAlarmSetEventRef=Rte_Ev_Cyclic2_BswTask_0_20ms, OsAlarmSetEventTaskRef=Os/BswTask
    Rte_Ev_Cyclic2_BswTask_0_10ms (OsEvent)
    Rte_Ev_Cyclic2_BswTask_0_20ms (OsEvent)
    SwcTask (OsTask):
      OsTaskActivation = 1
      OsTaskPriority = 1
      OsTaskSchedule = NON
      OsTaskStackSize = 320
      OsTaskStackSharing = false
      OsTaskType = AUTO
      OsTaskUsesFpu = false
      OsTaskEventRef = Rte_Ev_Cyclic_SwcTask_0_10ms
      OsTaskAccessingApplication = SystemApplication_OsCore
      OsTaskResourceRef = RES_SCHEDULER_OsCore
      OsTaskEventRef = Rte_Ev_Run_LightCtrl_ECU_Reset
      OsTaskEventRef = Rte_Ev_Run_LightCtrl_ECU_Reset_Execution
    Rte_Al_TE_IoHwAb_IoHwAb_IoHwAb_IoHwAbHandler (OsAlarm): OsAlarmCounterRef=SystemTimer, OsAlarmAccessingApplication=SystemApplication_OsCore
      OsAlarmAction
        OsAlarmSetEvent: OsAlarmSetEventRef=Rte_Ev_Run_IoHwAb_IoHwAb_IoHwAb_IoHwAbHandler, OsAlarmSetEventTaskRef=Os/IoTask
    Rte_Ev_Run_IoHwAb_IoHwAb_IoHwAb_IoHwAbHandler (OsEvent)
    Rte_Al_TE_SwcTask_0_10ms (OsAlarm): OsAlarmCounterRef=SystemTimer, OsAlarmAccessingApplication=SystemApplication_OsCore
      OsAlarmAction
        OsAlarmSetEvent: OsAlarmSetEventRef=Rte_Ev_Cyclic_SwcTask_0_10ms, OsAlarmSetEventTaskRef=Os/SwcTask
    Rte_Ev_Cyclic_SwcTask_0_10ms (OsEvent)
    OS_APPMODE_ANY (OsAppMode)
    OsPublishedInformation: OsKernelVersion=7, OsPlatformName=Arm
      TC38x (OsDerivativeInformation):
        OsMpuPrivilegedRegionsConfigurable = false
        OsMpuAlignment = 8
        OsMpuMemoryGapSize = 16
        OsMpuEndAddressAccessible = false
        OsStackAlignment = 8
        OsExceptionVectorTableAlignment = 256
        OsInterruptVectorTableAlignment = 8192
        OsHardwareManuals = User Manual: TC3XX_ts__TargetSpec_rev1v3v0.pdf V1.3.0, 2016-02 TC38X_ts_appx_V2.3.0.pdf V2.3.0 2017-09
        OsCyberSecurityConfiguration = false
        4 x OsPhysicalCore, all with OsPhysicalCoreType=TC1.6.2P, OsPhysicalCoreExceptionSources=8, OsPhysicalCorePrivelegedHwAccess=true:
          Core0: OsPhysicalCoreId=0, OsPhysicalCoreDefaultEntrySymbol=_start_tc0, OsPhysicalCoreMasterStartAllowed=true, OsPhysicalCoreIsAutostart=true, OsPhysicalCoreStackProtectionUnit=OsPhysicalCore0DataMpu
            OsPhysicalCore0DataMpu (OsPhysicalCoreMpu): OsPhysicalCoreMpuId=0, OsPhysicalCoreMpuMaxRegions=18, OsPhysicalCoreMpuType=DATA
            OsPhysicalCore0CodeMpu (OsPhysicalCoreMpu): OsPhysicalCoreMpuId=1, OsPhysicalCoreMpuMaxRegions=10, OsPhysicalCoreMpuType=CODE
          Core1: OsPhysicalCoreId=1, OsPhysicalCoreDefaultEntrySymbol=_start_tc1, OsPhysicalCoreMasterStartAllowed=false, OsPhysicalCoreIsAutostart=false, OsPhysicalCoreStackProtectionUnit=OsPhysicalCore1DataMpu
            OsPhysicalCore1DataMpu (OsPhysicalCoreMpu): OsPhysicalCoreMpuId=0, OsPhysicalCoreMpuMaxRegions=18, OsPhysicalCoreMpuType=DATA
            OsPhysicalCore1CodeMpu (OsPhysicalCoreMpu): OsPhysicalCoreMpuId=1, OsPhysicalCoreMpuMaxRegions=10, OsPhysicalCoreMpuType=CODE
          Core2: OsPhysicalCoreId=2, OsPhysicalCoreDefaultEntrySymbol=_start_tc2, OsPhysicalCoreMasterStartAllowed=false, OsPhysicalCoreIsAutostart=false, OsPhysicalCoreStackProtectionUnit=OsPhysicalCore2DataMpu
            OsPhysicalCore2DataMpu (OsPhysicalCoreMpu): OsPhysicalCoreMpuId=0, OsPhysicalCoreMpuMaxRegions=18, OsPhysicalCoreMpuType=DATA
            OsPhysicalCore2CodeMpu (OsPhysicalCoreMpu): OsPhysicalCoreMpuId=1, OsPhysicalCoreMpuMaxRegions=10, OsPhysicalCoreMpuType=CODE
          Core3: OsPhysicalCoreId=3, OsPhysicalCoreDefaultEntrySymbol=_start_tc3, OsPhysicalCoreMasterStartAllowed=false, OsPhysicalCoreIsAutostart=false, OsPhysicalCoreStackProtectionUnit=OsPhysicalCore3DataMpu
            OsPhysicalCore3DataMpu (OsPhysicalCoreMpu): OsPhysicalCoreMpuId=0, OsPhysicalCoreMpuMaxRegions=18, OsPhysicalCoreMpuType=DATA
            OsPhysicalCore3CodeMpu (OsPhysicalCoreMpu): OsPhysicalCoreMpuId=1, OsPhysicalCoreMpuMaxRegions=10, OsPhysicalCoreMpuType=CODE
        4 x OsHardwareTimer, all with OsHardwareTimerSize=32, OsHardwareTimerUnit=FRT, OsHardwareTimerType=STM:
          STM0: OsHardwareTimerBaseAddress=4026535936, OsHardwareTimerId=0
            STM0_Ch0 (OsHardwareTimerChannel): OsHardwareTimerChannelIntSource=768, OsHardwareTimerChannelOffset=0, OsHardwareTimerChannelId=0
            STM0_Ch1 (OsHardwareTimerChannel): OsHardwareTimerChannelIntSource=772, OsHardwareTimerChannelOffset=1, OsHardwareTimerChannelId=1
          STM1: OsHardwareTimerBaseAddress=4026536192, OsHardwareTimerId=1
            STM1_Ch0 (OsHardwareTimerChannel): OsHardwareTimerChannelIntSource=776, OsHardwareTimerChannelOffset=0, OsHardwareTimerChannelId=0
            STM1_Ch1 (OsHardwareTimerChannel): OsHardwareTimerChannelIntSource=780, OsHardwareTimerChannelOffset=1, OsHardwareTimerChannelId=1
          STM2: OsHardwareTimerBaseAddress=4026536448, OsHardwareTimerId=2
            STM2_Ch0 (OsHardwareTimerChannel): OsHardwareTimerChannelIntSource=784, OsHardwareTimerChannelOffset=0, OsHardwareTimerChannelId=0
            STM2_Ch1 (OsHardwareTimerChannel): OsHardwareTimerChannelIntSource=788, OsHardwareTimerChannelOffset=1, OsHardwareTimerChannelId=1
          STM3: OsHardwareTimerBaseAddress=4026536704, OsHardwareTimerId=3
            STM3_Ch0 (OsHardwareTimerChannel): OsHardwareTimerChannelIntSource=792, OsHardwareTimerChannelOffset=0, OsHardwareTimerChannelId=0
            STM3_Ch1 (OsHardwareTimerChannel): OsHardwareTimerChannelIntSource=796, OsHardwareTimerChannelOffset=1, OsHardwareTimerChannelId=1
        AURIXTC3XX_IR (OsSystemIntCtrl): OsSystemIntCtrlMaxPrios=255, OsSystemIntCtrlPrioOrder=ASC, OsSystemIntCtrlMaxSources=4092, OsSystemIntCtrlBaseAddress=4026757120
        GPT (OsHardwareTimer): OsHardwareTimerSize=16, OsHardwareTimerUnit=PIT, OsHardwareTimerBaseAddress=4026537984, OsHardwareTimerId=0, OsHardwareTimerType=PIT
          GPT_Ch0 (OsHardwareTimerChannel): OsHardwareTimerChannelIntSource=744, OsHardwareTimerChannelOffset=0, OsHardwareTimerChannelId=0
          GPT_Ch1 (OsHardwareTimerChannel): OsHardwareTimerChannelIntSource=756, OsHardwareTimerChannelOffset=1, OsHardwareTimerChannelId=1
        OsMemoryRegionSpecifics
          18 x OsMemoryRegionAccess:
            PS0_R: OsMemoryRegionAccessRights=R, OsMemoryRegionAccessType=PROTECTION_SET0
            PS0_W: OsMemoryRegionAccessRights=W, OsMemoryRegionAccessType=PROTECTION_SET0
            PS0_X: OsMemoryRegionAccessRights=X, OsMemoryRegionAccessType=PROTECTION_SET0
            PS1_R: OsMemoryRegionAccessRights=R, OsMemoryRegionAccessType=PROTECTION_SET1
            PS1_W: OsMemoryRegionAccessRights=W, OsMemoryRegionAccessType=PROTECTION_SET1
            PS1_X: OsMemoryRegionAccessRights=X, OsMemoryRegionAccessType=PROTECTION_SET1
            PS2_R: OsMemoryRegionAccessRights=R, OsMemoryRegionAccessType=PROTECTION_SET2
            PS2_W: OsMemoryRegionAccessRights=W, OsMemoryRegionAccessType=PROTECTION_SET2
            PS2_X: OsMemoryRegionAccessRights=X, OsMemoryRegionAccessType=PROTECTION_SET2
            PS3_R: OsMemoryRegionAccessRights=R, OsMemoryRegionAccessType=PROTECTION_SET3
            PS3_W: OsMemoryRegionAccessRights=W, OsMemoryRegionAccessType=PROTECTION_SET3
            PS3_X: OsMemoryRegionAccessRights=X, OsMemoryRegionAccessType=PROTECTION_SET3
            PS4_R: OsMemoryRegionAccessRights=R, OsMemoryRegionAccessType=PROTECTION_SET4
            PS4_W: OsMemoryRegionAccessRights=W, OsMemoryRegionAccessType=PROTECTION_SET4
            PS4_X: OsMemoryRegionAccessRights=X, OsMemoryRegionAccessType=PROTECTION_SET4
            PS5_R: OsMemoryRegionAccessRights=R, OsMemoryRegionAccessType=PROTECTION_SET5
            PS5_W: OsMemoryRegionAccessRights=W, OsMemoryRegionAccessType=PROTECTION_SET5
            PS5_X: OsMemoryRegionAccessRights=X, OsMemoryRegionAccessType=PROTECTION_SET5
        DMA (OsInterruptSupportedType):
          OsInterruptSupportedTypeSeparateSources = false
          OsInterruptSupportedTypeSeparatePriority = true
          OsInterruptSupportedTypeIsMapped = false
          OsInterruptSupportedTypePostActionRequired = false
      RCARV4H (OsDerivativeInformation):
        OsMpuAlignment = 64
        OsStackAlignment = 0
        OsExceptionVectorTableAlignment = 32
        OsInterruptVectorTableAlignment = 0
        OsHardwareManuals = Arm Cortex-R52 Processor, Revision: Technical Reference Manual, r1p2, 18 January 2019 ARM Architecture Reference Manual, ARMv8, for ARMv8-A architecture profile, ARM DDI 0487D.b (ID042519), 29 April 2019 ARM Architecture Reference Manual Supplement ARMv8, for the ARMv8-R AArch32 architecture profile, DDI0568A.b, 31 Mar 2017 Arm Generic Interrupt Controller, Architecture Specification, GIC architecture version 3 and version 4, Arm IHI 0069E (ID012119), January 2019 R-Car V4H Series User's Manual: Hardware, R8A779G2, Rev.0.54, August 2022 R-Car V4M Series User's Manual: Hardware, Rev.0.40, December 2022
        OsMpuEndAddressAccessible = true
        OsMpuPrivilegedRegionsConfigurable = true
        OsMpuMemoryGapSize = 0
        Core0 (OsPhysicalCore):
          OsPhysicalCoreId = 0
          OsPhysicalCoreDefaultEntrySymbol = _start
          OsPhysicalCoreType = Cortex-R52
          OsPhysicalCoreExceptionSources = 8
          OsPhysicalCoreIsAutostart = true
          OsPhysicalCoreMasterStartAllowed = false
          OsPhysicalCorePrivelegedHwAccess = true
          OsPhysicalCoreStackProtectionUnit = Core0_MPU
          Core0_MPU (OsPhysicalCoreMpu): OsPhysicalCoreMpuMaxRegions=24, OsPhysicalCoreMpuId=0, OsPhysicalCoreMpuType=CoreMpuv8
          MFIS (OsPhysicalCoreAddress): OsPhysicalCoreAddressValue=3861250048
        INTC (OsSystemIntCtrl):
          OsSystemIntCtrlMaxPrios = 248
          OsSystemIntCtrlMaxSources = 991
          OsSystemIntCtrlPrioOrder = DESC
          OsSystemIntCtrlType = GICv3
          OsSystemIntCtrlBaseAddress = 4293533696
        OsMemoryRegionSpecifics
          4 x OsMemoryRegionAccess, all with OsMemoryRegionAccessType=USERANDSUPERVISOR:
            SUPERVISOR_RW_USER_NONE: OsMemoryRegionAccessRights=S_RW_U_NONE
            SUPERVISOR_RW_USER_RW: OsMemoryRegionAccessRights=S_RW_U_RW
            SUPERVISOR_R_USER_NONE: OsMemoryRegionAccessRights=S_R_U_NONE
            SUPERVISOR_R_USER_R: OsMemoryRegionAccessRights=S_R_U_R
          TYPE_INNER_SHAREABLE (OsMemoryRegionFlag)
          TYPE_OUTER_SHAREABLE (OsMemoryRegionFlag)
          EXECUTE_ALLOWED (OsMemoryRegionAccess): OsMemoryRegionAccessRights=X, OsMemoryRegionAccessType=EXECUTION
          32 x OsMemoryRegionFlag:
            TYPE_DEVICE_GRE_MEMORY
            TYPE_DEVICE_nGRE_MEMORY
            TYPE_DEVICE_nGnRE_MEMORY
            TYPE_DEVICE_nGnRnE_MEMORY
            TYPE_NORMAL_MEMORY_OUTER_WRITETHROUGH_TRANSIENT_READALLOCATE
            TYPE_NORMAL_MEMORY_OUTER_WRITETHROUGH_TRANSIENT_WRITEALLOCATE
            TYPE_NORMAL_MEMORY_OUTER_WRITETHROUGH_TRANSIENT_READALLOCATE_WRITEALLOCATE
            TYPE_NORMAL_MEMORY_OUTER_NON_CACHEABLE
            TYPE_NORMAL_MEMORY_OUTER_WRITEBACK_TRANSIENT_READALLOCATE
            TYPE_NORMAL_MEMORY_OUTER_WRITEBACK_TRANSIENT_WRITEALLOCATE
            TYPE_NORMAL_MEMORY_OUTER_WRITEBACK_TRANSIENT_READALLOCATE_WRITEALLOCATE
            TYPE_NORMAL_MEMORY_OUTER_WRITETHROUGH_NONTRANSIENT_READALLOCATE
            TYPE_NORMAL_MEMORY_OUTER_WRITETHROUGH_NONTRANSIENT_WRITEALLOCATE
            TYPE_NORMAL_MEMORY_OUTER_WRITETHROUGH_NONTRANSIENT_READALLOCATE_WRITEALLOCATE
            TYPE_NORMAL_MEMORY_OUTER_WRITEBACK_NONTRANSIENT_READALLOCATE
            TYPE_NORMAL_MEMORY_OUTER_WRITEBACK_NONTRANSIENT_WRITEALLOCATE
            TYPE_NORMAL_MEMORY_OUTER_WRITEBACK_NONTRANSIENT_READALLOCATE_WRITEALLOCATE
            TYPE_NORMAL_MEMORY_INNER_WRITETHROUGH_TRANSIENT_READALLOCATE
            TYPE_NORMAL_MEMORY_INNER_WRITETHROUGH_TRANSIENT_WRITEALLOCATE
            TYPE_NORMAL_MEMORY_INNER_WRITETHROUGH_TRANSIENT_READALLOCATE_WRITEALLOCATE
            TYPE_NORMAL_MEMORY_INNER_NON_CACHEABLE
            TYPE_NORMAL_MEMORY_INNER_WRITEBACK_TRANSIENT_READALLOCATE
            TYPE_NORMAL_MEMORY_INNER_WRITEBACK_TRANSIENT_WRITEALLOCATE
            TYPE_NORMAL_MEMORY_INNER_WRITEBACK_TRANSIENT_READALLOCATE_WRITEALLOCATE
            TYPE_NORMAL_MEMORY_INNER_WRITETHROUGH_NONTRANSIENT
            TYPE_NORMAL_MEMORY_INNER_WRITETHROUGH_NONTRANSIENT_READALLOCATE
            TYPE_NORMAL_MEMORY_INNER_WRITETHROUGH_NONTRANSIENT_WRITEALLOCATE
            TYPE_NORMAL_MEMORY_INNER_WRITETHROUGH_NONTRANSIENT_READALLOCATE_WRITEALLOCATE
            TYPE_NORMAL_MEMORY_INNER_WRITEBACK_NONTRANSIENT
            TYPE_NORMAL_MEMORY_INNER_WRITEBACK_NONTRANSIENT_READALLOCATE
            TYPE_NORMAL_MEMORY_INNER_WRITEBACK_NONTRANSIENT_WRITEALLOCATE
            TYPE_NORMAL_MEMORY_INNER_WRITEBACK_NONTRANSIENT_READALLOCATE_WRITEALLOCATE
        OsMemoryRegionDefaults_AppT (OsMemoryRegionDefaults):
          OsMemoryRegionDefIdentifier = 1
          OsMemoryRegionDefType = APPLICATION_PRIVILEGED
          OsMemoryRegionDefAccessRights = SUPERVISOR_RW_USER_NONE
          OsMemoryRegionDefFlags = TYPE_NORMAL_MEMORY_INNER_WRITEBACK_TRANSIENT_READALLOCATE_WRITEALLOCATE
          OsMemoryRegionDefFlags = TYPE_NORMAL_MEMORY_OUTER_WRITEBACK_TRANSIENT_READALLOCATE_WRITEALLOCATE
        OsMemoryRegionDefaults_AppNT (OsMemoryRegionDefaults):
          OsMemoryRegionDefIdentifier = 1
          OsMemoryRegionDefType = APPLICATION_NONPRIVILEGED
          OsMemoryRegionDefAccessRights = SUPERVISOR_RW_USER_RW
          OsMemoryRegionDefFlags = TYPE_NORMAL_MEMORY_INNER_WRITEBACK_TRANSIENT_READALLOCATE_WRITEALLOCATE
          OsMemoryRegionDefFlags = TYPE_NORMAL_MEMORY_OUTER_WRITEBACK_TRANSIENT_READALLOCATE_WRITEALLOCATE
        Generic_Timer_Core0 (OsHardwareTimer): OsHardwareTimerSize=64, OsHardwareTimerUnit=FRT, OsHardwareTimerId=0, OsHardwareTimerType=V8R_GenericTimer, OsHardwareTimerBaseAddress=0
          EL1_PhysicalTimer_Core0 (OsHardwareTimerChannel): OsHardwareTimerChannelOffset=0, OsHardwareTimerChannelIntSource=30, OsHardwareTimerChannelId=0
          VirtualTimer_Core0 (OsHardwareTimerChannel): OsHardwareTimerChannelOffset=0, OsHardwareTimerChannelIntSource=27, OsHardwareTimerChannelId=1
        Core1 (OsPhysicalCore):
          OsPhysicalCoreId = 1
          OsPhysicalCoreDefaultEntrySymbol = _start_c1
          OsPhysicalCoreType = Cortex-R52
          OsPhysicalCoreExceptionSources = 8
          OsPhysicalCoreIsAutostart = true
          OsPhysicalCoreMasterStartAllowed = false
          OsPhysicalCorePrivelegedHwAccess = true
          OsPhysicalCoreStackProtectionUnit = Core1_MPU
          Core1_MPU (OsPhysicalCoreMpu): OsPhysicalCoreMpuMaxRegions=24, OsPhysicalCoreMpuId=0, OsPhysicalCoreMpuType=CoreMpuv8
        Core2 (OsPhysicalCore):
          OsPhysicalCoreId = 2
          OsPhysicalCoreDefaultEntrySymbol = _start_c2
          OsPhysicalCoreType = Cortex-R52
          OsPhysicalCoreExceptionSources = 8
          OsPhysicalCoreIsAutostart = true
          OsPhysicalCoreMasterStartAllowed = false
          OsPhysicalCorePrivelegedHwAccess = true
          OsPhysicalCoreStackProtectionUnit = Core2_MPU
          Core2_MPU (OsPhysicalCoreMpu): OsPhysicalCoreMpuMaxRegions=24, OsPhysicalCoreMpuId=0, OsPhysicalCoreMpuType=CoreMpuv8
        Generic_Timer_Core1 (OsHardwareTimer): OsHardwareTimerSize=64, OsHardwareTimerUnit=FRT, OsHardwareTimerId=1, OsHardwareTimerType=V8R_GenericTimer, OsHardwareTimerBaseAddress=0
          EL1_PhysicalTimer_Core1 (OsHardwareTimerChannel): OsHardwareTimerChannelOffset=0, OsHardwareTimerChannelIntSource=30, OsHardwareTimerChannelId=0
          VirtualTimer_Core1 (OsHardwareTimerChannel): OsHardwareTimerChannelOffset=0, OsHardwareTimerChannelIntSource=27, OsHardwareTimerChannelId=1
        Generic_Timer_Core2 (OsHardwareTimer): OsHardwareTimerSize=64, OsHardwareTimerUnit=FRT, OsHardwareTimerId=2, OsHardwareTimerType=V8R_GenericTimer, OsHardwareTimerBaseAddress=0
          EL1_PhysicalTimer_Core2 (OsHardwareTimerChannel): OsHardwareTimerChannelOffset=0, OsHardwareTimerChannelIntSource=30, OsHardwareTimerChannelId=0
          VirtualTimer_Core2 (OsHardwareTimerChannel): OsHardwareTimerChannelOffset=0, OsHardwareTimerChannelIntSource=27, OsHardwareTimerChannelId=1
    OsCore:
      OsCoreIsAutostart = true
      OsCoreIsAutosar = true
      OsCoreEntrySymbol = _start_tc0
      OsCorePhysicalCoreRef = TC38x/Core0
      OsCoreEcucCoreRef = EcucCoreDefinition
      OsCoreIdleTask = IdleTask_OsCore
      OsCoreSystemApplication = SystemApplication_OsCore
      OsCoreResScheduler = RES_SCHEDULER_OsCore
      OsCoreStacks:
        OsCoreKernelStackSize = 1024
        OsCoreStartupStackSize = 1024
        OsCoreShutdownStackSize = 1024
        OsCoreErrorStackSize = 1024
        OsCoreProtectionStackSize = 1024
        OsCoreInitStackSize = 1024
    IdleTask_OsCore (OsTask):
      OsTaskActivation = 1
      OsTaskPriority = 4294967295
      OsTaskSchedule = FULL
      OsTaskStackSharing = false
      OsTaskStackSize = 1024
      OsTaskType = AUTO
      OsTaskUsesFpu = false
      OsTaskAccessingApplication = SystemApplication_OsCore
      OsTaskResourceRef = RES_SCHEDULER_OsCore
      OsTaskAutostart: OsTaskAppModeRef=OS_APPMODE_ANY
    SystemApplication_OsCore (OsApplication):
      OsTrusted = true
      OsTrustedApplicationDelayTimingViolationCall = false
      OsTrustedApplicationWithProtection = false
      OsApplicationIsPrivileged = true
      OsAppUseTrustedFunctionStubs = false
      OsApplicationCoreRef = EcucCoreDefinition
      OsAppAlarmRef = Rte_Al_TE2_BswTask_0_10ms
      OsAppAlarmRef = Rte_Al_TE2_BswTask_0_20ms
      OsAppAlarmRef = Rte_Al_TE2_BswTask_0_1s
      OsAppAlarmRef = Rte_Al_TE_IoHwAb_IoHwAb_IoHwAb_IoHwAbHandler
      OsAppAlarmRef = Rte_Al_TE_SwcTask_0_10ms
      OsAppCounterRef = SystemTimer
      OsAppTaskRef = IdleTask_OsCore
      OsAppTaskRef = Os/BswTask
      OsAppTaskRef = Os/IoTask
      OsAppTaskRef = Os/SwcTask
      OsAppIsrRef = CounterIsr_SystemTimer
      OsAppIsrRef = vCan_30_Mcan_Isr_0
      OsAppTaskRef = Default_Init_Task
      OsAppTaskRef = Default_Init_Task_Trusted
      OsAppIsrRef = ADC0SR0_ISR
      OsAppAlarmRef = Rte_Al_TE_CanTp_CanTp_MainFunction
      OsApplicationHooks: OsAppErrorHook=false, OsAppShutdownHook=false, OsAppStartupHook=false
    CounterIsr_SystemTimer (OsIsr):
      OsIsrCategory = CATEGORY_2
      OsIsrInterruptType = EXTERNAL
      OsIsrInterruptSource = 768
      OsIsrInterruptPriority = 1
      OsIsrStackSize = 1024
      OsIsrEnableNesting = false
      OsIsrSpecialFunctionName = Os_TimerPfrtIsr
      OsIsrUsesFpu = false
      OsIsrInitialEnableInterruptSource = false
    vCan_30_Mcan_Isr_0 (OsIsr):  # /ActiveEcuC/Can PLAIN_TEXT Can messages event (for a specific controllers)
      OsIsrInterruptPriority = 16
      OsIsrCategory = CATEGORY_2
      OsIsrInterruptType = EXTERNAL
      OsIsrInterruptSource = 1456
      OsIsrStackSize = 1024
      OsIsrEnableNesting = false
      OsIsrUsesFpu = false
      OsIsrInitialEnableInterruptSource = true
    Rte_Al_TE2_BswTask_0_1s (OsAlarm): OsAlarmCounterRef=SystemTimer, OsAlarmAccessingApplication=SystemApplication_OsCore
      OsAlarmAction
        OsAlarmSetEvent: OsAlarmSetEventRef=Rte_Ev_Cyclic2_BswTask_0_1s, OsAlarmSetEventTaskRef=Os/BswTask
    Rte_Ev_Cyclic2_BswTask_0_1s (OsEvent)
    Default_Init_Task (OsTask):
      OsTaskActivation = 1
      OsTaskPriority = 50
      OsTaskSchedule = NON
      OsTaskStackSharing = true
      OsTaskStackSize = 1024
      OsTaskType = BASIC
      OsTaskUsesFpu = false
      OsTaskAccessingApplication = SystemApplication_OsCore
      OsTaskResourceRef = RES_SCHEDULER_OsCore
      OsTaskAutostart: OsTaskAppModeRef=OSDEFAULTAPPMODE
    Default_Init_Task_Trusted (OsTask):
      OsTaskActivation = 1
      OsTaskPriority = 49
      OsTaskSchedule = NON
      OsTaskStackSharing = true
      OsTaskStackSize = 1024
      OsTaskType = BASIC
      OsTaskUsesFpu = false
      OsTaskAccessingApplication = SystemApplication_OsCore
      OsTaskResourceRef = RES_SCHEDULER_OsCore
      OsTaskAutostart: OsTaskAppModeRef=OSDEFAULTAPPMODE
    ADC0SR0_ISR (OsIsr):
      OsIsrInterruptPriority = 15
      OsIsrCategory = CATEGORY_2
      OsIsrInterruptType = EXTERNAL
      OsIsrInterruptSource = 1648
      OsIsrStackSize = 1024
      OsIsrEnableNesting = false
      OsIsrUsesFpu = false
      OsIsrInitialEnableInterruptSource = true
      OsIsrSpecialFunctionName = ADC0SR0_ISR
    Rte_Al_TE_CanTp_CanTp_MainFunction (OsAlarm): OsAlarmCounterRef=SystemTimer, OsAlarmAccessingApplication=SystemApplication_OsCore
      OsAlarmAction
        OsAlarmSetEvent: OsAlarmSetEventRef=Rte_Ev_Run_CanTp_CanTp_MainFunction, OsAlarmSetEventTaskRef=Os/BswTask
    3 x OsEvent:
      Rte_Ev_Run_CanTp_CanTp_MainFunction
      Rte_Ev_Run_LightCtrl_ECU_Reset
      Rte_Ev_Run_LightCtrl_ECU_Reset_Execution
