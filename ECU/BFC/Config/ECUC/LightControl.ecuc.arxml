AUTOSAR XML (schema 00049)
package /ActiveEcuC
  ecuc value collection ActiveEcuC: ecu-extract=SYSTEM
    ecuc-values:
      CanSM
      EcuC
      Det
      CanIf
      Os
      PduR
      BswM
      Com
      Can
      Rte
      EcuM
      ComM
      Crc
      VTTCan
      VTTCntrl
      VTTEcuC
      VTTMcu
      VTTOs
      VTTvSet
      vSet
      MemMap
      VTTMemMap
      vCan
      vLinkGen
      vBRS
      vBaseEnv
      ResourceM
      McalLib
      Dio
      Mcu
      Adc
      Port
      Irq
      VTTDio
      VTTPort
      VTTAdc
      Dcm
      CanTp
      Fee
      Fls
      NvM
      MemIf
      VTTFls
      Dem
