AUTOSAR XML (schema 00049)
package /MICROSAR
  bsw implementation Nm_Impl: programming-language=C, sw-version=18.00.00, used-code-generator=DaVinci Configurator, vendor-id=30, ar-release-version=4.00.03
