AUTOSAR XML (schema 00049)
package /MICROSAR
  bsw implementation Fee_Impl: programming-language=C, sw-version=10.00.04, used-code-generator=DaVinci Configurator, vendor-id=30, ar-release-version=4.00.03
package /AURIX2G/EcucDefs/Fee_ib_bswmd/BswModuleDescriptions
  bsw module description Fee: provided-entrys=Fee_MainFunction
    bsw internal behavior FeeBehavior
      bsw schedulable entity Fee_MainFunction: implemented-entry=Fee_MainFunction
      bsw timing event Fee_MainFunctionTimingEvent0: starts-on-event=Fee_MainFunction, period=0.01
  bsw module entry Fee_MainFunction: call-type=SCHEDULED, execution-context=TASK
