AUTOSAR XML (schema 00049)
package /AURIX2G/EcucDefs/Mcu_ib_bswmd/BswModuleDescriptions
  bsw module description Mcu: provided-entrys=Mcu_Virtual
    bsw internal behavior McuBehavior
      exclusive area AtomAgcReg
      exclusive area TomTgcReg
      bsw called entity Mcu_Virtual: can-enter-exclusive-area=[AtomAgcReg, TomTgcReg], implemented-entry=Mcu_Virtual
  bsw module entry Mcu_Virtual: call-type=REGULAR, execution-context=TASK
package /TS_T2D22M10I1R0/Mcu_ib_bswmd/BswModuleDescriptions
  bsw module description Mcu
    bsw internal behavior McuBehavior
      4 x exclusive area:
        MCU_EXCLUSIVE_AREA_{00..03}
package /TS_T2D22M10I0R0/Mcu_ib_bswmd/BswModuleDescriptions
  bsw module description Mcu
    bsw internal behavior McuBehavior
      4 x exclusive area:
        MCU_EXCLUSIVE_AREA_{00..03}
