AUTOSAR XML (schema 00049)
package /MICROSAR/Dcm_ib_bswmd/BswModuleDescriptions
  bsw module description Dcm: provided-entrys=Dcm_MainFunction
    bsw internal behavior DcmBehavior
      exclusive area DCM_EXCLUSIVE_AREA_0
      bsw schedulable entity Dcm_MainFunction: can-enter-exclusive-area=DCM_EXCLUSIVE_AREA_0, implemented-entry=Dcm_MainFunction
      bsw timing event Dcm_MainFunctionTimingEvent0: starts-on-event=Dcm_MainFunction, period=0.01
  bsw module entry Dcm_MainFunction: call-type=SCHEDULED, execution-context=TASK
