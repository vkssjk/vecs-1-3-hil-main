AUTOSAR XML (schema 00049)
package /MICROSAR
  bsw implementation CanIf_Impl: programming-language=C, sw-version=11.02.00, used-code-generator=cMSR, vendor-id=30, ar-release-version=4.00.03
package /MICROSAR/CanIf_ib_bswmd/BswModuleDescriptions
  bsw module description CanIf: provided-entrys=CanIf_Virtual
    bsw internal behavior CanIf_Behavior
      8 x exclusive area:
        CANIF_EXCLUSIVE_AREA_{0..7}
      bsw called entity CanIf_Virtual: can-enter-exclusive-area=[CANIF_EXCLUSIVE_AREA_0, CANIF_EXCLUSIVE_AREA_1, CANIF_EXCLUSIVE_AREA_2, CANIF_EXCLUSIVE_AREA_3, CANIF_EXCLUSIVE_AREA_4, CANIF_EXCLUSIVE_AREA_5, CANIF_EXCLUSIVE_AREA_6, CANIF_EXCLUSIVE_AREA_7], implemented-entry=CanIf_Virtual
  bsw module entry CanIf_Virtual: call-type=REGULAR, execution-context=TASK
