AUTOSAR XML (schema 00049)
package /MICROSAR/Can_30_Core
  bsw implementation Can_Impl: programming-language=C, sw-version=4.01.00, used-code-generator=DaVinci Configurator, vendor-id=30, ar-release-version=4.00.03, vendor-api-infix=Core
    resource consumption ResourceConsumption
      61 x memory section:
        VAR_NOCACHE_CLEARED_UNSPECIFIED: alignment=UNSPECIFIED, sw-addrmethod=VAR_NOCACHE_CLEARED
        VAR_FAST_INIT_64: alignment=64, sw-addrmethod=VAR_FAST_INIT
        VAR_FAST_CLEARED_UNSPECIFIED: alignment=UNSPECIFIED, sw-addrmethod=VAR_FAST_CLEARED
        VAR_NO_INIT_8: alignment=8, sw-addrmethod=VAR_NO_INIT
        VAR_NOCACHE_CLEARED_16: alignment=16, sw-addrmethod=VAR_NOCACHE_CLEARED
        VAR_NO_INIT_16: alignment=16, sw-addrmethod=VAR_NO_INIT
        CONST_16: alignment=16, sw-addrmethod=CONST
        VAR_FAST_CLEARED_8: alignment=8, sw-addrmethod=VAR_FAST_CLEARED
        CODE: sw-addrmethod=CODE
        CONST_64: alignment=64, sw-addrmethod=CONST
        VAR_NOCACHE_CLEARED_8: alignment=8, sw-addrmethod=VAR_NOCACHE_CLEARED
        VAR_CLEARED_16: alignment=16, sw-addrmethod=VAR_CLEARED
        VAR_NOCACHE_CLEARED_BOOLEAN: alignment=BOOLEAN, sw-addrmethod=VAR_NOCACHE_CLEARED
        VAR_FAST_NO_INIT_16: alignment=16, sw-addrmethod=VAR_FAST_NO_INIT
        VAR_NO_INIT_64: alignment=64, sw-addrmethod=VAR_NO_INIT
        VAR_NOCACHE_CLEARED_64: alignment=64, sw-addrmethod=VAR_NOCACHE_CLEARED
        VAR_NOCACHE_INIT_32: alignment=32, sw-addrmethod=VAR_NOCACHE_INIT
        VAR_FAST_INIT_32: alignment=32, sw-addrmethod=VAR_FAST_INIT
        VAR_NO_INIT_UNSPECIFIED: alignment=UNSPECIFIED, sw-addrmethod=VAR_NO_INIT
        VAR_CLEARED_8: alignment=8, sw-addrmethod=VAR_CLEARED
        VAR_FAST_CLEARED_16: alignment=16, sw-addrmethod=VAR_FAST_CLEARED
        VAR_NOCACHE_INIT_8: alignment=8, sw-addrmethod=VAR_NOCACHE_INIT
        CONST_UNSPECIFIED: alignment=UNSPECIFIED, sw-addrmethod=CONST
        VAR_NOCACHE_NO_INIT_32: alignment=32, sw-addrmethod=VAR_NOCACHE_NO_INIT
        CONST_32: alignment=32, sw-addrmethod=CONST
        VAR_FAST_CLEARED_64: alignment=64, sw-addrmethod=VAR_FAST_CLEARED
        VAR_INIT_32: alignment=32, sw-addrmethod=VAR_INIT
        VAR_FAST_NO_INIT_64: alignment=64, sw-addrmethod=VAR_FAST_NO_INIT
        VAR_INIT_8: alignment=8, sw-addrmethod=VAR_INIT
        VAR_CLEARED_64: alignment=64, sw-addrmethod=VAR_CLEARED
        VAR_NO_INIT_32: alignment=32, sw-addrmethod=VAR_NO_INIT
        VAR_NOCACHE_INIT_64: alignment=64, sw-addrmethod=VAR_NOCACHE_INIT
        VAR_NOCACHE_CLEARED_32: alignment=32, sw-addrmethod=VAR_NOCACHE_CLEARED
        VAR_NOCACHE_INIT_BOOLEAN: alignment=BOOLEAN, sw-addrmethod=VAR_NOCACHE_INIT
        VAR_FAST_NO_INIT_BOOLEAN: alignment=BOOLEAN, sw-addrmethod=VAR_FAST_NO_INIT
        VAR_FAST_CLEARED_BOOLEAN: alignment=BOOLEAN, sw-addrmethod=VAR_FAST_CLEARED
        VAR_CLEARED_BOOLEAN: alignment=BOOLEAN, sw-addrmethod=VAR_CLEARED
        VAR_NO_INIT_BOOLEAN: alignment=BOOLEAN, sw-addrmethod=VAR_NO_INIT
        VAR_NOCACHE_NO_INIT_64: alignment=64, sw-addrmethod=VAR_NOCACHE_NO_INIT
        VAR_FAST_CLEARED_32: alignment=32, sw-addrmethod=VAR_FAST_CLEARED
        VAR_NOCACHE_NO_INIT_UNSPECIFIED: alignment=UNSPECIFIED, sw-addrmethod=VAR_NOCACHE_NO_INIT
        VAR_INIT_64: alignment=64, sw-addrmethod=VAR_INIT
        VAR_CLEARED_UNSPECIFIED: alignment=UNSPECIFIED, sw-addrmethod=VAR_CLEARED
        VAR_INIT_UNSPECIFIED: alignment=UNSPECIFIED, sw-addrmethod=VAR_INIT
        CONST_8: alignment=8, sw-addrmethod=CONST
        VAR_FAST_NO_INIT_32: alignment=32, sw-addrmethod=VAR_FAST_NO_INIT
        VAR_CLEARED_32: alignment=32, sw-addrmethod=VAR_CLEARED
        VAR_NOCACHE_NO_INIT_BOOLEAN: alignment=BOOLEAN, sw-addrmethod=VAR_NOCACHE_NO_INIT
        VAR_INIT_BOOLEAN: alignment=BOOLEAN, sw-addrmethod=VAR_INIT
        VAR_NOCACHE_INIT_UNSPECIFIED: alignment=UNSPECIFIED, sw-addrmethod=VAR_NOCACHE_INIT
        VAR_FAST_INIT_UNSPECIFIED: alignment=UNSPECIFIED, sw-addrmethod=VAR_FAST_INIT
        VAR_FAST_NO_INIT_8: alignment=8, sw-addrmethod=VAR_FAST_NO_INIT
        VAR_FAST_INIT_8: alignment=8, sw-addrmethod=VAR_FAST_INIT
        VAR_NOCACHE_INIT_16: alignment=16, sw-addrmethod=VAR_NOCACHE_INIT
        VAR_FAST_NO_INIT_UNSPECIFIED: alignment=UNSPECIFIED, sw-addrmethod=VAR_FAST_NO_INIT
        VAR_FAST_INIT_BOOLEAN: alignment=BOOLEAN, sw-addrmethod=VAR_FAST_INIT
        VAR_FAST_INIT_16: alignment=16, sw-addrmethod=VAR_FAST_INIT
        VAR_NOCACHE_NO_INIT_8: alignment=8, sw-addrmethod=VAR_NOCACHE_NO_INIT
        CONST_BOOLEAN: alignment=BOOLEAN, sw-addrmethod=CONST
        VAR_INIT_16: alignment=16, sw-addrmethod=VAR_INIT
        VAR_NOCACHE_NO_INIT_16: alignment=16, sw-addrmethod=VAR_NOCACHE_NO_INIT
package /MICROSAR/Can_CanoeemuCanoe_ib_bswmd/BswModuleDescriptions
  bsw module description Can
    provided-entrys:
      BswModuleDescriptions/Can_MainFunction_BusOff
      BswModuleDescriptions/Can_MainFunction_Wakeup
      BswModuleDescriptions/Can_MainFunction_Mode
    bsw internal behavior Can_CanoeemuCanoeBehavior
      8 x exclusive area:
        CAN_EXCLUSIVE_AREA_{0..7}
      bsw schedulable entity Can_MainFunction_BusOff: implemented-entry=BswModuleDescriptions/Can_MainFunction_BusOff
      bsw schedulable entity Can_MainFunction_Wakeup: implemented-entry=BswModuleDescriptions/Can_MainFunction_Wakeup
      bsw schedulable entity Can_MainFunction_Mode: implemented-entry=BswModuleDescriptions/Can_MainFunction_Mode
      bsw timing event Can_MainFunction_BusOffTimingEvent0: starts-on-event=Can_CanoeemuCanoeBehavior/Can_MainFunction_BusOff, period=0.01
      bsw timing event Can_MainFunction_WakeupTimingEvent0: starts-on-event=Can_CanoeemuCanoeBehavior/Can_MainFunction_Wakeup, period=0.01
      bsw timing event Can_MainFunction_ModeTimingEvent0: starts-on-event=Can_CanoeemuCanoeBehavior/Can_MainFunction_Mode, period=0.01
  bsw module entry Can_MainFunction_BusOff: call-type=SCHEDULED, execution-context=TASK
  bsw module entry Can_MainFunction_Wakeup: call-type=SCHEDULED, execution-context=TASK
  bsw module entry Can_MainFunction_Mode: call-type=SCHEDULED, execution-context=TASK
package /MICROSAR/Can_Mac7100Flexcan_ib_bswmd/BswModuleDescriptions
  bsw module description Can
    provided-entrys:
      BswModuleDescriptions/Can_MainFunction_BusOff
      BswModuleDescriptions/Can_MainFunction_Wakeup
      BswModuleDescriptions/Can_MainFunction_Mode
    bsw internal behavior Can_Mac7100Flexcan_Behavior
      7 x exclusive area:
        CAN_EXCLUSIVE_AREA_{0..6}
      bsw schedulable entity Can_MainFunction_BusOff: implemented-entry=BswModuleDescriptions/Can_MainFunction_BusOff
      bsw schedulable entity Can_MainFunction_Wakeup: implemented-entry=BswModuleDescriptions/Can_MainFunction_Wakeup
      bsw schedulable entity Can_MainFunction_Mode: implemented-entry=BswModuleDescriptions/Can_MainFunction_Mode
      bsw timing event Can_MainFunction_BusOffTimingEvent0: starts-on-event=Can_Mac7100Flexcan_Behavior/Can_MainFunction_BusOff, period=0.01
      bsw timing event Can_MainFunction_WakeupTimingEvent0: starts-on-event=Can_Mac7100Flexcan_Behavior/Can_MainFunction_Wakeup, period=0.01
      bsw timing event Can_MainFunction_ModeTimingEvent0: starts-on-event=Can_Mac7100Flexcan_Behavior/Can_MainFunction_Mode, period=0.01
  bsw module entry Can_MainFunction_BusOff: call-type=SCHEDULED, execution-context=TASK
  bsw module entry Can_MainFunction_Wakeup: call-type=SCHEDULED, execution-context=TASK
  bsw module entry Can_MainFunction_Mode: call-type=SCHEDULED, execution-context=TASK
