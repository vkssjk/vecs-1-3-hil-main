AUTOSAR XML (schema 00049)
package /MICROSAR/Can_30_Core_ib_bswmd/BswModuleDescriptions
  bsw module description Can
    provided-entrys:
      Can_30_Core_MainFunction_Write
      Can_30_Core_MainFunction_Read
      Can_30_Core_MainFunction_BusOff
      Can_30_Core_MainFunction_Wakeup
      Can_30_Core_MainFunction_Mode
    bsw internal behavior Can_CoreBehavior
      6 x exclusive area:
        CAN_30_CORE_EXCLUSIVE_AREA_1
        CAN_30_CORE_EXCLUSIVE_AREA_2
        CAN_30_CORE_EXCLUSIVE_AREA_{4..7}
      5 x bsw schedulable entity, all with can-enter-exclusive-area=[CAN_30_CORE_EXCLUSIVE_AREA_1, CAN_30_CORE_EXCLUSIVE_AREA_2, CAN_30_CORE_EXCLUSIVE_AREA_4, CAN_30_CORE_EXCLUSIVE_AREA_5, CAN_30_CORE_EXCLUSIVE_AREA_6, CAN_30_CORE_EXCLUSIVE_AREA_7]:
        Can_30_Core_MainFunction_Write: implemented-entry=Can_30_Core_MainFunction_Write
        Can_30_Core_MainFunction_Read: implemented-entry=Can_30_Core_MainFunction_Read
        Can_30_Core_MainFunction_BusOff: implemented-entry=Can_30_Core_MainFunction_BusOff
        Can_30_Core_MainFunction_Wakeup: implemented-entry=Can_30_Core_MainFunction_Wakeup
        Can_30_Core_MainFunction_Mode: implemented-entry=Can_30_Core_MainFunction_Mode
      5 x bsw timing event:
        Can_30_Core_MainFunction_WriteTimingEvent0: starts-on-event=Can_30_Core_MainFunction_Write, period=1
        Can_30_Core_MainFunction_ReadTimingEvent0: starts-on-event=Can_30_Core_MainFunction_Read, period=1
        Can_30_Core_MainFunction_BusOffTimingEvent0: starts-on-event=Can_30_Core_MainFunction_BusOff, period=0.01
        Can_30_Core_MainFunction_WakeupTimingEvent0: starts-on-event=Can_30_Core_MainFunction_Wakeup, period=0.01
        Can_30_Core_MainFunction_ModeTimingEvent0: starts-on-event=Can_30_Core_MainFunction_Mode, period=0.01
  5 x bsw module entry, all with call-type=SCHEDULED, execution-context=TASK:
    Can_30_Core_MainFunction_Write
    Can_30_Core_MainFunction_Read
    Can_30_Core_MainFunction_BusOff
    Can_30_Core_MainFunction_Wakeup
    Can_30_Core_MainFunction_Mode
