// T32 Tue Jan  4 13:50:25 2022

B::

TOOLBAR   ON
STATUSBAR ON
FramePOS 19.5,11.143,,,Maximized
WinPAGE.RESet

WinPAGE.Create P000
WinCLEAR

WinPOS 0.0 0.0 113. 54. 13. 1. W000
WinTABS 10. 10. 25.
d.l

WinPOS 117.88 -0.14286 117. 6. 23. 1. W003
WinTABS 13. 0. 0. 0. 0. 0. 0. 0. 0. 66.
Break.List

WinPOS 117.88 40.786 117. 24. 5. 0. W001
Frame.view /Locals /Caller

WinPAGE.select P000

ENDDO
