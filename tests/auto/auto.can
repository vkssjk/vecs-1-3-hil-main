/*@!Encoding:65001*/
includes
{
}

variables
{
  const long cHystOnDelay = 2000;
  const long cHystOffDelay = 3000;
  const long cEpsilon = 100;
  const long cLowerThreshold = 60;
  const long cUpperThreshold = 70;
  char CBStr[101];
  const int cMessageTimeout = 500;
  const int cSignalTimeout = 500;
}

void SetLightSwitch (int lightswitch)
{
  $ApplicationObjects::Mapping.SwitchState = lightswitch;
}

void SetLightIntensity (double lightintensity)
{
  $ApplicationObjects::Mapping.LightIntensity = lightintensity;
}

void RangeViolationCallback(dword checkID)
{
  testStepFail(CBStr);
  ChkControl_Stop(checkID);
}

void CheckHeadlightValueOverTime(int value, long timeout, char passstr[], char failstr[])
{
  dword checkID;
  long result;

  strncpy(CBStr, failstr, 100);
  checkID = ChkCreate_MsgSignalValueRangeViolation(ApplicationObjects::Mapping.HeadLightLamp
  , value, value, "RangeViolationCallback");

  ChkControl_Start(checkID);
  testWaitForTimeout(timeout);
  result = ChkQuery_NumEvents(checkID);

  if ( result == 0 )
  {
    ChkControl_Stop(checkID);
    testStepPass(passstr);
  }
}

void WaitForHeadlightValue(int awaitedValue, int timeout, char failstr[])
{
  long result;
  char buffer [250];

  result = TestWaitForImplValueSInt(ApplicationObjects::Mapping.HeadLightLamp, awaitedValue, timeout);

  if ( result < 1 )
  {
    snprintf(buffer, elcount(buffer), "Timed out after %d ms. Expected value: %d Actual Value: %d"
    , timeout, awaitedValue, $ApplicationObjects::Mapping.HeadLightLamp);

    TestStepFail(failstr);
    TestCaseComment(buffer);
    return;
  }
}

void WaitForHeadlightOn(int timeout)
{
  WaitForHeadlightValue(ApplicationObjects::eHeadlightSwitch::`ON, timeout, "Headlight did not switch on");
}

void WaitForHeadlightOff(int timeout)
{
  WaitForHeadlightValue(ApplicationObjects::eHeadlightSwitch::`OFF, timeout, "Headlight did not switch on");
}



export testcase CheckInstantAutoOnAfterOff()
{
  long result;

  // Init Testcase
  SetLightSwitch(ApplicationObjects::eHeadlightSwitch::`OFF);
  SetLightIntensity(0);
  WaitForHeadlightOff(500);
  testWaitForTimeout(3000); //added 3 seconds delay for real headlamp

  // Test functionality
  SetLightSwitch(ApplicationObjects::eHeadlightSwitch::`AUTO);
  testWaitForTimeout(cEpsilon);

  WaitForHeadlightValue(1, cEpsilon, "Headlight did not switch on immediatly");
  testStepPass("Headlight switched on immediatly");

  CheckHeadlightValueOverTime(1, _max(cHystOnDelay,cHystOffDelay)
  ,"Headlight stayed on after switching hysteresis time"
  ,"Headlight did not stay on after switching hysteresis time");
  testWaitForTimeout(500);
}

export testcase CheckInstantAutoOffAfterOn()
{
  long result;

  // Init Testcase
  SetLightSwitch(ApplicationObjects::eHeadlightSwitch::`ON);
  SetLightIntensity(100);
  WaitForHeadlightOn(500);
  testWaitForTimeout(3000); //added 3 seconds delay for real headlamp

  // Test functionality
  SetLightSwitch(ApplicationObjects::eHeadlightSwitch::`AUTO);
  testWaitForTimeout(cEpsilon);

  WaitForHeadlightValue(0, cEpsilon, "Headlight did not switch off immediately");
  testStepPass("Headlight switched off immediatly");

  CheckHeadlightValueOverTime(0, _max(cHystOnDelay,cHystOffDelay)
  ,"Headlight stayed off after switching hysteresis time"
  ,"Headlight did not stay off after switching hysteresis time");
  testWaitForTimeout(500);
}

export testcase CheckStayAutoOffAfterOff()
{
  long result;

  // Init Testcase
  SetLightSwitch(ApplicationObjects::eHeadlightSwitch::`OFF);
  SetLightIntensity(0);
  testWaitForTimeout(3000); //added 3 seconds delay for real headlamp
  SetLightIntensity(90);

  // Test functionality
  SetLightSwitch(ApplicationObjects::eHeadlightSwitch::`AUTO);
  testWaitForTimeout(cEpsilon);

  WaitForHeadlightValue(0, cEpsilon, "Headlight did not stay off after switching to Auto");
  testStepPass("Headlight stayed off after switching to Auto");

  CheckHeadlightValueOverTime(0, _max(cHystOnDelay,cHystOffDelay)
  ,"Headlight stayed off after switching hysteresis time"
  ,"Headlight did not stay off after switching hysteresis time");
  testWaitForTimeout(500);
}

export testcase CheckAutoOffAmbLightOn()
{
  long result;

  // Init Testcase
  testWaitForTimeout(cEpsilon);
  SetLightIntensity(0);
  SetLightSwitch(ApplicationObjects::eHeadlightSwitch::`ON);
  testWaitForTimeout(3000); //added 3 seconds delay for real headlamp
  SetLightSwitch(ApplicationObjects::eHeadlightSwitch::`AUTO);
  testWaitForTimeout(1500*2); //added 3 seconds delay for real headlamp

  // Test functionality
  SetLightIntensity(90);
  CheckHeadlightValueOverTime(1, cHystOffDelay - 2*cEpsilon
  ,"Headlight stayed on long enough after light intensity rise"
  ,"Headlight turned off too fast after light intensity rise");
  testWaitForTimeout(cEpsilon);

  WaitForHeadlightValue(0, 2*cEpsilon, "Headlight did not turn off after light intensity rise");

  testStepPass("Headlight turned off after light intensity rise");
  testWaitForTimeout(500);
}

export testcase CheckAutoOnAmbLightOff()
{
  long result;

  // Init Testcase
  SetLightIntensity(100);
  SetLightSwitch(ApplicationObjects::eHeadlightSwitch::`OFF);
  testWaitForTimeout(300);//added 3 seconds delay for real headlamp
  SetLightSwitch(ApplicationObjects::eHeadlightSwitch::`AUTO);
  testWaitForTimeout(300);//added 3 seconds delay for real headlamp

  // Test functionality
  SetLightIntensity(cLowerThreshold - 1);
  CheckHeadlightValueOverTime(0, cHystOnDelay - 2*cEpsilon
  ,"Headlight stayed off long enough after light intensity drop"
  ,"Headlight turned on too fast after light intensity drop");
  testWaitForTimeout(cEpsilon);
  WaitForHeadlightValue(1, 2*cEpsilon, "Headlight did not turn off after light intensity rise");

  testStepPass("Headlight turned on after light intensity drop");
  testWaitForTimeout(500);
}
